/* Generated by Cython 0.21 */

#define PY_SSIZE_T_CLEAN
#ifndef CYTHON_USE_PYLONG_INTERNALS
#ifdef PYLONG_BITS_IN_DIGIT
#define CYTHON_USE_PYLONG_INTERNALS 0
#else
#include "pyconfig.h"
#ifdef PYLONG_BITS_IN_DIGIT
#define CYTHON_USE_PYLONG_INTERNALS 1
#else
#define CYTHON_USE_PYLONG_INTERNALS 0
#endif
#endif
#endif
#include "Python.h"
#ifndef Py_PYTHON_H
    #error Python headers needed to compile C extensions, please install development version of Python.
#elif PY_VERSION_HEX < 0x02060000 || (0x03000000 <= PY_VERSION_HEX && PY_VERSION_HEX < 0x03020000)
    #error Cython requires Python 2.6+ or Python 3.2+.
#else
#define CYTHON_ABI "0_21"
#include <stddef.h>
#ifndef offsetof
#define offsetof(type, member) ( (size_t) & ((type*)0) -> member )
#endif
#if !defined(WIN32) && !defined(MS_WINDOWS)
  #ifndef __stdcall
    #define __stdcall
  #endif
  #ifndef __cdecl
    #define __cdecl
  #endif
  #ifndef __fastcall
    #define __fastcall
  #endif
#endif
#ifndef DL_IMPORT
  #define DL_IMPORT(t) t
#endif
#ifndef DL_EXPORT
  #define DL_EXPORT(t) t
#endif
#ifndef PY_LONG_LONG
  #define PY_LONG_LONG LONG_LONG
#endif
#ifndef Py_HUGE_VAL
  #define Py_HUGE_VAL HUGE_VAL
#endif
#ifdef PYPY_VERSION
#define CYTHON_COMPILING_IN_PYPY 1
#define CYTHON_COMPILING_IN_CPYTHON 0
#else
#define CYTHON_COMPILING_IN_PYPY 0
#define CYTHON_COMPILING_IN_CPYTHON 1
#endif
#if CYTHON_COMPILING_IN_PYPY && PY_VERSION_HEX < 0x02070600
#define Py_OptimizeFlag 0
#endif
#define __PYX_BUILD_PY_SSIZE_T "n"
#define CYTHON_FORMAT_SSIZE_T "z"
#if PY_MAJOR_VERSION < 3
  #define __Pyx_BUILTIN_MODULE_NAME "__builtin__"
  #define __Pyx_PyCode_New(a, k, l, s, f, code, c, n, v, fv, cell, fn, name, fline, lnos) \
          PyCode_New(a+k, l, s, f, code, c, n, v, fv, cell, fn, name, fline, lnos)
  #define __Pyx_DefaultClassType PyClass_Type
#else
  #define __Pyx_BUILTIN_MODULE_NAME "builtins"
  #define __Pyx_PyCode_New(a, k, l, s, f, code, c, n, v, fv, cell, fn, name, fline, lnos) \
          PyCode_New(a, k, l, s, f, code, c, n, v, fv, cell, fn, name, fline, lnos)
  #define __Pyx_DefaultClassType PyType_Type
#endif
#if PY_MAJOR_VERSION >= 3
  #define Py_TPFLAGS_CHECKTYPES 0
  #define Py_TPFLAGS_HAVE_INDEX 0
#endif
#if PY_MAJOR_VERSION >= 3
  #define Py_TPFLAGS_HAVE_NEWBUFFER 0
#endif
#if PY_VERSION_HEX < 0x030400a1 && !defined(Py_TPFLAGS_HAVE_FINALIZE)
  #define Py_TPFLAGS_HAVE_FINALIZE 0
#endif
#if PY_VERSION_HEX > 0x03030000 && defined(PyUnicode_KIND)
  #define CYTHON_PEP393_ENABLED 1
  #define __Pyx_PyUnicode_READY(op)       (likely(PyUnicode_IS_READY(op)) ? \
                                              0 : _PyUnicode_Ready((PyObject *)(op)))
  #define __Pyx_PyUnicode_GET_LENGTH(u)   PyUnicode_GET_LENGTH(u)
  #define __Pyx_PyUnicode_READ_CHAR(u, i) PyUnicode_READ_CHAR(u, i)
  #define __Pyx_PyUnicode_KIND(u)         PyUnicode_KIND(u)
  #define __Pyx_PyUnicode_DATA(u)         PyUnicode_DATA(u)
  #define __Pyx_PyUnicode_READ(k, d, i)   PyUnicode_READ(k, d, i)
#else
  #define CYTHON_PEP393_ENABLED 0
  #define __Pyx_PyUnicode_READY(op)       (0)
  #define __Pyx_PyUnicode_GET_LENGTH(u)   PyUnicode_GET_SIZE(u)
  #define __Pyx_PyUnicode_READ_CHAR(u, i) ((Py_UCS4)(PyUnicode_AS_UNICODE(u)[i]))
  #define __Pyx_PyUnicode_KIND(u)         (sizeof(Py_UNICODE))
  #define __Pyx_PyUnicode_DATA(u)         ((void*)PyUnicode_AS_UNICODE(u))
  #define __Pyx_PyUnicode_READ(k, d, i)   ((void)(k), (Py_UCS4)(((Py_UNICODE*)d)[i]))
#endif
#if CYTHON_COMPILING_IN_PYPY
  #define __Pyx_PyUnicode_Concat(a, b)      PyNumber_Add(a, b)
  #define __Pyx_PyUnicode_ConcatSafe(a, b)  PyNumber_Add(a, b)
#else
  #define __Pyx_PyUnicode_Concat(a, b)      PyUnicode_Concat(a, b)
  #define __Pyx_PyUnicode_ConcatSafe(a, b)  ((unlikely((a) == Py_None) || unlikely((b) == Py_None)) ? \
      PyNumber_Add(a, b) : __Pyx_PyUnicode_Concat(a, b))
#endif
#define __Pyx_PyString_FormatSafe(a, b)   ((unlikely((a) == Py_None)) ? PyNumber_Remainder(a, b) : __Pyx_PyString_Format(a, b))
#define __Pyx_PyUnicode_FormatSafe(a, b)  ((unlikely((a) == Py_None)) ? PyNumber_Remainder(a, b) : PyUnicode_Format(a, b))
#if PY_MAJOR_VERSION >= 3
  #define __Pyx_PyString_Format(a, b)  PyUnicode_Format(a, b)
#else
  #define __Pyx_PyString_Format(a, b)  PyString_Format(a, b)
#endif
#if PY_MAJOR_VERSION >= 3
  #define PyBaseString_Type            PyUnicode_Type
  #define PyStringObject               PyUnicodeObject
  #define PyString_Type                PyUnicode_Type
  #define PyString_Check               PyUnicode_Check
  #define PyString_CheckExact          PyUnicode_CheckExact
#endif
#if PY_MAJOR_VERSION >= 3
  #define __Pyx_PyBaseString_Check(obj) PyUnicode_Check(obj)
  #define __Pyx_PyBaseString_CheckExact(obj) PyUnicode_CheckExact(obj)
#else
  #define __Pyx_PyBaseString_Check(obj) (PyString_Check(obj) || PyUnicode_Check(obj))
  #define __Pyx_PyBaseString_CheckExact(obj) (PyString_CheckExact(obj) || PyUnicode_CheckExact(obj))
#endif
#ifndef PySet_CheckExact
  #define PySet_CheckExact(obj)        (Py_TYPE(obj) == &PySet_Type)
#endif
#define __Pyx_TypeCheck(obj, type) PyObject_TypeCheck(obj, (PyTypeObject *)type)
#if PY_MAJOR_VERSION >= 3
  #define PyIntObject                  PyLongObject
  #define PyInt_Type                   PyLong_Type
  #define PyInt_Check(op)              PyLong_Check(op)
  #define PyInt_CheckExact(op)         PyLong_CheckExact(op)
  #define PyInt_FromString             PyLong_FromString
  #define PyInt_FromUnicode            PyLong_FromUnicode
  #define PyInt_FromLong               PyLong_FromLong
  #define PyInt_FromSize_t             PyLong_FromSize_t
  #define PyInt_FromSsize_t            PyLong_FromSsize_t
  #define PyInt_AsLong                 PyLong_AsLong
  #define PyInt_AS_LONG                PyLong_AS_LONG
  #define PyInt_AsSsize_t              PyLong_AsSsize_t
  #define PyInt_AsUnsignedLongMask     PyLong_AsUnsignedLongMask
  #define PyInt_AsUnsignedLongLongMask PyLong_AsUnsignedLongLongMask
  #define PyNumber_Int                 PyNumber_Long
#endif
#if PY_MAJOR_VERSION >= 3
  #define PyBoolObject                 PyLongObject
#endif
#if PY_VERSION_HEX < 0x030200A4
  typedef long Py_hash_t;
  #define __Pyx_PyInt_FromHash_t PyInt_FromLong
  #define __Pyx_PyInt_AsHash_t   PyInt_AsLong
#else
  #define __Pyx_PyInt_FromHash_t PyInt_FromSsize_t
  #define __Pyx_PyInt_AsHash_t   PyInt_AsSsize_t
#endif
#if PY_MAJOR_VERSION >= 3
  #define PyMethod_New(func, self, klass) ((self) ? PyMethod_New(func, self) : PyInstanceMethod_New(func))
#endif
#ifndef CYTHON_INLINE
  #if defined(__GNUC__)
    #define CYTHON_INLINE __inline__
  #elif defined(_MSC_VER)
    #define CYTHON_INLINE __inline
  #elif defined (__STDC_VERSION__) && __STDC_VERSION__ >= 199901L
    #define CYTHON_INLINE inline
  #else
    #define CYTHON_INLINE
  #endif
#endif
#ifndef CYTHON_RESTRICT
  #if defined(__GNUC__)
    #define CYTHON_RESTRICT __restrict__
  #elif defined(_MSC_VER) && _MSC_VER >= 1400
    #define CYTHON_RESTRICT __restrict
  #elif defined (__STDC_VERSION__) && __STDC_VERSION__ >= 199901L
    #define CYTHON_RESTRICT restrict
  #else
    #define CYTHON_RESTRICT
  #endif
#endif
#ifdef NAN
#define __PYX_NAN() ((float) NAN)
#else
static CYTHON_INLINE float __PYX_NAN() {
  /* Initialize NaN. The sign is irrelevant, an exponent with all bits 1 and
   a nonzero mantissa means NaN. If the first bit in the mantissa is 1, it is
   a quiet NaN. */
  float value;
  memset(&value, 0xFF, sizeof(value));
  return value;
}
#endif
#ifdef __cplusplus
template<typename T>
void __Pyx_call_destructor(T* x) {
    x->~T();
}
#endif


#if PY_MAJOR_VERSION >= 3
  #define __Pyx_PyNumber_Divide(x,y)         PyNumber_TrueDivide(x,y)
  #define __Pyx_PyNumber_InPlaceDivide(x,y)  PyNumber_InPlaceTrueDivide(x,y)
#else
  #define __Pyx_PyNumber_Divide(x,y)         PyNumber_Divide(x,y)
  #define __Pyx_PyNumber_InPlaceDivide(x,y)  PyNumber_InPlaceDivide(x,y)
#endif

#ifndef __PYX_EXTERN_C
  #ifdef __cplusplus
    #define __PYX_EXTERN_C extern "C"
  #else
    #define __PYX_EXTERN_C extern
  #endif
#endif

#if defined(WIN32) || defined(MS_WINDOWS)
#define _USE_MATH_DEFINES
#endif
#include <math.h>
#define __PYX_HAVE__obitools__align___assemble
#define __PYX_HAVE_API__obitools__align___assemble
#include "stdlib.h"
#include "string.h"
#ifdef _OPENMP
#include <omp.h>
#endif /* _OPENMP */

#ifdef PYREX_WITHOUT_ASSERTIONS
#define CYTHON_WITHOUT_ASSERTIONS
#endif

#ifndef CYTHON_UNUSED
# if defined(__GNUC__)
#   if !(defined(__cplusplus)) || (__GNUC__ > 3 || (__GNUC__ == 3 && __GNUC_MINOR__ >= 4))
#     define CYTHON_UNUSED __attribute__ ((__unused__))
#   else
#     define CYTHON_UNUSED
#   endif
# elif defined(__ICC) || (defined(__INTEL_COMPILER) && !defined(_MSC_VER))
#   define CYTHON_UNUSED __attribute__ ((__unused__))
# else
#   define CYTHON_UNUSED
# endif
#endif
typedef struct {PyObject **p; char *s; const Py_ssize_t n; const char* encoding;
                const char is_unicode; const char is_str; const char intern; } __Pyx_StringTabEntry;

#define __PYX_DEFAULT_STRING_ENCODING_IS_ASCII 0
#define __PYX_DEFAULT_STRING_ENCODING_IS_DEFAULT 0
#define __PYX_DEFAULT_STRING_ENCODING ""
#define __Pyx_PyObject_FromString __Pyx_PyBytes_FromString
#define __Pyx_PyObject_FromStringAndSize __Pyx_PyBytes_FromStringAndSize
#define __Pyx_fits_Py_ssize_t(v, type, is_signed)  (    \
    (sizeof(type) < sizeof(Py_ssize_t))  ||             \
    (sizeof(type) > sizeof(Py_ssize_t) &&               \
          likely(v < (type)PY_SSIZE_T_MAX ||            \
                 v == (type)PY_SSIZE_T_MAX)  &&         \
          (!is_signed || likely(v > (type)PY_SSIZE_T_MIN ||       \
                                v == (type)PY_SSIZE_T_MIN)))  ||  \
    (sizeof(type) == sizeof(Py_ssize_t) &&              \
          (is_signed || likely(v < (type)PY_SSIZE_T_MAX ||        \
                               v == (type)PY_SSIZE_T_MAX)))  )
static CYTHON_INLINE char* __Pyx_PyObject_AsString(PyObject*);
static CYTHON_INLINE char* __Pyx_PyObject_AsStringAndSize(PyObject*, Py_ssize_t* length);
#define __Pyx_PyByteArray_FromString(s) PyByteArray_FromStringAndSize((const char*)s, strlen((const char*)s))
#define __Pyx_PyByteArray_FromStringAndSize(s, l) PyByteArray_FromStringAndSize((const char*)s, l)
#define __Pyx_PyBytes_FromString        PyBytes_FromString
#define __Pyx_PyBytes_FromStringAndSize PyBytes_FromStringAndSize
static CYTHON_INLINE PyObject* __Pyx_PyUnicode_FromString(const char*);
#if PY_MAJOR_VERSION < 3
    #define __Pyx_PyStr_FromString        __Pyx_PyBytes_FromString
    #define __Pyx_PyStr_FromStringAndSize __Pyx_PyBytes_FromStringAndSize
#else
    #define __Pyx_PyStr_FromString        __Pyx_PyUnicode_FromString
    #define __Pyx_PyStr_FromStringAndSize __Pyx_PyUnicode_FromStringAndSize
#endif
#define __Pyx_PyObject_AsSString(s)    ((signed char*) __Pyx_PyObject_AsString(s))
#define __Pyx_PyObject_AsUString(s)    ((unsigned char*) __Pyx_PyObject_AsString(s))
#define __Pyx_PyObject_FromUString(s)  __Pyx_PyObject_FromString((const char*)s)
#define __Pyx_PyBytes_FromUString(s)   __Pyx_PyBytes_FromString((const char*)s)
#define __Pyx_PyByteArray_FromUString(s)   __Pyx_PyByteArray_FromString((const char*)s)
#define __Pyx_PyStr_FromUString(s)     __Pyx_PyStr_FromString((const char*)s)
#define __Pyx_PyUnicode_FromUString(s) __Pyx_PyUnicode_FromString((const char*)s)
#if PY_MAJOR_VERSION < 3
static CYTHON_INLINE size_t __Pyx_Py_UNICODE_strlen(const Py_UNICODE *u)
{
    const Py_UNICODE *u_end = u;
    while (*u_end++) ;
    return (size_t)(u_end - u - 1);
}
#else
#define __Pyx_Py_UNICODE_strlen Py_UNICODE_strlen
#endif
#define __Pyx_PyUnicode_FromUnicode(u)       PyUnicode_FromUnicode(u, __Pyx_Py_UNICODE_strlen(u))
#define __Pyx_PyUnicode_FromUnicodeAndLength PyUnicode_FromUnicode
#define __Pyx_PyUnicode_AsUnicode            PyUnicode_AsUnicode
#define __Pyx_Owned_Py_None(b) (Py_INCREF(Py_None), Py_None)
#define __Pyx_PyBool_FromLong(b) ((b) ? (Py_INCREF(Py_True), Py_True) : (Py_INCREF(Py_False), Py_False))
static CYTHON_INLINE int __Pyx_PyObject_IsTrue(PyObject*);
static CYTHON_INLINE PyObject* __Pyx_PyNumber_Int(PyObject* x);
static CYTHON_INLINE Py_ssize_t __Pyx_PyIndex_AsSsize_t(PyObject*);
static CYTHON_INLINE PyObject * __Pyx_PyInt_FromSize_t(size_t);
#if CYTHON_COMPILING_IN_CPYTHON
#define __pyx_PyFloat_AsDouble(x) (PyFloat_CheckExact(x) ? PyFloat_AS_DOUBLE(x) : PyFloat_AsDouble(x))
#else
#define __pyx_PyFloat_AsDouble(x) PyFloat_AsDouble(x)
#endif
#define __pyx_PyFloat_AsFloat(x) ((float) __pyx_PyFloat_AsDouble(x))
#if PY_MAJOR_VERSION < 3 && __PYX_DEFAULT_STRING_ENCODING_IS_ASCII
static int __Pyx_sys_getdefaultencoding_not_ascii;
static int __Pyx_init_sys_getdefaultencoding_params(void) {
    PyObject* sys;
    PyObject* default_encoding = NULL;
    PyObject* ascii_chars_u = NULL;
    PyObject* ascii_chars_b = NULL;
    const char* default_encoding_c;
    sys = PyImport_ImportModule("sys");
    if (!sys) goto bad;
    default_encoding = PyObject_CallMethod(sys, (char*) (const char*) "getdefaultencoding", NULL);
    Py_DECREF(sys);
    if (!default_encoding) goto bad;
    default_encoding_c = PyBytes_AsString(default_encoding);
    if (!default_encoding_c) goto bad;
    if (strcmp(default_encoding_c, "ascii") == 0) {
        __Pyx_sys_getdefaultencoding_not_ascii = 0;
    } else {
        char ascii_chars[128];
        int c;
        for (c = 0; c < 128; c++) {
            ascii_chars[c] = c;
        }
        __Pyx_sys_getdefaultencoding_not_ascii = 1;
        ascii_chars_u = PyUnicode_DecodeASCII(ascii_chars, 128, NULL);
        if (!ascii_chars_u) goto bad;
        ascii_chars_b = PyUnicode_AsEncodedString(ascii_chars_u, default_encoding_c, NULL);
        if (!ascii_chars_b || !PyBytes_Check(ascii_chars_b) || memcmp(ascii_chars, PyBytes_AS_STRING(ascii_chars_b), 128) != 0) {
            PyErr_Format(
                PyExc_ValueError,
                "This module compiled with c_string_encoding=ascii, but default encoding '%.200s' is not a superset of ascii.",
                default_encoding_c);
            goto bad;
        }
        Py_DECREF(ascii_chars_u);
        Py_DECREF(ascii_chars_b);
    }
    Py_DECREF(default_encoding);
    return 0;
bad:
    Py_XDECREF(default_encoding);
    Py_XDECREF(ascii_chars_u);
    Py_XDECREF(ascii_chars_b);
    return -1;
}
#endif
#if __PYX_DEFAULT_STRING_ENCODING_IS_DEFAULT && PY_MAJOR_VERSION >= 3
#define __Pyx_PyUnicode_FromStringAndSize(c_str, size) PyUnicode_DecodeUTF8(c_str, size, NULL)
#else
#define __Pyx_PyUnicode_FromStringAndSize(c_str, size) PyUnicode_Decode(c_str, size, __PYX_DEFAULT_STRING_ENCODING, NULL)
#if __PYX_DEFAULT_STRING_ENCODING_IS_DEFAULT
static char* __PYX_DEFAULT_STRING_ENCODING;
static int __Pyx_init_sys_getdefaultencoding_params(void) {
    PyObject* sys;
    PyObject* default_encoding = NULL;
    char* default_encoding_c;
    sys = PyImport_ImportModule("sys");
    if (!sys) goto bad;
    default_encoding = PyObject_CallMethod(sys, (char*) (const char*) "getdefaultencoding", NULL);
    Py_DECREF(sys);
    if (!default_encoding) goto bad;
    default_encoding_c = PyBytes_AsString(default_encoding);
    if (!default_encoding_c) goto bad;
    __PYX_DEFAULT_STRING_ENCODING = (char*) malloc(strlen(default_encoding_c));
    if (!__PYX_DEFAULT_STRING_ENCODING) goto bad;
    strcpy(__PYX_DEFAULT_STRING_ENCODING, default_encoding_c);
    Py_DECREF(default_encoding);
    return 0;
bad:
    Py_XDECREF(default_encoding);
    return -1;
}
#endif
#endif


/* Test for GCC > 2.95 */
#if defined(__GNUC__)     && (__GNUC__ > 2 || (__GNUC__ == 2 && (__GNUC_MINOR__ > 95)))
  #define likely(x)   __builtin_expect(!!(x), 1)
  #define unlikely(x) __builtin_expect(!!(x), 0)
#else /* !__GNUC__ or GCC < 2.95 */
  #define likely(x)   (x)
  #define unlikely(x) (x)
#endif /* __GNUC__ */

static PyObject *__pyx_m;
static PyObject *__pyx_d;
static PyObject *__pyx_b;
static PyObject *__pyx_empty_tuple;
static PyObject *__pyx_empty_bytes;
static int __pyx_lineno;
static int __pyx_clineno = 0;
static const char * __pyx_cfilenm= __FILE__;
static const char *__pyx_filename;


static const char *__pyx_f[] = {
  "obitools/align/_assemble.pyx",
  "obitools/align/_dynamic.pxd",
};

/*--- Type declarations ---*/
struct __pyx_obj_8obitools_5align_8_dynamic_DynamicProgramming;
struct __pyx_obj_8obitools_5align_4_nws_NWS;
struct __pyx_obj_8obitools_5align_9_assemble_DirectAssemble;
struct __pyx_obj_8obitools_5align_9_assemble_ReverseAssemble;
struct __pyx_t_8obitools_5align_8_dynamic_AlignCell;
struct __pyx_t_8obitools_5align_8_dynamic_AlignMatrix;
struct __pyx_opt_args_8obitools_5align_8_dynamic_allocateMatrix;
struct __pyx_t_8obitools_5align_8_dynamic_alignSequence;
struct __pyx_opt_args_8obitools_5align_8_dynamic_allocateSequence;
struct __pyx_t_8obitools_5align_8_dynamic_alignPath;
struct __pyx_opt_args_8obitools_5align_8_dynamic_allocatePath;

/* "_dynamic.pxd":11
 *     void memcpy(void* s1, void* s2, int n)
 * 
 * cdef struct AlignCell :             # <<<<<<<<<<<<<<
 *     double score
 *     int   path
 */
struct __pyx_t_8obitools_5align_8_dynamic_AlignCell {
  double score;
  int path;
};

/* "_dynamic.pxd":15
 *     int   path
 * 
 * cdef struct AlignMatrix :             # <<<<<<<<<<<<<<
 *     AlignCell*  matrix
 *     int*        bestVJump
 */
struct __pyx_t_8obitools_5align_8_dynamic_AlignMatrix {
  struct __pyx_t_8obitools_5align_8_dynamic_AlignCell *matrix;
  int *bestVJump;
  int *bestHJump;
  int msize;
  int vsize;
  int hsize;
};

/* "_dynamic.pxd":25
 * 
 * 
 * cdef AlignMatrix* allocateMatrix(int hsize, int vsize,AlignMatrix *matrix=?)             # <<<<<<<<<<<<<<
 * 
 * cdef void freeMatrix(AlignMatrix* matrix)
 */
struct __pyx_opt_args_8obitools_5align_8_dynamic_allocateMatrix {
  int __pyx_n;
  struct __pyx_t_8obitools_5align_8_dynamic_AlignMatrix *matrix;
};

/* "_dynamic.pxd":32
 * 
 * 
 * cdef struct alignSequence:             # <<<<<<<<<<<<<<
 *     long    length
 *     long    buffsize
 */
struct __pyx_t_8obitools_5align_8_dynamic_alignSequence {
  long length;
  long buffsize;
  int hasQuality;
  char *sequence;
  double *quality;
};

/* "_dynamic.pxd":39
 *     double* quality
 * 
 * cdef alignSequence* allocateSequence(object bioseq, alignSequence* seq=?) except *             # <<<<<<<<<<<<<<
 * 
 * cdef void freeSequence(alignSequence* seq)
 */
struct __pyx_opt_args_8obitools_5align_8_dynamic_allocateSequence {
  int __pyx_n;
  struct __pyx_t_8obitools_5align_8_dynamic_alignSequence *seq;
};

/* "_dynamic.pxd":43
 * cdef void freeSequence(alignSequence* seq)
 * 
 * cdef struct alignPath:             # <<<<<<<<<<<<<<
 *     long length
 *     long buffsize
 */
struct __pyx_t_8obitools_5align_8_dynamic_alignPath {
  long length;
  long buffsize;
  long vStart;
  long hStart;
  long *path;
};

/* "_dynamic.pxd":50
 *     long *path
 * 
 * cdef alignPath* allocatePath(long l1,long l2,alignPath* path=?)             # <<<<<<<<<<<<<<
 * 
 * cdef void reversePath(alignPath* path)
 */
struct __pyx_opt_args_8obitools_5align_8_dynamic_allocatePath {
  int __pyx_n;
  struct __pyx_t_8obitools_5align_8_dynamic_alignPath *path;
};

/* "_dynamic.pxd":63
 * cpdef unsigned char encodeBase(unsigned char lettre)
 * 
 * cdef class DynamicProgramming:             # <<<<<<<<<<<<<<
 *     cdef AlignMatrix* matrix
 * 
 */
struct __pyx_obj_8obitools_5align_8_dynamic_DynamicProgramming {
  PyObject_HEAD
  struct __pyx_vtabstruct_8obitools_5align_8_dynamic_DynamicProgramming *__pyx_vtab;
  struct __pyx_t_8obitools_5align_8_dynamic_AlignMatrix *matrix;
  PyObject *horizontalSeq;
  PyObject *verticalSeq;
  struct __pyx_t_8obitools_5align_8_dynamic_alignSequence *hSeq;
  struct __pyx_t_8obitools_5align_8_dynamic_alignSequence *vSeq;
  struct __pyx_t_8obitools_5align_8_dynamic_alignPath *path;
  double _opengap;
  double _extgap;
  PyObject *alignment;
  int sequenceChanged;
  int scoreChanged;
};


/* "_nws.pxd":3
 * from _dynamic cimport *
 * 
 * cdef class NWS(DynamicProgramming):             # <<<<<<<<<<<<<<
 *     cdef double _match
 *     cdef double _mismatch
 */
struct __pyx_obj_8obitools_5align_4_nws_NWS {
  struct __pyx_obj_8obitools_5align_8_dynamic_DynamicProgramming __pyx_base;
  double _match;
  double _mismatch;
};

struct __pyx_obj_8obitools_5align_9_assemble_DirectAssemble {
  struct __pyx_obj_8obitools_5align_4_nws_NWS __pyx_base;
  double ysmax;
  int ymax;
};


/* "obitools/align/_assemble.pxd":9
 *     cdef double doAlignment(self) except? 0
 * 
 * cdef class ReverseAssemble(DirectAssemble):             # <<<<<<<<<<<<<<
 *     pass
 */
struct __pyx_obj_8obitools_5align_9_assemble_ReverseAssemble {
  struct __pyx_obj_8obitools_5align_9_assemble_DirectAssemble __pyx_base;
};



/* "_dynamic.pxd":63
 * cpdef unsigned char encodeBase(unsigned char lettre)
 * 
 * cdef class DynamicProgramming:             # <<<<<<<<<<<<<<
 *     cdef AlignMatrix* matrix
 * 
 */

struct __pyx_vtabstruct_8obitools_5align_8_dynamic_DynamicProgramming {
  int (*_vlen)(struct __pyx_obj_8obitools_5align_8_dynamic_DynamicProgramming *);
  int (*_hlen)(struct __pyx_obj_8obitools_5align_8_dynamic_DynamicProgramming *);
  int (*allocate)(struct __pyx_obj_8obitools_5align_8_dynamic_DynamicProgramming *);
  double (*doAlignment)(struct __pyx_obj_8obitools_5align_8_dynamic_DynamicProgramming *);
  void (*reset)(struct __pyx_obj_8obitools_5align_8_dynamic_DynamicProgramming *);
  int (*index)(struct __pyx_obj_8obitools_5align_8_dynamic_DynamicProgramming *, int, int);
  int (*_needToCompute)(struct __pyx_obj_8obitools_5align_8_dynamic_DynamicProgramming *);
  void (*backtrack)(struct __pyx_obj_8obitools_5align_8_dynamic_DynamicProgramming *);
  void (*clean)(struct __pyx_obj_8obitools_5align_8_dynamic_DynamicProgramming *);
};
static struct __pyx_vtabstruct_8obitools_5align_8_dynamic_DynamicProgramming *__pyx_vtabptr_8obitools_5align_8_dynamic_DynamicProgramming;


/* "_nws.pxd":3
 * from _dynamic cimport *
 * 
 * cdef class NWS(DynamicProgramming):             # <<<<<<<<<<<<<<
 *     cdef double _match
 *     cdef double _mismatch
 */

struct __pyx_vtabstruct_8obitools_5align_4_nws_NWS {
  struct __pyx_vtabstruct_8obitools_5align_8_dynamic_DynamicProgramming __pyx_base;
  double (*matchScore)(struct __pyx_obj_8obitools_5align_4_nws_NWS *, int, int);
};
static struct __pyx_vtabstruct_8obitools_5align_4_nws_NWS *__pyx_vtabptr_8obitools_5align_4_nws_NWS;


/* "obitools/align/_assemble.pyx":11
 * 
 * 
 * cdef class DirectAssemble(NWS):             # <<<<<<<<<<<<<<
 * 
 *     def __init__(self,match=4,mismatch=-6,opengap=-8,extgap=-2):
 */

struct __pyx_vtabstruct_8obitools_5align_9_assemble_DirectAssemble {
  struct __pyx_vtabstruct_8obitools_5align_4_nws_NWS __pyx_base;
};
static struct __pyx_vtabstruct_8obitools_5align_9_assemble_DirectAssemble *__pyx_vtabptr_8obitools_5align_9_assemble_DirectAssemble;


/* "obitools/align/_assemble.pyx":160
 * 
 * 
 * cdef class ReverseAssemble(DirectAssemble):             # <<<<<<<<<<<<<<
 * 
 *     property seqB:
 */

struct __pyx_vtabstruct_8obitools_5align_9_assemble_ReverseAssemble {
  struct __pyx_vtabstruct_8obitools_5align_9_assemble_DirectAssemble __pyx_base;
};
static struct __pyx_vtabstruct_8obitools_5align_9_assemble_ReverseAssemble *__pyx_vtabptr_8obitools_5align_9_assemble_ReverseAssemble;
#ifndef CYTHON_REFNANNY
  #define CYTHON_REFNANNY 0
#endif
#if CYTHON_REFNANNY
  typedef struct {
    void (*INCREF)(void*, PyObject*, int);
    void (*DECREF)(void*, PyObject*, int);
    void (*GOTREF)(void*, PyObject*, int);
    void (*GIVEREF)(void*, PyObject*, int);
    void* (*SetupContext)(const char*, int, const char*);
    void (*FinishContext)(void**);
  } __Pyx_RefNannyAPIStruct;
  static __Pyx_RefNannyAPIStruct *__Pyx_RefNanny = NULL;
  static __Pyx_RefNannyAPIStruct *__Pyx_RefNannyImportAPI(const char *modname);
  #define __Pyx_RefNannyDeclarations void *__pyx_refnanny = NULL;
#ifdef WITH_THREAD
  #define __Pyx_RefNannySetupContext(name, acquire_gil) \
          if (acquire_gil) { \
              PyGILState_STATE __pyx_gilstate_save = PyGILState_Ensure(); \
              __pyx_refnanny = __Pyx_RefNanny->SetupContext((name), __LINE__, __FILE__); \
              PyGILState_Release(__pyx_gilstate_save); \
          } else { \
              __pyx_refnanny = __Pyx_RefNanny->SetupContext((name), __LINE__, __FILE__); \
          }
#else
  #define __Pyx_RefNannySetupContext(name, acquire_gil) \
          __pyx_refnanny = __Pyx_RefNanny->SetupContext((name), __LINE__, __FILE__)
#endif
  #define __Pyx_RefNannyFinishContext() \
          __Pyx_RefNanny->FinishContext(&__pyx_refnanny)
  #define __Pyx_INCREF(r)  __Pyx_RefNanny->INCREF(__pyx_refnanny, (PyObject *)(r), __LINE__)
  #define __Pyx_DECREF(r)  __Pyx_RefNanny->DECREF(__pyx_refnanny, (PyObject *)(r), __LINE__)
  #define __Pyx_GOTREF(r)  __Pyx_RefNanny->GOTREF(__pyx_refnanny, (PyObject *)(r), __LINE__)
  #define __Pyx_GIVEREF(r) __Pyx_RefNanny->GIVEREF(__pyx_refnanny, (PyObject *)(r), __LINE__)
  #define __Pyx_XINCREF(r)  do { if((r) != NULL) {__Pyx_INCREF(r); }} while(0)
  #define __Pyx_XDECREF(r)  do { if((r) != NULL) {__Pyx_DECREF(r); }} while(0)
  #define __Pyx_XGOTREF(r)  do { if((r) != NULL) {__Pyx_GOTREF(r); }} while(0)
  #define __Pyx_XGIVEREF(r) do { if((r) != NULL) {__Pyx_GIVEREF(r);}} while(0)
#else
  #define __Pyx_RefNannyDeclarations
  #define __Pyx_RefNannySetupContext(name, acquire_gil)
  #define __Pyx_RefNannyFinishContext()
  #define __Pyx_INCREF(r) Py_INCREF(r)
  #define __Pyx_DECREF(r) Py_DECREF(r)
  #define __Pyx_GOTREF(r)
  #define __Pyx_GIVEREF(r)
  #define __Pyx_XINCREF(r) Py_XINCREF(r)
  #define __Pyx_XDECREF(r) Py_XDECREF(r)
  #define __Pyx_XGOTREF(r)
  #define __Pyx_XGIVEREF(r)
#endif
#define __Pyx_XDECREF_SET(r, v) do {                            \
        PyObject *tmp = (PyObject *) r;                         \
        r = v; __Pyx_XDECREF(tmp);                              \
    } while (0)
#define __Pyx_DECREF_SET(r, v) do {                             \
        PyObject *tmp = (PyObject *) r;                         \
        r = v; __Pyx_DECREF(tmp);                               \
    } while (0)
#define __Pyx_CLEAR(r)    do { PyObject* tmp = ((PyObject*)(r)); r = NULL; __Pyx_DECREF(tmp);} while(0)
#define __Pyx_XCLEAR(r)   do { if((r) != NULL) {PyObject* tmp = ((PyObject*)(r)); r = NULL; __Pyx_DECREF(tmp);}} while(0)

#if CYTHON_COMPILING_IN_CPYTHON
static CYTHON_INLINE PyObject* __Pyx_PyObject_GetAttrStr(PyObject* obj, PyObject* attr_name) {
    PyTypeObject* tp = Py_TYPE(obj);
    if (likely(tp->tp_getattro))
        return tp->tp_getattro(obj, attr_name);
#if PY_MAJOR_VERSION < 3
    if (likely(tp->tp_getattr))
        return tp->tp_getattr(obj, PyString_AS_STRING(attr_name));
#endif
    return PyObject_GetAttr(obj, attr_name);
}
#else
#define __Pyx_PyObject_GetAttrStr(o,n) PyObject_GetAttr(o,n)
#endif

static PyObject *__Pyx_GetBuiltinName(PyObject *name);

static void __Pyx_RaiseDoubleKeywordsError(const char* func_name, PyObject* kw_name);

static int __Pyx_ParseOptionalKeywords(PyObject *kwds, PyObject **argnames[], \
    PyObject *kwds2, PyObject *values[], Py_ssize_t num_pos_args, \
    const char* function_name);

static void __Pyx_RaiseArgtupleInvalid(const char* func_name, int exact,
    Py_ssize_t num_min, Py_ssize_t num_max, Py_ssize_t num_found);

#if CYTHON_COMPILING_IN_CPYTHON
static CYTHON_INLINE PyObject* __Pyx_PyObject_Call(PyObject *func, PyObject *arg, PyObject *kw);
#else
#define __Pyx_PyObject_Call(func, arg, kw) PyObject_Call(func, arg, kw)
#endif

static CYTHON_INLINE void __Pyx_ErrRestore(PyObject *type, PyObject *value, PyObject *tb);
static CYTHON_INLINE void __Pyx_ErrFetch(PyObject **type, PyObject **value, PyObject **tb);

static void __Pyx_WriteUnraisable(const char *name, int clineno,
                                  int lineno, const char *filename,
                                  int full_traceback);

#if CYTHON_COMPILING_IN_CPYTHON
static CYTHON_INLINE PyObject* __Pyx_PyObject_CallMethO(PyObject *func, PyObject *arg);
#endif

static CYTHON_INLINE PyObject* __Pyx_PyObject_CallOneArg(PyObject *func, PyObject *arg);

#if CYTHON_COMPILING_IN_CPYTHON
static CYTHON_INLINE PyObject* __Pyx_PyObject_CallNoArg(PyObject *func);
#else
#define __Pyx_PyObject_CallNoArg(func) __Pyx_PyObject_Call(func, __pyx_empty_tuple, NULL)
#endif

static void __Pyx_call_next_tp_dealloc(PyObject* obj, destructor current_tp_dealloc);

static int __Pyx_call_next_tp_traverse(PyObject* obj, visitproc v, void *a, traverseproc current_tp_traverse);

static void __Pyx_call_next_tp_clear(PyObject* obj, inquiry current_tp_dealloc);

static void* __Pyx_GetVtable(PyObject *dict);

static int __Pyx_SetVtable(PyObject *dict, void *vtable);

typedef struct {
    int code_line;
    PyCodeObject* code_object;
} __Pyx_CodeObjectCacheEntry;
struct __Pyx_CodeObjectCache {
    int count;
    int max_count;
    __Pyx_CodeObjectCacheEntry* entries;
};
static struct __Pyx_CodeObjectCache __pyx_code_cache = {0,0,NULL};
static int __pyx_bisect_code_objects(__Pyx_CodeObjectCacheEntry* entries, int count, int code_line);
static PyCodeObject *__pyx_find_code_object(int code_line);
static void __pyx_insert_code_object(int code_line, PyCodeObject* code_object);

static void __Pyx_AddTraceback(const char *funcname, int c_line,
                               int py_line, const char *filename);

static CYTHON_INLINE PyObject* __Pyx_PyInt_From_long(long value);

static CYTHON_INLINE int __Pyx_PyInt_As_int(PyObject *);

static CYTHON_INLINE long __Pyx_PyInt_As_long(PyObject *);

static int __Pyx_check_binary_version(void);

#if !defined(__Pyx_PyIdentifier_FromString)
#if PY_MAJOR_VERSION < 3
  #define __Pyx_PyIdentifier_FromString(s) PyString_FromString(s)
#else
  #define __Pyx_PyIdentifier_FromString(s) PyUnicode_FromString(s)
#endif
#endif

static PyObject *__Pyx_ImportModule(const char *name);

static PyTypeObject *__Pyx_ImportType(const char *module_name, const char *class_name, size_t size, int strict);

static int __Pyx_ImportFunction(PyObject *module, const char *funcname, void (**f)(void), const char *sig);

static int __Pyx_InitStrings(__Pyx_StringTabEntry *t);

static double __pyx_f_8obitools_5align_9_assemble_14DirectAssemble_doAlignment(struct __pyx_obj_8obitools_5align_9_assemble_DirectAssemble *__pyx_v_self); /* proto*/
static void __pyx_f_8obitools_5align_9_assemble_14DirectAssemble_backtrack(struct __pyx_obj_8obitools_5align_9_assemble_DirectAssemble *__pyx_v_self); /* proto*/

/* Module declarations from 'obitools.align._dynamic' */
static PyTypeObject *__pyx_ptype_8obitools_5align_8_dynamic_DynamicProgramming = 0;
static struct __pyx_t_8obitools_5align_8_dynamic_alignSequence *(*__pyx_f_8obitools_5align_8_dynamic_allocateSequence)(PyObject *, struct __pyx_opt_args_8obitools_5align_8_dynamic_allocateSequence *__pyx_optional_args); /*proto*/
static struct __pyx_t_8obitools_5align_8_dynamic_alignPath *(*__pyx_f_8obitools_5align_8_dynamic_allocatePath)(long, long, struct __pyx_opt_args_8obitools_5align_8_dynamic_allocatePath *__pyx_optional_args); /*proto*/

/* Module declarations from 'obitools.align._nws' */
static PyTypeObject *__pyx_ptype_8obitools_5align_4_nws_NWS = 0;

/* Module declarations from 'obitools.align._assemble' */
static PyTypeObject *__pyx_ptype_8obitools_5align_9_assemble_DirectAssemble = 0;
static PyTypeObject *__pyx_ptype_8obitools_5align_9_assemble_ReverseAssemble = 0;
#define __Pyx_MODULE_NAME "obitools.align._assemble"
int __pyx_module_is_main_obitools__align___assemble = 0;

/* Implementation of 'obitools.align._assemble' */
static PyObject *__pyx_builtin_range;
static int __pyx_pf_8obitools_5align_9_assemble_14DirectAssemble___init__(struct __pyx_obj_8obitools_5align_9_assemble_DirectAssemble *__pyx_v_self, PyObject *__pyx_v_match, PyObject *__pyx_v_mismatch, PyObject *__pyx_v_opengap, PyObject *__pyx_v_extgap); /* proto */
static PyObject *__pyx_pf_8obitools_5align_9_assemble_15ReverseAssemble_4seqB___get__(struct __pyx_obj_8obitools_5align_9_assemble_ReverseAssemble *__pyx_v_self); /* proto */
static int __pyx_pf_8obitools_5align_9_assemble_15ReverseAssemble_4seqB_2__set__(struct __pyx_obj_8obitools_5align_9_assemble_ReverseAssemble *__pyx_v_self, PyObject *__pyx_v_seq); /* proto */
static PyObject *__pyx_tp_new_8obitools_5align_9_assemble_DirectAssemble(PyTypeObject *t, PyObject *a, PyObject *k); /*proto*/
static PyObject *__pyx_tp_new_8obitools_5align_9_assemble_ReverseAssemble(PyTypeObject *t, PyObject *a, PyObject *k); /*proto*/
static char __pyx_k_init[] = "__init__";
static char __pyx_k_main[] = "__main__";
static char __pyx_k_test[] = "__test__";
static char __pyx_k_match[] = "match";
static char __pyx_k_range[] = "range";
static char __pyx_k_extgap[] = "extgap";
static char __pyx_k_opengap[] = "opengap";
static char __pyx_k_wrapped[] = "wrapped";
static char __pyx_k_mismatch[] = "mismatch";
static char __pyx_k_complement[] = "complement";
static char __pyx_k_pyx_vtable[] = "__pyx_vtable__";
static char __pyx_k_needToCompute[] = "needToCompute";
static char __pyx_k_Created_on_6_Nov_2009_author_co[] = "\nCreated on 6 Nov. 2009\n\n@author: coissac\n";
static PyObject *__pyx_n_s_complement;
static PyObject *__pyx_n_s_extgap;
static PyObject *__pyx_n_s_init;
static PyObject *__pyx_n_s_main;
static PyObject *__pyx_n_s_match;
static PyObject *__pyx_n_s_mismatch;
static PyObject *__pyx_n_s_needToCompute;
static PyObject *__pyx_n_s_opengap;
static PyObject *__pyx_n_s_pyx_vtable;
static PyObject *__pyx_n_s_range;
static PyObject *__pyx_n_s_test;
static PyObject *__pyx_n_s_wrapped;
static PyObject *__pyx_int_4;
static PyObject *__pyx_int_neg_2;
static PyObject *__pyx_int_neg_6;
static PyObject *__pyx_int_neg_8;

/* "obitools/align/_assemble.pyx":13
 * cdef class DirectAssemble(NWS):
 * 
 *     def __init__(self,match=4,mismatch=-6,opengap=-8,extgap=-2):             # <<<<<<<<<<<<<<
 *         NWS.__init__(self,match,mismatch,opengap,extgap)
 *         self.ysmax=0
 */

/* Python wrapper */
static int __pyx_pw_8obitools_5align_9_assemble_14DirectAssemble_1__init__(PyObject *__pyx_v_self, PyObject *__pyx_args, PyObject *__pyx_kwds); /*proto*/
static int __pyx_pw_8obitools_5align_9_assemble_14DirectAssemble_1__init__(PyObject *__pyx_v_self, PyObject *__pyx_args, PyObject *__pyx_kwds) {
  PyObject *__pyx_v_match = 0;
  PyObject *__pyx_v_mismatch = 0;
  PyObject *__pyx_v_opengap = 0;
  PyObject *__pyx_v_extgap = 0;
  int __pyx_lineno = 0;
  const char *__pyx_filename = NULL;
  int __pyx_clineno = 0;
  int __pyx_r;
  __Pyx_RefNannyDeclarations
  __Pyx_RefNannySetupContext("__init__ (wrapper)", 0);
  {
    static PyObject **__pyx_pyargnames[] = {&__pyx_n_s_match,&__pyx_n_s_mismatch,&__pyx_n_s_opengap,&__pyx_n_s_extgap,0};
    PyObject* values[4] = {0,0,0,0};
    values[0] = ((PyObject *)__pyx_int_4);
    values[1] = ((PyObject *)__pyx_int_neg_6);
    values[2] = ((PyObject *)__pyx_int_neg_8);
    values[3] = ((PyObject *)__pyx_int_neg_2);
    if (unlikely(__pyx_kwds)) {
      Py_ssize_t kw_args;
      const Py_ssize_t pos_args = PyTuple_GET_SIZE(__pyx_args);
      switch (pos_args) {
        case  4: values[3] = PyTuple_GET_ITEM(__pyx_args, 3);
        case  3: values[2] = PyTuple_GET_ITEM(__pyx_args, 2);
        case  2: values[1] = PyTuple_GET_ITEM(__pyx_args, 1);
        case  1: values[0] = PyTuple_GET_ITEM(__pyx_args, 0);
        case  0: break;
        default: goto __pyx_L5_argtuple_error;
      }
      kw_args = PyDict_Size(__pyx_kwds);
      switch (pos_args) {
        case  0:
        if (kw_args > 0) {
          PyObject* value = PyDict_GetItem(__pyx_kwds, __pyx_n_s_match);
          if (value) { values[0] = value; kw_args--; }
        }
        case  1:
        if (kw_args > 0) {
          PyObject* value = PyDict_GetItem(__pyx_kwds, __pyx_n_s_mismatch);
          if (value) { values[1] = value; kw_args--; }
        }
        case  2:
        if (kw_args > 0) {
          PyObject* value = PyDict_GetItem(__pyx_kwds, __pyx_n_s_opengap);
          if (value) { values[2] = value; kw_args--; }
        }
        case  3:
        if (kw_args > 0) {
          PyObject* value = PyDict_GetItem(__pyx_kwds, __pyx_n_s_extgap);
          if (value) { values[3] = value; kw_args--; }
        }
      }
      if (unlikely(kw_args > 0)) {
        if (unlikely(__Pyx_ParseOptionalKeywords(__pyx_kwds, __pyx_pyargnames, 0, values, pos_args, "__init__") < 0)) {__pyx_filename = __pyx_f[0]; __pyx_lineno = 13; __pyx_clineno = __LINE__; goto __pyx_L3_error;}
      }
    } else {
      switch (PyTuple_GET_SIZE(__pyx_args)) {
        case  4: values[3] = PyTuple_GET_ITEM(__pyx_args, 3);
        case  3: values[2] = PyTuple_GET_ITEM(__pyx_args, 2);
        case  2: values[1] = PyTuple_GET_ITEM(__pyx_args, 1);
        case  1: values[0] = PyTuple_GET_ITEM(__pyx_args, 0);
        case  0: break;
        default: goto __pyx_L5_argtuple_error;
      }
    }
    __pyx_v_match = values[0];
    __pyx_v_mismatch = values[1];
    __pyx_v_opengap = values[2];
    __pyx_v_extgap = values[3];
  }
  goto __pyx_L4_argument_unpacking_done;
  __pyx_L5_argtuple_error:;
  __Pyx_RaiseArgtupleInvalid("__init__", 0, 0, 4, PyTuple_GET_SIZE(__pyx_args)); {__pyx_filename = __pyx_f[0]; __pyx_lineno = 13; __pyx_clineno = __LINE__; goto __pyx_L3_error;}
  __pyx_L3_error:;
  __Pyx_AddTraceback("obitools.align._assemble.DirectAssemble.__init__", __pyx_clineno, __pyx_lineno, __pyx_filename);
  __Pyx_RefNannyFinishContext();
  return -1;
  __pyx_L4_argument_unpacking_done:;
  __pyx_r = __pyx_pf_8obitools_5align_9_assemble_14DirectAssemble___init__(((struct __pyx_obj_8obitools_5align_9_assemble_DirectAssemble *)__pyx_v_self), __pyx_v_match, __pyx_v_mismatch, __pyx_v_opengap, __pyx_v_extgap);

  /* function exit code */
  __Pyx_RefNannyFinishContext();
  return __pyx_r;
}

static int __pyx_pf_8obitools_5align_9_assemble_14DirectAssemble___init__(struct __pyx_obj_8obitools_5align_9_assemble_DirectAssemble *__pyx_v_self, PyObject *__pyx_v_match, PyObject *__pyx_v_mismatch, PyObject *__pyx_v_opengap, PyObject *__pyx_v_extgap) {
  int __pyx_r;
  __Pyx_RefNannyDeclarations
  PyObject *__pyx_t_1 = NULL;
  PyObject *__pyx_t_2 = NULL;
  PyObject *__pyx_t_3 = NULL;
  Py_ssize_t __pyx_t_4;
  PyObject *__pyx_t_5 = NULL;
  int __pyx_lineno = 0;
  const char *__pyx_filename = NULL;
  int __pyx_clineno = 0;
  __Pyx_RefNannySetupContext("__init__", 0);

  /* "obitools/align/_assemble.pyx":14
 * 
 *     def __init__(self,match=4,mismatch=-6,opengap=-8,extgap=-2):
 *         NWS.__init__(self,match,mismatch,opengap,extgap)             # <<<<<<<<<<<<<<
 *         self.ysmax=0
 *         self.ymax=0
 */
  __pyx_t_2 = __Pyx_PyObject_GetAttrStr(((PyObject *)((PyObject*)__pyx_ptype_8obitools_5align_4_nws_NWS)), __pyx_n_s_init); if (unlikely(!__pyx_t_2)) {__pyx_filename = __pyx_f[0]; __pyx_lineno = 14; __pyx_clineno = __LINE__; goto __pyx_L1_error;}
  __Pyx_GOTREF(__pyx_t_2);
  __pyx_t_3 = NULL;
  __pyx_t_4 = 0;
  if (CYTHON_COMPILING_IN_CPYTHON && likely(PyMethod_Check(__pyx_t_2))) {
    __pyx_t_3 = PyMethod_GET_SELF(__pyx_t_2);
    if (likely(__pyx_t_3)) {
      PyObject* function = PyMethod_GET_FUNCTION(__pyx_t_2);
      __Pyx_INCREF(__pyx_t_3);
      __Pyx_INCREF(function);
      __Pyx_DECREF_SET(__pyx_t_2, function);
      __pyx_t_4 = 1;
    }
  }
  __pyx_t_5 = PyTuple_New(5+__pyx_t_4); if (unlikely(!__pyx_t_5)) {__pyx_filename = __pyx_f[0]; __pyx_lineno = 14; __pyx_clineno = __LINE__; goto __pyx_L1_error;}
  __Pyx_GOTREF(__pyx_t_5);
  if (__pyx_t_3) {
    PyTuple_SET_ITEM(__pyx_t_5, 0, __pyx_t_3); __Pyx_GIVEREF(__pyx_t_3); __pyx_t_3 = NULL;
  }
  __Pyx_INCREF(((PyObject *)__pyx_v_self));
  PyTuple_SET_ITEM(__pyx_t_5, 0+__pyx_t_4, ((PyObject *)__pyx_v_self));
  __Pyx_GIVEREF(((PyObject *)__pyx_v_self));
  __Pyx_INCREF(__pyx_v_match);
  PyTuple_SET_ITEM(__pyx_t_5, 1+__pyx_t_4, __pyx_v_match);
  __Pyx_GIVEREF(__pyx_v_match);
  __Pyx_INCREF(__pyx_v_mismatch);
  PyTuple_SET_ITEM(__pyx_t_5, 2+__pyx_t_4, __pyx_v_mismatch);
  __Pyx_GIVEREF(__pyx_v_mismatch);
  __Pyx_INCREF(__pyx_v_opengap);
  PyTuple_SET_ITEM(__pyx_t_5, 3+__pyx_t_4, __pyx_v_opengap);
  __Pyx_GIVEREF(__pyx_v_opengap);
  __Pyx_INCREF(__pyx_v_extgap);
  PyTuple_SET_ITEM(__pyx_t_5, 4+__pyx_t_4, __pyx_v_extgap);
  __Pyx_GIVEREF(__pyx_v_extgap);
  __pyx_t_1 = __Pyx_PyObject_Call(__pyx_t_2, __pyx_t_5, NULL); if (unlikely(!__pyx_t_1)) {__pyx_filename = __pyx_f[0]; __pyx_lineno = 14; __pyx_clineno = __LINE__; goto __pyx_L1_error;}
  __Pyx_GOTREF(__pyx_t_1);
  __Pyx_DECREF(__pyx_t_5); __pyx_t_5 = 0;
  __Pyx_DECREF(__pyx_t_2); __pyx_t_2 = 0;
  __Pyx_DECREF(__pyx_t_1); __pyx_t_1 = 0;

  /* "obitools/align/_assemble.pyx":15
 *     def __init__(self,match=4,mismatch=-6,opengap=-8,extgap=-2):
 *         NWS.__init__(self,match,mismatch,opengap,extgap)
 *         self.ysmax=0             # <<<<<<<<<<<<<<
 *         self.ymax=0
 * 
 */
  __pyx_v_self->ysmax = 0.0;

  /* "obitools/align/_assemble.pyx":16
 *         NWS.__init__(self,match,mismatch,opengap,extgap)
 *         self.ysmax=0
 *         self.ymax=0             # <<<<<<<<<<<<<<
 * 
 *     cdef double doAlignment(self) except? 0:
 */
  __pyx_v_self->ymax = 0;

  /* "obitools/align/_assemble.pyx":13
 * cdef class DirectAssemble(NWS):
 * 
 *     def __init__(self,match=4,mismatch=-6,opengap=-8,extgap=-2):             # <<<<<<<<<<<<<<
 *         NWS.__init__(self,match,mismatch,opengap,extgap)
 *         self.ysmax=0
 */

  /* function exit code */
  __pyx_r = 0;
  goto __pyx_L0;
  __pyx_L1_error:;
  __Pyx_XDECREF(__pyx_t_1);
  __Pyx_XDECREF(__pyx_t_2);
  __Pyx_XDECREF(__pyx_t_3);
  __Pyx_XDECREF(__pyx_t_5);
  __Pyx_AddTraceback("obitools.align._assemble.DirectAssemble.__init__", __pyx_clineno, __pyx_lineno, __pyx_filename);
  __pyx_r = -1;
  __pyx_L0:;
  __Pyx_RefNannyFinishContext();
  return __pyx_r;
}

/* "obitools/align/_assemble.pyx":18
 *         self.ymax=0
 * 
 *     cdef double doAlignment(self) except? 0:             # <<<<<<<<<<<<<<
 *         cdef int i  # vertical index
 *         cdef int j  # horizontal index
 */

static double __pyx_f_8obitools_5align_9_assemble_14DirectAssemble_doAlignment(struct __pyx_obj_8obitools_5align_9_assemble_DirectAssemble *__pyx_v_self) {
  int __pyx_v_i;
  int __pyx_v_j;
  int __pyx_v_idx;
  int __pyx_v_idx0;
  int __pyx_v_idx1;
  int __pyx_v_jump;
  int __pyx_v_delta;
  double __pyx_v_score;
  double __pyx_v_scoremax;
  int __pyx_v_path;
  double __pyx_r;
  __Pyx_RefNannyDeclarations
  PyObject *__pyx_t_1 = NULL;
  int __pyx_t_2;
  int __pyx_t_3;
  long __pyx_t_4;
  long __pyx_t_5;
  int __pyx_t_6;
  int __pyx_t_7;
  int __pyx_lineno = 0;
  const char *__pyx_filename = NULL;
  int __pyx_clineno = 0;
  __Pyx_RefNannySetupContext("doAlignment", 0);

  /* "obitools/align/_assemble.pyx":31
 * 
 * 
 *         if self.needToCompute:             # <<<<<<<<<<<<<<
 *             self.allocate()
 *             self.reset()
 */
  __pyx_t_1 = __Pyx_PyObject_GetAttrStr(((PyObject *)__pyx_v_self), __pyx_n_s_needToCompute); if (unlikely(!__pyx_t_1)) {__pyx_filename = __pyx_f[0]; __pyx_lineno = 31; __pyx_clineno = __LINE__; goto __pyx_L1_error;}
  __Pyx_GOTREF(__pyx_t_1);
  __pyx_t_2 = __Pyx_PyObject_IsTrue(__pyx_t_1); if (unlikely(__pyx_t_2 < 0)) {__pyx_filename = __pyx_f[0]; __pyx_lineno = 31; __pyx_clineno = __LINE__; goto __pyx_L1_error;}
  __Pyx_DECREF(__pyx_t_1); __pyx_t_1 = 0;
  if (__pyx_t_2) {

    /* "obitools/align/_assemble.pyx":32
 * 
 *         if self.needToCompute:
 *             self.allocate()             # <<<<<<<<<<<<<<
 *             self.reset()
 *             self.ysmax=0
 */
    __pyx_t_3 = ((struct __pyx_vtabstruct_8obitools_5align_9_assemble_DirectAssemble *)__pyx_v_self->__pyx_base.__pyx_base.__pyx_vtab)->__pyx_base.__pyx_base.allocate(((struct __pyx_obj_8obitools_5align_8_dynamic_DynamicProgramming *)__pyx_v_self)); if (unlikely(__pyx_t_3 == -1)) {__pyx_filename = __pyx_f[0]; __pyx_lineno = 32; __pyx_clineno = __LINE__; goto __pyx_L1_error;}

    /* "obitools/align/_assemble.pyx":33
 *         if self.needToCompute:
 *             self.allocate()
 *             self.reset()             # <<<<<<<<<<<<<<
 *             self.ysmax=0
 *             self.ymax=0
 */
    ((struct __pyx_vtabstruct_8obitools_5align_9_assemble_DirectAssemble *)__pyx_v_self->__pyx_base.__pyx_base.__pyx_vtab)->__pyx_base.__pyx_base.reset(((struct __pyx_obj_8obitools_5align_8_dynamic_DynamicProgramming *)__pyx_v_self));

    /* "obitools/align/_assemble.pyx":34
 *             self.allocate()
 *             self.reset()
 *             self.ysmax=0             # <<<<<<<<<<<<<<
 *             self.ymax=0
 * 
 */
    __pyx_v_self->ysmax = 0.0;

    /* "obitools/align/_assemble.pyx":35
 *             self.reset()
 *             self.ysmax=0
 *             self.ymax=0             # <<<<<<<<<<<<<<
 * 
 *             for j in range(1,self.hSeq.length+1):
 */
    __pyx_v_self->ymax = 0;

    /* "obitools/align/_assemble.pyx":37
 *             self.ymax=0
 * 
 *             for j in range(1,self.hSeq.length+1):             # <<<<<<<<<<<<<<
 *                 idx = self.index(j,0)
 *                 self.matrix.matrix[idx].score = 0
 */
    __pyx_t_4 = (__pyx_v_self->__pyx_base.__pyx_base.hSeq->length + 1);
    for (__pyx_t_3 = 1; __pyx_t_3 < __pyx_t_4; __pyx_t_3+=1) {
      __pyx_v_j = __pyx_t_3;

      /* "obitools/align/_assemble.pyx":38
 * 
 *             for j in range(1,self.hSeq.length+1):
 *                 idx = self.index(j,0)             # <<<<<<<<<<<<<<
 *                 self.matrix.matrix[idx].score = 0
 *                 self.matrix.matrix[idx].path  = j
 */
      __pyx_v_idx = ((struct __pyx_vtabstruct_8obitools_5align_9_assemble_DirectAssemble *)__pyx_v_self->__pyx_base.__pyx_base.__pyx_vtab)->__pyx_base.__pyx_base.index(((struct __pyx_obj_8obitools_5align_8_dynamic_DynamicProgramming *)__pyx_v_self), __pyx_v_j, 0);

      /* "obitools/align/_assemble.pyx":39
 *             for j in range(1,self.hSeq.length+1):
 *                 idx = self.index(j,0)
 *                 self.matrix.matrix[idx].score = 0             # <<<<<<<<<<<<<<
 *                 self.matrix.matrix[idx].path  = j
 * 
 */
      (__pyx_v_self->__pyx_base.__pyx_base.matrix->matrix[__pyx_v_idx]).score = 0.0;

      /* "obitools/align/_assemble.pyx":40
 *                 idx = self.index(j,0)
 *                 self.matrix.matrix[idx].score = 0
 *                 self.matrix.matrix[idx].path  = j             # <<<<<<<<<<<<<<
 * 
 *             for i in range(1,self.vSeq.length+1):
 */
      (__pyx_v_self->__pyx_base.__pyx_base.matrix->matrix[__pyx_v_idx]).path = __pyx_v_j;
    }

    /* "obitools/align/_assemble.pyx":42
 *                 self.matrix.matrix[idx].path  = j
 * 
 *             for i in range(1,self.vSeq.length+1):             # <<<<<<<<<<<<<<
 *                 idx = self.index(0,i)
 *                 self.matrix.matrix[idx].score = self._opengap + (self._extgap * (i-1))
 */
    __pyx_t_4 = (__pyx_v_self->__pyx_base.__pyx_base.vSeq->length + 1);
    for (__pyx_t_3 = 1; __pyx_t_3 < __pyx_t_4; __pyx_t_3+=1) {
      __pyx_v_i = __pyx_t_3;

      /* "obitools/align/_assemble.pyx":43
 * 
 *             for i in range(1,self.vSeq.length+1):
 *                 idx = self.index(0,i)             # <<<<<<<<<<<<<<
 *                 self.matrix.matrix[idx].score = self._opengap + (self._extgap * (i-1))
 *                 self.matrix.matrix[idx].path  = -i
 */
      __pyx_v_idx = ((struct __pyx_vtabstruct_8obitools_5align_9_assemble_DirectAssemble *)__pyx_v_self->__pyx_base.__pyx_base.__pyx_vtab)->__pyx_base.__pyx_base.index(((struct __pyx_obj_8obitools_5align_8_dynamic_DynamicProgramming *)__pyx_v_self), 0, __pyx_v_i);

      /* "obitools/align/_assemble.pyx":44
 *             for i in range(1,self.vSeq.length+1):
 *                 idx = self.index(0,i)
 *                 self.matrix.matrix[idx].score = self._opengap + (self._extgap * (i-1))             # <<<<<<<<<<<<<<
 *                 self.matrix.matrix[idx].path  = -i
 * 
 */
      (__pyx_v_self->__pyx_base.__pyx_base.matrix->matrix[__pyx_v_idx]).score = (__pyx_v_self->__pyx_base.__pyx_base._opengap + (__pyx_v_self->__pyx_base.__pyx_base._extgap * (__pyx_v_i - 1)));

      /* "obitools/align/_assemble.pyx":45
 *                 idx = self.index(0,i)
 *                 self.matrix.matrix[idx].score = self._opengap + (self._extgap * (i-1))
 *                 self.matrix.matrix[idx].path  = -i             # <<<<<<<<<<<<<<
 * 
 *             idx0=self.index(-1,0)
 */
      (__pyx_v_self->__pyx_base.__pyx_base.matrix->matrix[__pyx_v_idx]).path = (-__pyx_v_i);
    }

    /* "obitools/align/_assemble.pyx":47
 *                 self.matrix.matrix[idx].path  = -i
 * 
 *             idx0=self.index(-1,0)             # <<<<<<<<<<<<<<
 *             idx1=self.index(0,1)
 *             for i in range(1,self.vSeq.length+1):
 */
    __pyx_v_idx0 = ((struct __pyx_vtabstruct_8obitools_5align_9_assemble_DirectAssemble *)__pyx_v_self->__pyx_base.__pyx_base.__pyx_vtab)->__pyx_base.__pyx_base.index(((struct __pyx_obj_8obitools_5align_8_dynamic_DynamicProgramming *)__pyx_v_self), -1, 0);

    /* "obitools/align/_assemble.pyx":48
 * 
 *             idx0=self.index(-1,0)
 *             idx1=self.index(0,1)             # <<<<<<<<<<<<<<
 *             for i in range(1,self.vSeq.length+1):
 *                 idx0+=1
 */
    __pyx_v_idx1 = ((struct __pyx_vtabstruct_8obitools_5align_9_assemble_DirectAssemble *)__pyx_v_self->__pyx_base.__pyx_base.__pyx_vtab)->__pyx_base.__pyx_base.index(((struct __pyx_obj_8obitools_5align_8_dynamic_DynamicProgramming *)__pyx_v_self), 0, 1);

    /* "obitools/align/_assemble.pyx":49
 *             idx0=self.index(-1,0)
 *             idx1=self.index(0,1)
 *             for i in range(1,self.vSeq.length+1):             # <<<<<<<<<<<<<<
 *                 idx0+=1
 *                 idx1+=1
 */
    __pyx_t_4 = (__pyx_v_self->__pyx_base.__pyx_base.vSeq->length + 1);
    for (__pyx_t_3 = 1; __pyx_t_3 < __pyx_t_4; __pyx_t_3+=1) {
      __pyx_v_i = __pyx_t_3;

      /* "obitools/align/_assemble.pyx":50
 *             idx1=self.index(0,1)
 *             for i in range(1,self.vSeq.length+1):
 *                 idx0+=1             # <<<<<<<<<<<<<<
 *                 idx1+=1
 *                 for j in range(1,self.hSeq.length+1):
 */
      __pyx_v_idx0 = (__pyx_v_idx0 + 1);

      /* "obitools/align/_assemble.pyx":51
 *             for i in range(1,self.vSeq.length+1):
 *                 idx0+=1
 *                 idx1+=1             # <<<<<<<<<<<<<<
 *                 for j in range(1,self.hSeq.length+1):
 * 
 */
      __pyx_v_idx1 = (__pyx_v_idx1 + 1);

      /* "obitools/align/_assemble.pyx":52
 *                 idx0+=1
 *                 idx1+=1
 *                 for j in range(1,self.hSeq.length+1):             # <<<<<<<<<<<<<<
 * 
 *                     # 1 - came from diagonal
 */
      __pyx_t_5 = (__pyx_v_self->__pyx_base.__pyx_base.hSeq->length + 1);
      for (__pyx_t_6 = 1; __pyx_t_6 < __pyx_t_5; __pyx_t_6+=1) {
        __pyx_v_j = __pyx_t_6;

        /* "obitools/align/_assemble.pyx":56
 *                     # 1 - came from diagonal
 *                     #idx = self.index(j-1,i-1)
 *                     idx = idx0             # <<<<<<<<<<<<<<
 *                     # print "computing cell : %d,%d --> %d/%d" % (j,i,self.index(j,i),self.matrix.msize),
 *                     scoremax = self.matrix.matrix[idx].score + \
 */
        __pyx_v_idx = __pyx_v_idx0;

        /* "obitools/align/_assemble.pyx":58
 *                     idx = idx0
 *                     # print "computing cell : %d,%d --> %d/%d" % (j,i,self.index(j,i),self.matrix.msize),
 *                     scoremax = self.matrix.matrix[idx].score + \             # <<<<<<<<<<<<<<
 *                                self.matchScore(j,i)
 *                     path = 0
 */
        __pyx_v_scoremax = ((__pyx_v_self->__pyx_base.__pyx_base.matrix->matrix[__pyx_v_idx]).score + ((struct __pyx_vtabstruct_8obitools_5align_9_assemble_DirectAssemble *)__pyx_v_self->__pyx_base.__pyx_base.__pyx_vtab)->__pyx_base.matchScore(((struct __pyx_obj_8obitools_5align_4_nws_NWS *)__pyx_v_self), __pyx_v_j, __pyx_v_i));

        /* "obitools/align/_assemble.pyx":60
 *                     scoremax = self.matrix.matrix[idx].score + \
 *                                self.matchScore(j,i)
 *                     path = 0             # <<<<<<<<<<<<<<
 * 
 *                     # print "so=%f sd=%f sm=%f" % (self.matrix.matrix[idx].score,self.matchScore(j,i),scoremax),
 */
        __pyx_v_path = 0;

        /* "obitools/align/_assemble.pyx":66
 *                     # 2 - open horizontal gap
 *                     # idx = self.index(j-1,i)
 *                     idx = idx1 - 1             # <<<<<<<<<<<<<<
 *                     score = self.matrix.matrix[idx].score+ \
 *                             self._opengap
 */
        __pyx_v_idx = (__pyx_v_idx1 - 1);

        /* "obitools/align/_assemble.pyx":67
 *                     # idx = self.index(j-1,i)
 *                     idx = idx1 - 1
 *                     score = self.matrix.matrix[idx].score+ \             # <<<<<<<<<<<<<<
 *                             self._opengap
 *                     if score > scoremax :
 */
        __pyx_v_score = ((__pyx_v_self->__pyx_base.__pyx_base.matrix->matrix[__pyx_v_idx]).score + __pyx_v_self->__pyx_base.__pyx_base._opengap);

        /* "obitools/align/_assemble.pyx":69
 *                     score = self.matrix.matrix[idx].score+ \
 *                             self._opengap
 *                     if score > scoremax :             # <<<<<<<<<<<<<<
 *                         scoremax = score
 *                         path = +1
 */
        __pyx_t_2 = ((__pyx_v_score > __pyx_v_scoremax) != 0);
        if (__pyx_t_2) {

          /* "obitools/align/_assemble.pyx":70
 *                             self._opengap
 *                     if score > scoremax :
 *                         scoremax = score             # <<<<<<<<<<<<<<
 *                         path = +1
 * 
 */
          __pyx_v_scoremax = __pyx_v_score;

          /* "obitools/align/_assemble.pyx":71
 *                     if score > scoremax :
 *                         scoremax = score
 *                         path = +1             # <<<<<<<<<<<<<<
 * 
 *                     # 3 - open vertical gap
 */
          __pyx_v_path = 1;
          goto __pyx_L12;
        }
        __pyx_L12:;

        /* "obitools/align/_assemble.pyx":75
 *                     # 3 - open vertical gap
 *                     # idx = self.index(j,i-1)
 *                     idx = idx0 + 1             # <<<<<<<<<<<<<<
 *                     score = self.matrix.matrix[idx].score + \
 *                             self._opengap
 */
        __pyx_v_idx = (__pyx_v_idx0 + 1);

        /* "obitools/align/_assemble.pyx":76
 *                     # idx = self.index(j,i-1)
 *                     idx = idx0 + 1
 *                     score = self.matrix.matrix[idx].score + \             # <<<<<<<<<<<<<<
 *                             self._opengap
 *                     if score > scoremax :
 */
        __pyx_v_score = ((__pyx_v_self->__pyx_base.__pyx_base.matrix->matrix[__pyx_v_idx]).score + __pyx_v_self->__pyx_base.__pyx_base._opengap);

        /* "obitools/align/_assemble.pyx":78
 *                     score = self.matrix.matrix[idx].score + \
 *                             self._opengap
 *                     if score > scoremax :             # <<<<<<<<<<<<<<
 *                         scoremax = score
 *                         path = -1
 */
        __pyx_t_2 = ((__pyx_v_score > __pyx_v_scoremax) != 0);
        if (__pyx_t_2) {

          /* "obitools/align/_assemble.pyx":79
 *                             self._opengap
 *                     if score > scoremax :
 *                         scoremax = score             # <<<<<<<<<<<<<<
 *                         path = -1
 * 
 */
          __pyx_v_scoremax = __pyx_v_score;

          /* "obitools/align/_assemble.pyx":80
 *                     if score > scoremax :
 *                         scoremax = score
 *                         path = -1             # <<<<<<<<<<<<<<
 * 
 *                     # 4 - extend horizontal gap
 */
          __pyx_v_path = -1;
          goto __pyx_L13;
        }
        __pyx_L13:;

        /* "obitools/align/_assemble.pyx":83
 * 
 *                     # 4 - extend horizontal gap
 *                     jump = self.matrix.bestHJump[i]             # <<<<<<<<<<<<<<
 *                     if jump >= 0:
 *                         idx = self.index(jump,i)
 */
        __pyx_v_jump = (__pyx_v_self->__pyx_base.__pyx_base.matrix->bestHJump[__pyx_v_i]);

        /* "obitools/align/_assemble.pyx":84
 *                     # 4 - extend horizontal gap
 *                     jump = self.matrix.bestHJump[i]
 *                     if jump >= 0:             # <<<<<<<<<<<<<<
 *                         idx = self.index(jump,i)
 *                         delta = j-jump
 */
        __pyx_t_2 = ((__pyx_v_jump >= 0) != 0);
        if (__pyx_t_2) {

          /* "obitools/align/_assemble.pyx":85
 *                     jump = self.matrix.bestHJump[i]
 *                     if jump >= 0:
 *                         idx = self.index(jump,i)             # <<<<<<<<<<<<<<
 *                         delta = j-jump
 *                         score = self.matrix.matrix[idx].score + \
 */
          __pyx_v_idx = ((struct __pyx_vtabstruct_8obitools_5align_9_assemble_DirectAssemble *)__pyx_v_self->__pyx_base.__pyx_base.__pyx_vtab)->__pyx_base.__pyx_base.index(((struct __pyx_obj_8obitools_5align_8_dynamic_DynamicProgramming *)__pyx_v_self), __pyx_v_jump, __pyx_v_i);

          /* "obitools/align/_assemble.pyx":86
 *                     if jump >= 0:
 *                         idx = self.index(jump,i)
 *                         delta = j-jump             # <<<<<<<<<<<<<<
 *                         score = self.matrix.matrix[idx].score + \
 *                                 self._extgap * delta
 */
          __pyx_v_delta = (__pyx_v_j - __pyx_v_jump);

          /* "obitools/align/_assemble.pyx":87
 *                         idx = self.index(jump,i)
 *                         delta = j-jump
 *                         score = self.matrix.matrix[idx].score + \             # <<<<<<<<<<<<<<
 *                                 self._extgap * delta
 *                         if score > scoremax :
 */
          __pyx_v_score = ((__pyx_v_self->__pyx_base.__pyx_base.matrix->matrix[__pyx_v_idx]).score + (__pyx_v_self->__pyx_base.__pyx_base._extgap * __pyx_v_delta));

          /* "obitools/align/_assemble.pyx":89
 *                         score = self.matrix.matrix[idx].score + \
 *                                 self._extgap * delta
 *                         if score > scoremax :             # <<<<<<<<<<<<<<
 *                             scoremax = score
 *                             path = delta+1
 */
          __pyx_t_2 = ((__pyx_v_score > __pyx_v_scoremax) != 0);
          if (__pyx_t_2) {

            /* "obitools/align/_assemble.pyx":90
 *                                 self._extgap * delta
 *                         if score > scoremax :
 *                             scoremax = score             # <<<<<<<<<<<<<<
 *                             path = delta+1
 * 
 */
            __pyx_v_scoremax = __pyx_v_score;

            /* "obitools/align/_assemble.pyx":91
 *                         if score > scoremax :
 *                             scoremax = score
 *                             path = delta+1             # <<<<<<<<<<<<<<
 * 
 *                     # 5 - extend vertical gap
 */
            __pyx_v_path = (__pyx_v_delta + 1);
            goto __pyx_L15;
          }
          __pyx_L15:;
          goto __pyx_L14;
        }
        __pyx_L14:;

        /* "obitools/align/_assemble.pyx":94
 * 
 *                     # 5 - extend vertical gap
 *                     jump = self.matrix.bestVJump[j]             # <<<<<<<<<<<<<<
 *                     if jump >= 0:
 *                         idx = self.index(j,jump)
 */
        __pyx_v_jump = (__pyx_v_self->__pyx_base.__pyx_base.matrix->bestVJump[__pyx_v_j]);

        /* "obitools/align/_assemble.pyx":95
 *                     # 5 - extend vertical gap
 *                     jump = self.matrix.bestVJump[j]
 *                     if jump >= 0:             # <<<<<<<<<<<<<<
 *                         idx = self.index(j,jump)
 *                         delta = i-jump
 */
        __pyx_t_2 = ((__pyx_v_jump >= 0) != 0);
        if (__pyx_t_2) {

          /* "obitools/align/_assemble.pyx":96
 *                     jump = self.matrix.bestVJump[j]
 *                     if jump >= 0:
 *                         idx = self.index(j,jump)             # <<<<<<<<<<<<<<
 *                         delta = i-jump
 *                         score = self.matrix.matrix[idx].score + \
 */
          __pyx_v_idx = ((struct __pyx_vtabstruct_8obitools_5align_9_assemble_DirectAssemble *)__pyx_v_self->__pyx_base.__pyx_base.__pyx_vtab)->__pyx_base.__pyx_base.index(((struct __pyx_obj_8obitools_5align_8_dynamic_DynamicProgramming *)__pyx_v_self), __pyx_v_j, __pyx_v_jump);

          /* "obitools/align/_assemble.pyx":97
 *                     if jump >= 0:
 *                         idx = self.index(j,jump)
 *                         delta = i-jump             # <<<<<<<<<<<<<<
 *                         score = self.matrix.matrix[idx].score + \
 *                                 self._extgap * delta
 */
          __pyx_v_delta = (__pyx_v_i - __pyx_v_jump);

          /* "obitools/align/_assemble.pyx":98
 *                         idx = self.index(j,jump)
 *                         delta = i-jump
 *                         score = self.matrix.matrix[idx].score + \             # <<<<<<<<<<<<<<
 *                                 self._extgap * delta
 *                         if score > scoremax :
 */
          __pyx_v_score = ((__pyx_v_self->__pyx_base.__pyx_base.matrix->matrix[__pyx_v_idx]).score + (__pyx_v_self->__pyx_base.__pyx_base._extgap * __pyx_v_delta));

          /* "obitools/align/_assemble.pyx":100
 *                         score = self.matrix.matrix[idx].score + \
 *                                 self._extgap * delta
 *                         if score > scoremax :             # <<<<<<<<<<<<<<
 *                             scoremax = score
 *                             path = -delta-1
 */
          __pyx_t_2 = ((__pyx_v_score > __pyx_v_scoremax) != 0);
          if (__pyx_t_2) {

            /* "obitools/align/_assemble.pyx":101
 *                                 self._extgap * delta
 *                         if score > scoremax :
 *                             scoremax = score             # <<<<<<<<<<<<<<
 *                             path = -delta-1
 * 
 */
            __pyx_v_scoremax = __pyx_v_score;

            /* "obitools/align/_assemble.pyx":102
 *                         if score > scoremax :
 *                             scoremax = score
 *                             path = -delta-1             # <<<<<<<<<<<<<<
 * 
 *                     # idx = self.index(j,i)
 */
            __pyx_v_path = ((-__pyx_v_delta) - 1);
            goto __pyx_L17;
          }
          __pyx_L17:;
          goto __pyx_L16;
        }
        __pyx_L16:;

        /* "obitools/align/_assemble.pyx":105
 * 
 *                     # idx = self.index(j,i)
 *                     idx = idx1             # <<<<<<<<<<<<<<
 *                     self.matrix.matrix[idx].score = scoremax
 *                     self.matrix.matrix[idx].path  = path
 */
        __pyx_v_idx = __pyx_v_idx1;

        /* "obitools/align/_assemble.pyx":106
 *                     # idx = self.index(j,i)
 *                     idx = idx1
 *                     self.matrix.matrix[idx].score = scoremax             # <<<<<<<<<<<<<<
 *                     self.matrix.matrix[idx].path  = path
 * 
 */
        (__pyx_v_self->__pyx_base.__pyx_base.matrix->matrix[__pyx_v_idx]).score = __pyx_v_scoremax;

        /* "obitools/align/_assemble.pyx":107
 *                     idx = idx1
 *                     self.matrix.matrix[idx].score = scoremax
 *                     self.matrix.matrix[idx].path  = path             # <<<<<<<<<<<<<<
 * 
 *                     if path == -1:
 */
        (__pyx_v_self->__pyx_base.__pyx_base.matrix->matrix[__pyx_v_idx]).path = __pyx_v_path;

        /* "obitools/align/_assemble.pyx":111
 *                     if path == -1:
 *                         self.matrix.bestVJump[j]=i
 *                     elif path == +1 :             # <<<<<<<<<<<<<<
 *                         self.matrix.bestHJump[i]=j
 * 
 */
        switch (__pyx_v_path) {

          /* "obitools/align/_assemble.pyx":109
 *                     self.matrix.matrix[idx].path  = path
 * 
 *                     if path == -1:             # <<<<<<<<<<<<<<
 *                         self.matrix.bestVJump[j]=i
 *                     elif path == +1 :
 */
          case -1:

          /* "obitools/align/_assemble.pyx":110
 * 
 *                     if path == -1:
 *                         self.matrix.bestVJump[j]=i             # <<<<<<<<<<<<<<
 *                     elif path == +1 :
 *                         self.matrix.bestHJump[i]=j
 */
          (__pyx_v_self->__pyx_base.__pyx_base.matrix->bestVJump[__pyx_v_j]) = __pyx_v_i;
          break;

          /* "obitools/align/_assemble.pyx":111
 *                     if path == -1:
 *                         self.matrix.bestVJump[j]=i
 *                     elif path == +1 :             # <<<<<<<<<<<<<<
 *                         self.matrix.bestHJump[i]=j
 * 
 */
          case 1:

          /* "obitools/align/_assemble.pyx":112
 *                         self.matrix.bestVJump[j]=i
 *                     elif path == +1 :
 *                         self.matrix.bestHJump[i]=j             # <<<<<<<<<<<<<<
 * 
 *                     if j==self.hSeq.length and scoremax > self.ysmax:
 */
          (__pyx_v_self->__pyx_base.__pyx_base.matrix->bestHJump[__pyx_v_i]) = __pyx_v_j;
          break;
          default: break;
        }

        /* "obitools/align/_assemble.pyx":114
 *                         self.matrix.bestHJump[i]=j
 * 
 *                     if j==self.hSeq.length and scoremax > self.ysmax:             # <<<<<<<<<<<<<<
 *                         self.ysmax=scoremax
 *                         self.ymax=i
 */
        __pyx_t_7 = ((__pyx_v_j == __pyx_v_self->__pyx_base.__pyx_base.hSeq->length) != 0);
        if (__pyx_t_7) {
          goto __pyx_L20_next_and;
        } else {
          __pyx_t_2 = __pyx_t_7;
          goto __pyx_L19_bool_binop_done;
        }
        __pyx_L20_next_and:;
        __pyx_t_7 = ((__pyx_v_scoremax > __pyx_v_self->ysmax) != 0);
        __pyx_t_2 = __pyx_t_7;
        __pyx_L19_bool_binop_done:;
        if (__pyx_t_2) {

          /* "obitools/align/_assemble.pyx":115
 * 
 *                     if j==self.hSeq.length and scoremax > self.ysmax:
 *                         self.ysmax=scoremax             # <<<<<<<<<<<<<<
 *                         self.ymax=i
 *                     idx0+=1
 */
          __pyx_v_self->ysmax = __pyx_v_scoremax;

          /* "obitools/align/_assemble.pyx":116
 *                     if j==self.hSeq.length and scoremax > self.ysmax:
 *                         self.ysmax=scoremax
 *                         self.ymax=i             # <<<<<<<<<<<<<<
 *                     idx0+=1
 *                     idx1+=1
 */
          __pyx_v_self->ymax = __pyx_v_i;
          goto __pyx_L18;
        }
        __pyx_L18:;

        /* "obitools/align/_assemble.pyx":117
 *                         self.ysmax=scoremax
 *                         self.ymax=i
 *                     idx0+=1             # <<<<<<<<<<<<<<
 *                     idx1+=1
 * 
 */
        __pyx_v_idx0 = (__pyx_v_idx0 + 1);

        /* "obitools/align/_assemble.pyx":118
 *                         self.ymax=i
 *                     idx0+=1
 *                     idx1+=1             # <<<<<<<<<<<<<<
 * 
 *         self.sequenceChanged=False
 */
        __pyx_v_idx1 = (__pyx_v_idx1 + 1);
      }
    }
    goto __pyx_L3;
  }
  __pyx_L3:;

  /* "obitools/align/_assemble.pyx":120
 *                     idx1+=1
 * 
 *         self.sequenceChanged=False             # <<<<<<<<<<<<<<
 *         self.scoreChanged=False
 * 
 */
  __pyx_v_self->__pyx_base.__pyx_base.sequenceChanged = 0;

  /* "obitools/align/_assemble.pyx":121
 * 
 *         self.sequenceChanged=False
 *         self.scoreChanged=False             # <<<<<<<<<<<<<<
 * 
 *         return self.ysmax
 */
  __pyx_v_self->__pyx_base.__pyx_base.scoreChanged = 0;

  /* "obitools/align/_assemble.pyx":123
 *         self.scoreChanged=False
 * 
 *         return self.ysmax             # <<<<<<<<<<<<<<
 * 
 *     cdef void backtrack(self):
 */
  __pyx_r = __pyx_v_self->ysmax;
  goto __pyx_L0;

  /* "obitools/align/_assemble.pyx":18
 *         self.ymax=0
 * 
 *     cdef double doAlignment(self) except? 0:             # <<<<<<<<<<<<<<
 *         cdef int i  # vertical index
 *         cdef int j  # horizontal index
 */

  /* function exit code */
  __pyx_L1_error:;
  __Pyx_XDECREF(__pyx_t_1);
  __Pyx_AddTraceback("obitools.align._assemble.DirectAssemble.doAlignment", __pyx_clineno, __pyx_lineno, __pyx_filename);
  __pyx_r = 0.0;
  __pyx_L0:;
  __Pyx_RefNannyFinishContext();
  return __pyx_r;
}

/* "obitools/align/_assemble.pyx":125
 *         return self.ysmax
 * 
 *     cdef void backtrack(self):             # <<<<<<<<<<<<<<
 *         #cdef list path=[]
 *         cdef int i
 */

static void __pyx_f_8obitools_5align_9_assemble_14DirectAssemble_backtrack(struct __pyx_obj_8obitools_5align_9_assemble_DirectAssemble *__pyx_v_self) {
  int __pyx_v_i;
  int __pyx_v_j;
  int __pyx_v_p;
  __Pyx_RefNannyDeclarations
  double __pyx_t_1;
  int __pyx_t_2;
  long __pyx_t_3;
  struct __pyx_t_8obitools_5align_8_dynamic_alignPath *__pyx_t_4;
  struct __pyx_opt_args_8obitools_5align_8_dynamic_allocatePath __pyx_t_5;
  int __pyx_t_6;
  int __pyx_t_7;
  int __pyx_lineno = 0;
  const char *__pyx_filename = NULL;
  int __pyx_clineno = 0;
  __Pyx_RefNannySetupContext("backtrack", 0);

  /* "obitools/align/_assemble.pyx":131
 *         cdef int p
 * 
 *         self.doAlignment()             # <<<<<<<<<<<<<<
 *         i=self.ymax
 *         j=self.hSeq.length
 */
  __pyx_t_1 = ((struct __pyx_vtabstruct_8obitools_5align_9_assemble_DirectAssemble *)__pyx_v_self->__pyx_base.__pyx_base.__pyx_vtab)->__pyx_base.__pyx_base.doAlignment(((struct __pyx_obj_8obitools_5align_8_dynamic_DynamicProgramming *)__pyx_v_self)); if (unlikely(__pyx_t_1 == 0.0 && PyErr_Occurred())) {__pyx_filename = __pyx_f[0]; __pyx_lineno = 131; __pyx_clineno = __LINE__; goto __pyx_L1_error;}

  /* "obitools/align/_assemble.pyx":132
 * 
 *         self.doAlignment()
 *         i=self.ymax             # <<<<<<<<<<<<<<
 *         j=self.hSeq.length
 *         self.path=allocatePath(i,j+1,self.path)
 */
  __pyx_t_2 = __pyx_v_self->ymax;
  __pyx_v_i = __pyx_t_2;

  /* "obitools/align/_assemble.pyx":133
 *         self.doAlignment()
 *         i=self.ymax
 *         j=self.hSeq.length             # <<<<<<<<<<<<<<
 *         self.path=allocatePath(i,j+1,self.path)
 * 
 */
  __pyx_t_3 = __pyx_v_self->__pyx_base.__pyx_base.hSeq->length;
  __pyx_v_j = __pyx_t_3;

  /* "obitools/align/_assemble.pyx":134
 *         i=self.ymax
 *         j=self.hSeq.length
 *         self.path=allocatePath(i,j+1,self.path)             # <<<<<<<<<<<<<<
 * 
 *         if self.ymax<self.vSeq.length:
 */
  __pyx_t_5.__pyx_n = 1;
  __pyx_t_5.path = __pyx_v_self->__pyx_base.__pyx_base.path;
  __pyx_t_4 = __pyx_f_8obitools_5align_8_dynamic_allocatePath(__pyx_v_i, (__pyx_v_j + 1), &__pyx_t_5); 
  __pyx_v_self->__pyx_base.__pyx_base.path = __pyx_t_4;

  /* "obitools/align/_assemble.pyx":136
 *         self.path=allocatePath(i,j+1,self.path)
 * 
 *         if self.ymax<self.vSeq.length:             # <<<<<<<<<<<<<<
 *             self.path.path[self.path.length]=self.ymax-self.vSeq.length
 *             self.path.length+=1
 */
  __pyx_t_6 = ((__pyx_v_self->ymax < __pyx_v_self->__pyx_base.__pyx_base.vSeq->length) != 0);
  if (__pyx_t_6) {

    /* "obitools/align/_assemble.pyx":137
 * 
 *         if self.ymax<self.vSeq.length:
 *             self.path.path[self.path.length]=self.ymax-self.vSeq.length             # <<<<<<<<<<<<<<
 *             self.path.length+=1
 * 
 */
    (__pyx_v_self->__pyx_base.__pyx_base.path->path[__pyx_v_self->__pyx_base.__pyx_base.path->length]) = (__pyx_v_self->ymax - __pyx_v_self->__pyx_base.__pyx_base.vSeq->length);

    /* "obitools/align/_assemble.pyx":138
 *         if self.ymax<self.vSeq.length:
 *             self.path.path[self.path.length]=self.ymax-self.vSeq.length
 *             self.path.length+=1             # <<<<<<<<<<<<<<
 * 
 *         while (i or j):
 */
    __pyx_v_self->__pyx_base.__pyx_base.path->length = (__pyx_v_self->__pyx_base.__pyx_base.path->length + 1);
    goto __pyx_L3;
  }
  __pyx_L3:;

  /* "obitools/align/_assemble.pyx":140
 *             self.path.length+=1
 * 
 *         while (i or j):             # <<<<<<<<<<<<<<
 *             p=self.matrix.matrix[self.index(j,i)].path
 *             self.path.path[self.path.length]=p
 */
  while (1) {
    __pyx_t_7 = (__pyx_v_i != 0);
    if (!__pyx_t_7) {
      goto __pyx_L7_next_or;
    } else {
      __pyx_t_6 = __pyx_t_7;
      goto __pyx_L6_bool_binop_done;
    }
    __pyx_L7_next_or:;
    __pyx_t_7 = (__pyx_v_j != 0);
    __pyx_t_6 = __pyx_t_7;
    __pyx_L6_bool_binop_done:;
    if (!__pyx_t_6) break;

    /* "obitools/align/_assemble.pyx":141
 * 
 *         while (i or j):
 *             p=self.matrix.matrix[self.index(j,i)].path             # <<<<<<<<<<<<<<
 *             self.path.path[self.path.length]=p
 *             self.path.length+=1
 */
    __pyx_t_2 = (__pyx_v_self->__pyx_base.__pyx_base.matrix->matrix[((struct __pyx_vtabstruct_8obitools_5align_9_assemble_DirectAssemble *)__pyx_v_self->__pyx_base.__pyx_base.__pyx_vtab)->__pyx_base.__pyx_base.index(((struct __pyx_obj_8obitools_5align_8_dynamic_DynamicProgramming *)__pyx_v_self), __pyx_v_j, __pyx_v_i)]).path;
    __pyx_v_p = __pyx_t_2;

    /* "obitools/align/_assemble.pyx":142
 *         while (i or j):
 *             p=self.matrix.matrix[self.index(j,i)].path
 *             self.path.path[self.path.length]=p             # <<<<<<<<<<<<<<
 *             self.path.length+=1
 *             #path.append(p)
 */
    (__pyx_v_self->__pyx_base.__pyx_base.path->path[__pyx_v_self->__pyx_base.__pyx_base.path->length]) = __pyx_v_p;

    /* "obitools/align/_assemble.pyx":143
 *             p=self.matrix.matrix[self.index(j,i)].path
 *             self.path.path[self.path.length]=p
 *             self.path.length+=1             # <<<<<<<<<<<<<<
 *             #path.append(p)
 *             if p==0:
 */
    __pyx_v_self->__pyx_base.__pyx_base.path->length = (__pyx_v_self->__pyx_base.__pyx_base.path->length + 1);

    /* "obitools/align/_assemble.pyx":145
 *             self.path.length+=1
 *             #path.append(p)
 *             if p==0:             # <<<<<<<<<<<<<<
 *                 i-=1
 *                 j-=1
 */
    __pyx_t_6 = ((__pyx_v_p == 0) != 0);
    if (__pyx_t_6) {

      /* "obitools/align/_assemble.pyx":146
 *             #path.append(p)
 *             if p==0:
 *                 i-=1             # <<<<<<<<<<<<<<
 *                 j-=1
 *             elif p < 0:
 */
      __pyx_v_i = (__pyx_v_i - 1);

      /* "obitools/align/_assemble.pyx":147
 *             if p==0:
 *                 i-=1
 *                 j-=1             # <<<<<<<<<<<<<<
 *             elif p < 0:
 *                 i+=p
 */
      __pyx_v_j = (__pyx_v_j - 1);
      goto __pyx_L8;
    }

    /* "obitools/align/_assemble.pyx":148
 *                 i-=1
 *                 j-=1
 *             elif p < 0:             # <<<<<<<<<<<<<<
 *                 i+=p
 *             else:
 */
    __pyx_t_6 = ((__pyx_v_p < 0) != 0);
    if (__pyx_t_6) {

      /* "obitools/align/_assemble.pyx":149
 *                 j-=1
 *             elif p < 0:
 *                 i+=p             # <<<<<<<<<<<<<<
 *             else:
 *                 j-=p
 */
      __pyx_v_i = (__pyx_v_i + __pyx_v_p);
      goto __pyx_L8;
    }
    /*else*/ {

      /* "obitools/align/_assemble.pyx":151
 *                 i+=p
 *             else:
 *                 j-=p             # <<<<<<<<<<<<<<
 * 
 *         #path.reverse()
 */
      __pyx_v_j = (__pyx_v_j - __pyx_v_p);
    }
    __pyx_L8:;
  }

  /* "obitools/align/_assemble.pyx":155
 *         #path.reverse()
 *         #reversePath(self.path)
 *         self.path.hStart=0             # <<<<<<<<<<<<<<
 *         self.path.vStart=0
 *         #return 0,0,path
 */
  __pyx_v_self->__pyx_base.__pyx_base.path->hStart = 0;

  /* "obitools/align/_assemble.pyx":156
 *         #reversePath(self.path)
 *         self.path.hStart=0
 *         self.path.vStart=0             # <<<<<<<<<<<<<<
 *         #return 0,0,path
 * 
 */
  __pyx_v_self->__pyx_base.__pyx_base.path->vStart = 0;

  /* "obitools/align/_assemble.pyx":125
 *         return self.ysmax
 * 
 *     cdef void backtrack(self):             # <<<<<<<<<<<<<<
 *         #cdef list path=[]
 *         cdef int i
 */

  /* function exit code */
  goto __pyx_L0;
  __pyx_L1_error:;
  __Pyx_WriteUnraisable("obitools.align._assemble.DirectAssemble.backtrack", __pyx_clineno, __pyx_lineno, __pyx_filename, 0);
  __pyx_L0:;
  __Pyx_RefNannyFinishContext();
}

/* "obitools/align/_assemble.pyx":163
 * 
 *     property seqB:
 *             def __get__(self):             # <<<<<<<<<<<<<<
 *                 return self.verticalSeq.wrapped
 * 
 */

/* Python wrapper */
static PyObject *__pyx_pw_8obitools_5align_9_assemble_15ReverseAssemble_4seqB_1__get__(PyObject *__pyx_v_self); /*proto*/
static PyObject *__pyx_pw_8obitools_5align_9_assemble_15ReverseAssemble_4seqB_1__get__(PyObject *__pyx_v_self) {
  PyObject *__pyx_r = 0;
  __Pyx_RefNannyDeclarations
  __Pyx_RefNannySetupContext("__get__ (wrapper)", 0);
  __pyx_r = __pyx_pf_8obitools_5align_9_assemble_15ReverseAssemble_4seqB___get__(((struct __pyx_obj_8obitools_5align_9_assemble_ReverseAssemble *)__pyx_v_self));

  /* function exit code */
  __Pyx_RefNannyFinishContext();
  return __pyx_r;
}

static PyObject *__pyx_pf_8obitools_5align_9_assemble_15ReverseAssemble_4seqB___get__(struct __pyx_obj_8obitools_5align_9_assemble_ReverseAssemble *__pyx_v_self) {
  PyObject *__pyx_r = NULL;
  __Pyx_RefNannyDeclarations
  PyObject *__pyx_t_1 = NULL;
  int __pyx_lineno = 0;
  const char *__pyx_filename = NULL;
  int __pyx_clineno = 0;
  __Pyx_RefNannySetupContext("__get__", 0);

  /* "obitools/align/_assemble.pyx":164
 *     property seqB:
 *             def __get__(self):
 *                 return self.verticalSeq.wrapped             # <<<<<<<<<<<<<<
 * 
 *             def __set__(self, seq):
 */
  __Pyx_XDECREF(__pyx_r);
  __pyx_t_1 = __Pyx_PyObject_GetAttrStr(__pyx_v_self->__pyx_base.__pyx_base.__pyx_base.verticalSeq, __pyx_n_s_wrapped); if (unlikely(!__pyx_t_1)) {__pyx_filename = __pyx_f[0]; __pyx_lineno = 164; __pyx_clineno = __LINE__; goto __pyx_L1_error;}
  __Pyx_GOTREF(__pyx_t_1);
  __pyx_r = __pyx_t_1;
  __pyx_t_1 = 0;
  goto __pyx_L0;

  /* "obitools/align/_assemble.pyx":163
 * 
 *     property seqB:
 *             def __get__(self):             # <<<<<<<<<<<<<<
 *                 return self.verticalSeq.wrapped
 * 
 */

  /* function exit code */
  __pyx_L1_error:;
  __Pyx_XDECREF(__pyx_t_1);
  __Pyx_AddTraceback("obitools.align._assemble.ReverseAssemble.seqB.__get__", __pyx_clineno, __pyx_lineno, __pyx_filename);
  __pyx_r = NULL;
  __pyx_L0:;
  __Pyx_XGIVEREF(__pyx_r);
  __Pyx_RefNannyFinishContext();
  return __pyx_r;
}

/* "obitools/align/_assemble.pyx":166
 *                 return self.verticalSeq.wrapped
 * 
 *             def __set__(self, seq):             # <<<<<<<<<<<<<<
 *                 self.sequenceChanged=True
 *                 self.verticalSeq=seq.complement()
 */

/* Python wrapper */
static int __pyx_pw_8obitools_5align_9_assemble_15ReverseAssemble_4seqB_3__set__(PyObject *__pyx_v_self, PyObject *__pyx_v_seq); /*proto*/
static int __pyx_pw_8obitools_5align_9_assemble_15ReverseAssemble_4seqB_3__set__(PyObject *__pyx_v_self, PyObject *__pyx_v_seq) {
  int __pyx_r;
  __Pyx_RefNannyDeclarations
  __Pyx_RefNannySetupContext("__set__ (wrapper)", 0);
  __pyx_r = __pyx_pf_8obitools_5align_9_assemble_15ReverseAssemble_4seqB_2__set__(((struct __pyx_obj_8obitools_5align_9_assemble_ReverseAssemble *)__pyx_v_self), ((PyObject *)__pyx_v_seq));

  /* function exit code */
  __Pyx_RefNannyFinishContext();
  return __pyx_r;
}

static int __pyx_pf_8obitools_5align_9_assemble_15ReverseAssemble_4seqB_2__set__(struct __pyx_obj_8obitools_5align_9_assemble_ReverseAssemble *__pyx_v_self, PyObject *__pyx_v_seq) {
  int __pyx_r;
  __Pyx_RefNannyDeclarations
  PyObject *__pyx_t_1 = NULL;
  PyObject *__pyx_t_2 = NULL;
  PyObject *__pyx_t_3 = NULL;
  struct __pyx_t_8obitools_5align_8_dynamic_alignSequence *__pyx_t_4;
  struct __pyx_opt_args_8obitools_5align_8_dynamic_allocateSequence __pyx_t_5;
  int __pyx_lineno = 0;
  const char *__pyx_filename = NULL;
  int __pyx_clineno = 0;
  __Pyx_RefNannySetupContext("__set__", 0);

  /* "obitools/align/_assemble.pyx":167
 * 
 *             def __set__(self, seq):
 *                 self.sequenceChanged=True             # <<<<<<<<<<<<<<
 *                 self.verticalSeq=seq.complement()
 *                 self.vSeq=allocateSequence(self.verticalSeq,self.vSeq)
 */
  __pyx_v_self->__pyx_base.__pyx_base.__pyx_base.sequenceChanged = 1;

  /* "obitools/align/_assemble.pyx":168
 *             def __set__(self, seq):
 *                 self.sequenceChanged=True
 *                 self.verticalSeq=seq.complement()             # <<<<<<<<<<<<<<
 *                 self.vSeq=allocateSequence(self.verticalSeq,self.vSeq)
 */
  __pyx_t_2 = __Pyx_PyObject_GetAttrStr(__pyx_v_seq, __pyx_n_s_complement); if (unlikely(!__pyx_t_2)) {__pyx_filename = __pyx_f[0]; __pyx_lineno = 168; __pyx_clineno = __LINE__; goto __pyx_L1_error;}
  __Pyx_GOTREF(__pyx_t_2);
  __pyx_t_3 = NULL;
  if (CYTHON_COMPILING_IN_CPYTHON && likely(PyMethod_Check(__pyx_t_2))) {
    __pyx_t_3 = PyMethod_GET_SELF(__pyx_t_2);
    if (likely(__pyx_t_3)) {
      PyObject* function = PyMethod_GET_FUNCTION(__pyx_t_2);
      __Pyx_INCREF(__pyx_t_3);
      __Pyx_INCREF(function);
      __Pyx_DECREF_SET(__pyx_t_2, function);
    }
  }
  if (__pyx_t_3) {
    __pyx_t_1 = __Pyx_PyObject_CallOneArg(__pyx_t_2, __pyx_t_3); if (unlikely(!__pyx_t_1)) {__pyx_filename = __pyx_f[0]; __pyx_lineno = 168; __pyx_clineno = __LINE__; goto __pyx_L1_error;}
    __Pyx_DECREF(__pyx_t_3); __pyx_t_3 = 0;
  } else {
    __pyx_t_1 = __Pyx_PyObject_CallNoArg(__pyx_t_2); if (unlikely(!__pyx_t_1)) {__pyx_filename = __pyx_f[0]; __pyx_lineno = 168; __pyx_clineno = __LINE__; goto __pyx_L1_error;}
  }
  __Pyx_GOTREF(__pyx_t_1);
  __Pyx_DECREF(__pyx_t_2); __pyx_t_2 = 0;
  __Pyx_GIVEREF(__pyx_t_1);
  __Pyx_GOTREF(__pyx_v_self->__pyx_base.__pyx_base.__pyx_base.verticalSeq);
  __Pyx_DECREF(__pyx_v_self->__pyx_base.__pyx_base.__pyx_base.verticalSeq);
  __pyx_v_self->__pyx_base.__pyx_base.__pyx_base.verticalSeq = __pyx_t_1;
  __pyx_t_1 = 0;

  /* "obitools/align/_assemble.pyx":169
 *                 self.sequenceChanged=True
 *                 self.verticalSeq=seq.complement()
 *                 self.vSeq=allocateSequence(self.verticalSeq,self.vSeq)             # <<<<<<<<<<<<<<
 */
  __pyx_t_1 = __pyx_v_self->__pyx_base.__pyx_base.__pyx_base.verticalSeq;
  __Pyx_INCREF(__pyx_t_1);
  __pyx_t_5.__pyx_n = 1;
  __pyx_t_5.seq = __pyx_v_self->__pyx_base.__pyx_base.__pyx_base.vSeq;
  __pyx_t_4 = __pyx_f_8obitools_5align_8_dynamic_allocateSequence(__pyx_t_1, &__pyx_t_5); if (unlikely(PyErr_Occurred())) {__pyx_filename = __pyx_f[0]; __pyx_lineno = 169; __pyx_clineno = __LINE__; goto __pyx_L1_error;}
  __Pyx_DECREF(__pyx_t_1); __pyx_t_1 = 0;
  __pyx_v_self->__pyx_base.__pyx_base.__pyx_base.vSeq = __pyx_t_4;

  /* "obitools/align/_assemble.pyx":166
 *                 return self.verticalSeq.wrapped
 * 
 *             def __set__(self, seq):             # <<<<<<<<<<<<<<
 *                 self.sequenceChanged=True
 *                 self.verticalSeq=seq.complement()
 */

  /* function exit code */
  __pyx_r = 0;
  goto __pyx_L0;
  __pyx_L1_error:;
  __Pyx_XDECREF(__pyx_t_1);
  __Pyx_XDECREF(__pyx_t_2);
  __Pyx_XDECREF(__pyx_t_3);
  __Pyx_AddTraceback("obitools.align._assemble.ReverseAssemble.seqB.__set__", __pyx_clineno, __pyx_lineno, __pyx_filename);
  __pyx_r = -1;
  __pyx_L0:;
  __Pyx_RefNannyFinishContext();
  return __pyx_r;
}
static struct __pyx_vtabstruct_8obitools_5align_9_assemble_DirectAssemble __pyx_vtable_8obitools_5align_9_assemble_DirectAssemble;

static PyObject *__pyx_tp_new_8obitools_5align_9_assemble_DirectAssemble(PyTypeObject *t, PyObject *a, PyObject *k) {
  struct __pyx_obj_8obitools_5align_9_assemble_DirectAssemble *p;
  PyObject *o = __pyx_ptype_8obitools_5align_4_nws_NWS->tp_new(t, a, k);
  if (unlikely(!o)) return 0;
  p = ((struct __pyx_obj_8obitools_5align_9_assemble_DirectAssemble *)o);
  p->__pyx_base.__pyx_base.__pyx_vtab = (struct __pyx_vtabstruct_8obitools_5align_8_dynamic_DynamicProgramming*)__pyx_vtabptr_8obitools_5align_9_assemble_DirectAssemble;
  return o;
}

static void __pyx_tp_dealloc_8obitools_5align_9_assemble_DirectAssemble(PyObject *o) {
  #if PY_VERSION_HEX >= 0x030400a1
  if (unlikely(Py_TYPE(o)->tp_finalize) && !_PyGC_FINALIZED(o)) {
    if (PyObject_CallFinalizerFromDealloc(o)) return;
  }
  #endif
  PyObject_GC_UnTrack(o);
  PyObject_GC_Track(o);
  if (likely(__pyx_ptype_8obitools_5align_4_nws_NWS)) __pyx_ptype_8obitools_5align_4_nws_NWS->tp_dealloc(o); else __Pyx_call_next_tp_dealloc(o, __pyx_tp_dealloc_8obitools_5align_9_assemble_DirectAssemble);
}

static int __pyx_tp_traverse_8obitools_5align_9_assemble_DirectAssemble(PyObject *o, visitproc v, void *a) {
  int e;
  e = ((likely(__pyx_ptype_8obitools_5align_4_nws_NWS)) ? ((__pyx_ptype_8obitools_5align_4_nws_NWS->tp_traverse) ? __pyx_ptype_8obitools_5align_4_nws_NWS->tp_traverse(o, v, a) : 0) : __Pyx_call_next_tp_traverse(o, v, a, __pyx_tp_traverse_8obitools_5align_9_assemble_DirectAssemble)); if (e) return e;
  return 0;
}

static int __pyx_tp_clear_8obitools_5align_9_assemble_DirectAssemble(PyObject *o) {
  if (likely(__pyx_ptype_8obitools_5align_4_nws_NWS)) { if (__pyx_ptype_8obitools_5align_4_nws_NWS->tp_clear) __pyx_ptype_8obitools_5align_4_nws_NWS->tp_clear(o); } else __Pyx_call_next_tp_clear(o, __pyx_tp_clear_8obitools_5align_9_assemble_DirectAssemble);
  return 0;
}

static PyMethodDef __pyx_methods_8obitools_5align_9_assemble_DirectAssemble[] = {
  {0, 0, 0, 0}
};

static PyTypeObject __pyx_type_8obitools_5align_9_assemble_DirectAssemble = {
  PyVarObject_HEAD_INIT(0, 0)
  "obitools.align._assemble.DirectAssemble", /*tp_name*/
  sizeof(struct __pyx_obj_8obitools_5align_9_assemble_DirectAssemble), /*tp_basicsize*/
  0, /*tp_itemsize*/
  __pyx_tp_dealloc_8obitools_5align_9_assemble_DirectAssemble, /*tp_dealloc*/
  0, /*tp_print*/
  0, /*tp_getattr*/
  0, /*tp_setattr*/
  #if PY_MAJOR_VERSION < 3
  0, /*tp_compare*/
  #else
  0, /*reserved*/
  #endif
  0, /*tp_repr*/
  0, /*tp_as_number*/
  0, /*tp_as_sequence*/
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  0, /*tp_as_buffer*/
  Py_TPFLAGS_DEFAULT|Py_TPFLAGS_HAVE_VERSION_TAG|Py_TPFLAGS_CHECKTYPES|Py_TPFLAGS_HAVE_NEWBUFFER|Py_TPFLAGS_BASETYPE|Py_TPFLAGS_HAVE_GC, /*tp_flags*/
  0, /*tp_doc*/
  __pyx_tp_traverse_8obitools_5align_9_assemble_DirectAssemble, /*tp_traverse*/
  __pyx_tp_clear_8obitools_5align_9_assemble_DirectAssemble, /*tp_clear*/
  0, /*tp_richcompare*/
  0, /*tp_weaklistoffset*/
  0, /*tp_iter*/
  0, /*tp_iternext*/
  __pyx_methods_8obitools_5align_9_assemble_DirectAssemble, /*tp_methods*/
  0, /*tp_members*/
  0, /*tp_getset*/
  0, /*tp_base*/
  0, /*tp_dict*/
  0, /*tp_descr_get*/
  0, /*tp_descr_set*/
  0, /*tp_dictoffset*/
  __pyx_pw_8obitools_5align_9_assemble_14DirectAssemble_1__init__, /*tp_init*/
  0, /*tp_alloc*/
  __pyx_tp_new_8obitools_5align_9_assemble_DirectAssemble, /*tp_new*/
  0, /*tp_free*/
  0, /*tp_is_gc*/
  0, /*tp_bases*/
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  0, /*tp_version_tag*/
  #if PY_VERSION_HEX >= 0x030400a1
  0, /*tp_finalize*/
  #endif
};
static struct __pyx_vtabstruct_8obitools_5align_9_assemble_ReverseAssemble __pyx_vtable_8obitools_5align_9_assemble_ReverseAssemble;

static PyObject *__pyx_tp_new_8obitools_5align_9_assemble_ReverseAssemble(PyTypeObject *t, PyObject *a, PyObject *k) {
  struct __pyx_obj_8obitools_5align_9_assemble_ReverseAssemble *p;
  PyObject *o = __pyx_tp_new_8obitools_5align_9_assemble_DirectAssemble(t, a, k);
  if (unlikely(!o)) return 0;
  p = ((struct __pyx_obj_8obitools_5align_9_assemble_ReverseAssemble *)o);
  p->__pyx_base.__pyx_base.__pyx_base.__pyx_vtab = (struct __pyx_vtabstruct_8obitools_5align_8_dynamic_DynamicProgramming*)__pyx_vtabptr_8obitools_5align_9_assemble_ReverseAssemble;
  return o;
}

static PyObject *__pyx_getprop_8obitools_5align_9_assemble_15ReverseAssemble_seqB(PyObject *o, CYTHON_UNUSED void *x) {
  return __pyx_pw_8obitools_5align_9_assemble_15ReverseAssemble_4seqB_1__get__(o);
}

static int __pyx_setprop_8obitools_5align_9_assemble_15ReverseAssemble_seqB(PyObject *o, PyObject *v, CYTHON_UNUSED void *x) {
  if (v) {
    return __pyx_pw_8obitools_5align_9_assemble_15ReverseAssemble_4seqB_3__set__(o, v);
  }
  else {
    PyErr_SetString(PyExc_NotImplementedError, "__del__");
    return -1;
  }
}

static struct PyGetSetDef __pyx_getsets_8obitools_5align_9_assemble_ReverseAssemble[] = {
  {(char *)"seqB", __pyx_getprop_8obitools_5align_9_assemble_15ReverseAssemble_seqB, __pyx_setprop_8obitools_5align_9_assemble_15ReverseAssemble_seqB, 0, 0},
  {0, 0, 0, 0, 0}
};

static PyTypeObject __pyx_type_8obitools_5align_9_assemble_ReverseAssemble = {
  PyVarObject_HEAD_INIT(0, 0)
  "obitools.align._assemble.ReverseAssemble", /*tp_name*/
  sizeof(struct __pyx_obj_8obitools_5align_9_assemble_ReverseAssemble), /*tp_basicsize*/
  0, /*tp_itemsize*/
  __pyx_tp_dealloc_8obitools_5align_9_assemble_DirectAssemble, /*tp_dealloc*/
  0, /*tp_print*/
  0, /*tp_getattr*/
  0, /*tp_setattr*/
  #if PY_MAJOR_VERSION < 3
  0, /*tp_compare*/
  #else
  0, /*reserved*/
  #endif
  0, /*tp_repr*/
  0, /*tp_as_number*/
  0, /*tp_as_sequence*/
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  0, /*tp_as_buffer*/
  Py_TPFLAGS_DEFAULT|Py_TPFLAGS_HAVE_VERSION_TAG|Py_TPFLAGS_CHECKTYPES|Py_TPFLAGS_HAVE_NEWBUFFER|Py_TPFLAGS_BASETYPE|Py_TPFLAGS_HAVE_GC, /*tp_flags*/
  0, /*tp_doc*/
  __pyx_tp_traverse_8obitools_5align_9_assemble_DirectAssemble, /*tp_traverse*/
  __pyx_tp_clear_8obitools_5align_9_assemble_DirectAssemble, /*tp_clear*/
  0, /*tp_richcompare*/
  0, /*tp_weaklistoffset*/
  0, /*tp_iter*/
  0, /*tp_iternext*/
  0, /*tp_methods*/
  0, /*tp_members*/
  __pyx_getsets_8obitools_5align_9_assemble_ReverseAssemble, /*tp_getset*/
  0, /*tp_base*/
  0, /*tp_dict*/
  0, /*tp_descr_get*/
  0, /*tp_descr_set*/
  0, /*tp_dictoffset*/
  #if CYTHON_COMPILING_IN_PYPY
  __pyx_pw_8obitools_5align_9_assemble_14DirectAssemble_1__init__, /*tp_init*/
  #else
  0, /*tp_init*/
  #endif
  0, /*tp_alloc*/
  __pyx_tp_new_8obitools_5align_9_assemble_ReverseAssemble, /*tp_new*/
  0, /*tp_free*/
  0, /*tp_is_gc*/
  0, /*tp_bases*/
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  0, /*tp_version_tag*/
  #if PY_VERSION_HEX >= 0x030400a1
  0, /*tp_finalize*/
  #endif
};

static PyMethodDef __pyx_methods[] = {
  {0, 0, 0, 0}
};

#if PY_MAJOR_VERSION >= 3
static struct PyModuleDef __pyx_moduledef = {
  #if PY_VERSION_HEX < 0x03020000
    { PyObject_HEAD_INIT(NULL) NULL, 0, NULL },
  #else
    PyModuleDef_HEAD_INIT,
  #endif
    "_assemble",
    __pyx_k_Created_on_6_Nov_2009_author_co, /* m_doc */
    -1, /* m_size */
    __pyx_methods /* m_methods */,
    NULL, /* m_reload */
    NULL, /* m_traverse */
    NULL, /* m_clear */
    NULL /* m_free */
};
#endif

static __Pyx_StringTabEntry __pyx_string_tab[] = {
  {&__pyx_n_s_complement, __pyx_k_complement, sizeof(__pyx_k_complement), 0, 0, 1, 1},
  {&__pyx_n_s_extgap, __pyx_k_extgap, sizeof(__pyx_k_extgap), 0, 0, 1, 1},
  {&__pyx_n_s_init, __pyx_k_init, sizeof(__pyx_k_init), 0, 0, 1, 1},
  {&__pyx_n_s_main, __pyx_k_main, sizeof(__pyx_k_main), 0, 0, 1, 1},
  {&__pyx_n_s_match, __pyx_k_match, sizeof(__pyx_k_match), 0, 0, 1, 1},
  {&__pyx_n_s_mismatch, __pyx_k_mismatch, sizeof(__pyx_k_mismatch), 0, 0, 1, 1},
  {&__pyx_n_s_needToCompute, __pyx_k_needToCompute, sizeof(__pyx_k_needToCompute), 0, 0, 1, 1},
  {&__pyx_n_s_opengap, __pyx_k_opengap, sizeof(__pyx_k_opengap), 0, 0, 1, 1},
  {&__pyx_n_s_pyx_vtable, __pyx_k_pyx_vtable, sizeof(__pyx_k_pyx_vtable), 0, 0, 1, 1},
  {&__pyx_n_s_range, __pyx_k_range, sizeof(__pyx_k_range), 0, 0, 1, 1},
  {&__pyx_n_s_test, __pyx_k_test, sizeof(__pyx_k_test), 0, 0, 1, 1},
  {&__pyx_n_s_wrapped, __pyx_k_wrapped, sizeof(__pyx_k_wrapped), 0, 0, 1, 1},
  {0, 0, 0, 0, 0, 0, 0}
};
static int __Pyx_InitCachedBuiltins(void) {
  __pyx_builtin_range = __Pyx_GetBuiltinName(__pyx_n_s_range); if (!__pyx_builtin_range) {__pyx_filename = __pyx_f[0]; __pyx_lineno = 37; __pyx_clineno = __LINE__; goto __pyx_L1_error;}
  return 0;
  __pyx_L1_error:;
  return -1;
}

static int __Pyx_InitCachedConstants(void) {
  __Pyx_RefNannyDeclarations
  __Pyx_RefNannySetupContext("__Pyx_InitCachedConstants", 0);
  __Pyx_RefNannyFinishContext();
  return 0;
}

static int __Pyx_InitGlobals(void) {
  if (__Pyx_InitStrings(__pyx_string_tab) < 0) {__pyx_filename = __pyx_f[0]; __pyx_lineno = 1; __pyx_clineno = __LINE__; goto __pyx_L1_error;};
  __pyx_int_4 = PyInt_FromLong(4); if (unlikely(!__pyx_int_4)) {__pyx_filename = __pyx_f[0]; __pyx_lineno = 1; __pyx_clineno = __LINE__; goto __pyx_L1_error;}
  __pyx_int_neg_2 = PyInt_FromLong(-2); if (unlikely(!__pyx_int_neg_2)) {__pyx_filename = __pyx_f[0]; __pyx_lineno = 1; __pyx_clineno = __LINE__; goto __pyx_L1_error;}
  __pyx_int_neg_6 = PyInt_FromLong(-6); if (unlikely(!__pyx_int_neg_6)) {__pyx_filename = __pyx_f[0]; __pyx_lineno = 1; __pyx_clineno = __LINE__; goto __pyx_L1_error;}
  __pyx_int_neg_8 = PyInt_FromLong(-8); if (unlikely(!__pyx_int_neg_8)) {__pyx_filename = __pyx_f[0]; __pyx_lineno = 1; __pyx_clineno = __LINE__; goto __pyx_L1_error;}
  return 0;
  __pyx_L1_error:;
  return -1;
}

#if PY_MAJOR_VERSION < 3
PyMODINIT_FUNC init_assemble(void); /*proto*/
PyMODINIT_FUNC init_assemble(void)
#else
PyMODINIT_FUNC PyInit__assemble(void); /*proto*/
PyMODINIT_FUNC PyInit__assemble(void)
#endif
{
  PyObject *__pyx_t_1 = NULL;
  PyObject *__pyx_t_2 = NULL;
  int __pyx_lineno = 0;
  const char *__pyx_filename = NULL;
  int __pyx_clineno = 0;
  __Pyx_RefNannyDeclarations
  #if CYTHON_REFNANNY
  __Pyx_RefNanny = __Pyx_RefNannyImportAPI("refnanny");
  if (!__Pyx_RefNanny) {
      PyErr_Clear();
      __Pyx_RefNanny = __Pyx_RefNannyImportAPI("Cython.Runtime.refnanny");
      if (!__Pyx_RefNanny)
          Py_FatalError("failed to import 'refnanny' module");
  }
  #endif
  __Pyx_RefNannySetupContext("PyMODINIT_FUNC PyInit__assemble(void)", 0);
  if ( __Pyx_check_binary_version() < 0) {__pyx_filename = __pyx_f[0]; __pyx_lineno = 1; __pyx_clineno = __LINE__; goto __pyx_L1_error;}
  __pyx_empty_tuple = PyTuple_New(0); if (unlikely(!__pyx_empty_tuple)) {__pyx_filename = __pyx_f[0]; __pyx_lineno = 1; __pyx_clineno = __LINE__; goto __pyx_L1_error;}
  __pyx_empty_bytes = PyBytes_FromStringAndSize("", 0); if (unlikely(!__pyx_empty_bytes)) {__pyx_filename = __pyx_f[0]; __pyx_lineno = 1; __pyx_clineno = __LINE__; goto __pyx_L1_error;}
  #ifdef __Pyx_CyFunction_USED
  if (__Pyx_CyFunction_init() < 0) {__pyx_filename = __pyx_f[0]; __pyx_lineno = 1; __pyx_clineno = __LINE__; goto __pyx_L1_error;}
  #endif
  #ifdef __Pyx_FusedFunction_USED
  if (__pyx_FusedFunction_init() < 0) {__pyx_filename = __pyx_f[0]; __pyx_lineno = 1; __pyx_clineno = __LINE__; goto __pyx_L1_error;}
  #endif
  #ifdef __Pyx_Generator_USED
  if (__pyx_Generator_init() < 0) {__pyx_filename = __pyx_f[0]; __pyx_lineno = 1; __pyx_clineno = __LINE__; goto __pyx_L1_error;}
  #endif
  /*--- Library function declarations ---*/
  /*--- Threads initialization code ---*/
  #if defined(__PYX_FORCE_INIT_THREADS) && __PYX_FORCE_INIT_THREADS
  #ifdef WITH_THREAD /* Python build with threading support? */
  PyEval_InitThreads();
  #endif
  #endif
  /*--- Module creation code ---*/
  #if PY_MAJOR_VERSION < 3
  __pyx_m = Py_InitModule4("_assemble", __pyx_methods, __pyx_k_Created_on_6_Nov_2009_author_co, 0, PYTHON_API_VERSION); Py_XINCREF(__pyx_m);
  #else
  __pyx_m = PyModule_Create(&__pyx_moduledef);
  #endif
  if (unlikely(!__pyx_m)) {__pyx_filename = __pyx_f[0]; __pyx_lineno = 1; __pyx_clineno = __LINE__; goto __pyx_L1_error;}
  __pyx_d = PyModule_GetDict(__pyx_m); if (unlikely(!__pyx_d)) {__pyx_filename = __pyx_f[0]; __pyx_lineno = 1; __pyx_clineno = __LINE__; goto __pyx_L1_error;}
  Py_INCREF(__pyx_d);
  __pyx_b = PyImport_AddModule(__Pyx_BUILTIN_MODULE_NAME); if (unlikely(!__pyx_b)) {__pyx_filename = __pyx_f[0]; __pyx_lineno = 1; __pyx_clineno = __LINE__; goto __pyx_L1_error;}
  #if CYTHON_COMPILING_IN_PYPY
  Py_INCREF(__pyx_b);
  #endif
  if (PyObject_SetAttrString(__pyx_m, "__builtins__", __pyx_b) < 0) {__pyx_filename = __pyx_f[0]; __pyx_lineno = 1; __pyx_clineno = __LINE__; goto __pyx_L1_error;};
  /*--- Initialize various global constants etc. ---*/
  if (unlikely(__Pyx_InitGlobals() < 0)) {__pyx_filename = __pyx_f[0]; __pyx_lineno = 1; __pyx_clineno = __LINE__; goto __pyx_L1_error;}
  #if PY_MAJOR_VERSION < 3 && (__PYX_DEFAULT_STRING_ENCODING_IS_ASCII || __PYX_DEFAULT_STRING_ENCODING_IS_DEFAULT)
  if (__Pyx_init_sys_getdefaultencoding_params() < 0) {__pyx_filename = __pyx_f[0]; __pyx_lineno = 1; __pyx_clineno = __LINE__; goto __pyx_L1_error;}
  #endif
  if (__pyx_module_is_main_obitools__align___assemble) {
    if (PyObject_SetAttrString(__pyx_m, "__name__", __pyx_n_s_main) < 0) {__pyx_filename = __pyx_f[0]; __pyx_lineno = 1; __pyx_clineno = __LINE__; goto __pyx_L1_error;};
  }
  #if PY_MAJOR_VERSION >= 3
  {
    PyObject *modules = PyImport_GetModuleDict(); if (unlikely(!modules)) {__pyx_filename = __pyx_f[0]; __pyx_lineno = 1; __pyx_clineno = __LINE__; goto __pyx_L1_error;}
    if (!PyDict_GetItemString(modules, "obitools.align._assemble")) {
      if (unlikely(PyDict_SetItemString(modules, "obitools.align._assemble", __pyx_m) < 0)) {__pyx_filename = __pyx_f[0]; __pyx_lineno = 1; __pyx_clineno = __LINE__; goto __pyx_L1_error;}
    }
  }
  #endif
  /*--- Builtin init code ---*/
  if (unlikely(__Pyx_InitCachedBuiltins() < 0)) {__pyx_filename = __pyx_f[0]; __pyx_lineno = 1; __pyx_clineno = __LINE__; goto __pyx_L1_error;}
  /*--- Constants init code ---*/
  if (unlikely(__Pyx_InitCachedConstants() < 0)) {__pyx_filename = __pyx_f[0]; __pyx_lineno = 1; __pyx_clineno = __LINE__; goto __pyx_L1_error;}
  /*--- Global init code ---*/
  /*--- Variable export code ---*/
  /*--- Function export code ---*/
  /*--- Type init code ---*/
  __pyx_ptype_8obitools_5align_4_nws_NWS = __Pyx_ImportType("obitools.align._nws", "NWS", sizeof(struct __pyx_obj_8obitools_5align_4_nws_NWS), 1); if (unlikely(!__pyx_ptype_8obitools_5align_4_nws_NWS)) {__pyx_filename = __pyx_f[0]; __pyx_lineno = 1; __pyx_clineno = __LINE__; goto __pyx_L1_error;}
  __pyx_vtabptr_8obitools_5align_4_nws_NWS = (struct __pyx_vtabstruct_8obitools_5align_4_nws_NWS*)__Pyx_GetVtable(__pyx_ptype_8obitools_5align_4_nws_NWS->tp_dict); if (unlikely(!__pyx_vtabptr_8obitools_5align_4_nws_NWS)) {__pyx_filename = __pyx_f[0]; __pyx_lineno = 1; __pyx_clineno = __LINE__; goto __pyx_L1_error;}
  __pyx_vtabptr_8obitools_5align_9_assemble_DirectAssemble = &__pyx_vtable_8obitools_5align_9_assemble_DirectAssemble;
  __pyx_vtable_8obitools_5align_9_assemble_DirectAssemble.__pyx_base = *__pyx_vtabptr_8obitools_5align_4_nws_NWS;
  __pyx_vtable_8obitools_5align_9_assemble_DirectAssemble.__pyx_base.__pyx_base.doAlignment = (double (*)(struct __pyx_obj_8obitools_5align_8_dynamic_DynamicProgramming *))__pyx_f_8obitools_5align_9_assemble_14DirectAssemble_doAlignment;
  __pyx_vtable_8obitools_5align_9_assemble_DirectAssemble.__pyx_base.__pyx_base.backtrack = (void (*)(struct __pyx_obj_8obitools_5align_8_dynamic_DynamicProgramming *))__pyx_f_8obitools_5align_9_assemble_14DirectAssemble_backtrack;
  __pyx_type_8obitools_5align_9_assemble_DirectAssemble.tp_base = __pyx_ptype_8obitools_5align_4_nws_NWS;
  if (PyType_Ready(&__pyx_type_8obitools_5align_9_assemble_DirectAssemble) < 0) {__pyx_filename = __pyx_f[0]; __pyx_lineno = 11; __pyx_clineno = __LINE__; goto __pyx_L1_error;}
  __pyx_type_8obitools_5align_9_assemble_DirectAssemble.tp_print = 0;
  if (__Pyx_SetVtable(__pyx_type_8obitools_5align_9_assemble_DirectAssemble.tp_dict, __pyx_vtabptr_8obitools_5align_9_assemble_DirectAssemble) < 0) {__pyx_filename = __pyx_f[0]; __pyx_lineno = 11; __pyx_clineno = __LINE__; goto __pyx_L1_error;}
  if (PyObject_SetAttrString(__pyx_m, "DirectAssemble", (PyObject *)&__pyx_type_8obitools_5align_9_assemble_DirectAssemble) < 0) {__pyx_filename = __pyx_f[0]; __pyx_lineno = 11; __pyx_clineno = __LINE__; goto __pyx_L1_error;}
  __pyx_ptype_8obitools_5align_9_assemble_DirectAssemble = &__pyx_type_8obitools_5align_9_assemble_DirectAssemble;
  __pyx_vtabptr_8obitools_5align_9_assemble_ReverseAssemble = &__pyx_vtable_8obitools_5align_9_assemble_ReverseAssemble;
  __pyx_vtable_8obitools_5align_9_assemble_ReverseAssemble.__pyx_base = *__pyx_vtabptr_8obitools_5align_9_assemble_DirectAssemble;
  __pyx_type_8obitools_5align_9_assemble_ReverseAssemble.tp_base = __pyx_ptype_8obitools_5align_9_assemble_DirectAssemble;
  if (PyType_Ready(&__pyx_type_8obitools_5align_9_assemble_ReverseAssemble) < 0) {__pyx_filename = __pyx_f[0]; __pyx_lineno = 160; __pyx_clineno = __LINE__; goto __pyx_L1_error;}
  __pyx_type_8obitools_5align_9_assemble_ReverseAssemble.tp_print = 0;
  if (__Pyx_SetVtable(__pyx_type_8obitools_5align_9_assemble_ReverseAssemble.tp_dict, __pyx_vtabptr_8obitools_5align_9_assemble_ReverseAssemble) < 0) {__pyx_filename = __pyx_f[0]; __pyx_lineno = 160; __pyx_clineno = __LINE__; goto __pyx_L1_error;}
  if (PyObject_SetAttrString(__pyx_m, "ReverseAssemble", (PyObject *)&__pyx_type_8obitools_5align_9_assemble_ReverseAssemble) < 0) {__pyx_filename = __pyx_f[0]; __pyx_lineno = 160; __pyx_clineno = __LINE__; goto __pyx_L1_error;}
  __pyx_ptype_8obitools_5align_9_assemble_ReverseAssemble = &__pyx_type_8obitools_5align_9_assemble_ReverseAssemble;
  /*--- Type import code ---*/
  __pyx_ptype_8obitools_5align_8_dynamic_DynamicProgramming = __Pyx_ImportType("obitools.align._dynamic", "DynamicProgramming", sizeof(struct __pyx_obj_8obitools_5align_8_dynamic_DynamicProgramming), 1); if (unlikely(!__pyx_ptype_8obitools_5align_8_dynamic_DynamicProgramming)) {__pyx_filename = __pyx_f[1]; __pyx_lineno = 63; __pyx_clineno = __LINE__; goto __pyx_L1_error;}
  __pyx_vtabptr_8obitools_5align_8_dynamic_DynamicProgramming = (struct __pyx_vtabstruct_8obitools_5align_8_dynamic_DynamicProgramming*)__Pyx_GetVtable(__pyx_ptype_8obitools_5align_8_dynamic_DynamicProgramming->tp_dict); if (unlikely(!__pyx_vtabptr_8obitools_5align_8_dynamic_DynamicProgramming)) {__pyx_filename = __pyx_f[1]; __pyx_lineno = 63; __pyx_clineno = __LINE__; goto __pyx_L1_error;}
  /*--- Variable import code ---*/
  /*--- Function import code ---*/
  __pyx_t_1 = __Pyx_ImportModule("obitools.align._dynamic"); if (!__pyx_t_1) {__pyx_filename = __pyx_f[0]; __pyx_lineno = 1; __pyx_clineno = __LINE__; goto __pyx_L1_error;}
  if (__Pyx_ImportFunction(__pyx_t_1, "allocateSequence", (void (**)(void))&__pyx_f_8obitools_5align_8_dynamic_allocateSequence, "struct __pyx_t_8obitools_5align_8_dynamic_alignSequence *(PyObject *, struct __pyx_opt_args_8obitools_5align_8_dynamic_allocateSequence *__pyx_optional_args)") < 0) {__pyx_filename = __pyx_f[0]; __pyx_lineno = 1; __pyx_clineno = __LINE__; goto __pyx_L1_error;}
  if (__Pyx_ImportFunction(__pyx_t_1, "allocatePath", (void (**)(void))&__pyx_f_8obitools_5align_8_dynamic_allocatePath, "struct __pyx_t_8obitools_5align_8_dynamic_alignPath *(long, long, struct __pyx_opt_args_8obitools_5align_8_dynamic_allocatePath *__pyx_optional_args)") < 0) {__pyx_filename = __pyx_f[0]; __pyx_lineno = 1; __pyx_clineno = __LINE__; goto __pyx_L1_error;}
  Py_DECREF(__pyx_t_1); __pyx_t_1 = 0;
  /*--- Execution code ---*/

  /* "obitools/align/_assemble.pyx":1
 * '''             # <<<<<<<<<<<<<<
 * Created on 6 Nov. 2009
 * 
 */
  __pyx_t_2 = PyDict_New(); if (unlikely(!__pyx_t_2)) {__pyx_filename = __pyx_f[0]; __pyx_lineno = 1; __pyx_clineno = __LINE__; goto __pyx_L1_error;}
  __Pyx_GOTREF(__pyx_t_2);
  if (PyDict_SetItem(__pyx_d, __pyx_n_s_test, __pyx_t_2) < 0) {__pyx_filename = __pyx_f[0]; __pyx_lineno = 1; __pyx_clineno = __LINE__; goto __pyx_L1_error;}
  __Pyx_DECREF(__pyx_t_2); __pyx_t_2 = 0;

  /*--- Wrapped vars code ---*/

  goto __pyx_L0;
  __pyx_L1_error:;
  __Pyx_XDECREF(__pyx_t_1);
  __Pyx_XDECREF(__pyx_t_2);
  if (__pyx_m) {
    if (__pyx_d) {
      __Pyx_AddTraceback("init obitools.align._assemble", __pyx_clineno, __pyx_lineno, __pyx_filename);
      Py_DECREF(__pyx_d); __pyx_d = 0;
    }
    Py_DECREF(__pyx_m); __pyx_m = 0;
  } else if (!PyErr_Occurred()) {
    PyErr_SetString(PyExc_ImportError, "init obitools.align._assemble");
  }
  __pyx_L0:;
  __Pyx_RefNannyFinishContext();
  #if PY_MAJOR_VERSION < 3
  return;
  #else
  return __pyx_m;
  #endif
}

/* Runtime support code */
#if CYTHON_REFNANNY
static __Pyx_RefNannyAPIStruct *__Pyx_RefNannyImportAPI(const char *modname) {
    PyObject *m = NULL, *p = NULL;
    void *r = NULL;
    m = PyImport_ImportModule((char *)modname);
    if (!m) goto end;
    p = PyObject_GetAttrString(m, (char *)"RefNannyAPI");
    if (!p) goto end;
    r = PyLong_AsVoidPtr(p);
end:
    Py_XDECREF(p);
    Py_XDECREF(m);
    return (__Pyx_RefNannyAPIStruct *)r;
}
#endif

static PyObject *__Pyx_GetBuiltinName(PyObject *name) {
    PyObject* result = __Pyx_PyObject_GetAttrStr(__pyx_b, name);
    if (unlikely(!result)) {
        PyErr_Format(PyExc_NameError,
#if PY_MAJOR_VERSION >= 3
            "name '%U' is not defined", name);
#else
            "name '%.200s' is not defined", PyString_AS_STRING(name));
#endif
    }
    return result;
}

static void __Pyx_RaiseDoubleKeywordsError(
    const char* func_name,
    PyObject* kw_name)
{
    PyErr_Format(PyExc_TypeError,
        #if PY_MAJOR_VERSION >= 3
        "%s() got multiple values for keyword argument '%U'", func_name, kw_name);
        #else
        "%s() got multiple values for keyword argument '%s'", func_name,
        PyString_AsString(kw_name));
        #endif
}

static int __Pyx_ParseOptionalKeywords(
    PyObject *kwds,
    PyObject **argnames[],
    PyObject *kwds2,
    PyObject *values[],
    Py_ssize_t num_pos_args,
    const char* function_name)
{
    PyObject *key = 0, *value = 0;
    Py_ssize_t pos = 0;
    PyObject*** name;
    PyObject*** first_kw_arg = argnames + num_pos_args;
    while (PyDict_Next(kwds, &pos, &key, &value)) {
        name = first_kw_arg;
        while (*name && (**name != key)) name++;
        if (*name) {
            values[name-argnames] = value;
            continue;
        }
        name = first_kw_arg;
        #if PY_MAJOR_VERSION < 3
        if (likely(PyString_CheckExact(key)) || likely(PyString_Check(key))) {
            while (*name) {
                if ((CYTHON_COMPILING_IN_PYPY || PyString_GET_SIZE(**name) == PyString_GET_SIZE(key))
                        && _PyString_Eq(**name, key)) {
                    values[name-argnames] = value;
                    break;
                }
                name++;
            }
            if (*name) continue;
            else {
                PyObject*** argname = argnames;
                while (argname != first_kw_arg) {
                    if ((**argname == key) || (
                            (CYTHON_COMPILING_IN_PYPY || PyString_GET_SIZE(**argname) == PyString_GET_SIZE(key))
                             && _PyString_Eq(**argname, key))) {
                        goto arg_passed_twice;
                    }
                    argname++;
                }
            }
        } else
        #endif
        if (likely(PyUnicode_Check(key))) {
            while (*name) {
                int cmp = (**name == key) ? 0 :
                #if !CYTHON_COMPILING_IN_PYPY && PY_MAJOR_VERSION >= 3
                    (PyUnicode_GET_SIZE(**name) != PyUnicode_GET_SIZE(key)) ? 1 :
                #endif
                    PyUnicode_Compare(**name, key);
                if (cmp < 0 && unlikely(PyErr_Occurred())) goto bad;
                if (cmp == 0) {
                    values[name-argnames] = value;
                    break;
                }
                name++;
            }
            if (*name) continue;
            else {
                PyObject*** argname = argnames;
                while (argname != first_kw_arg) {
                    int cmp = (**argname == key) ? 0 :
                    #if !CYTHON_COMPILING_IN_PYPY && PY_MAJOR_VERSION >= 3
                        (PyUnicode_GET_SIZE(**argname) != PyUnicode_GET_SIZE(key)) ? 1 :
                    #endif
                        PyUnicode_Compare(**argname, key);
                    if (cmp < 0 && unlikely(PyErr_Occurred())) goto bad;
                    if (cmp == 0) goto arg_passed_twice;
                    argname++;
                }
            }
        } else
            goto invalid_keyword_type;
        if (kwds2) {
            if (unlikely(PyDict_SetItem(kwds2, key, value))) goto bad;
        } else {
            goto invalid_keyword;
        }
    }
    return 0;
arg_passed_twice:
    __Pyx_RaiseDoubleKeywordsError(function_name, key);
    goto bad;
invalid_keyword_type:
    PyErr_Format(PyExc_TypeError,
        "%.200s() keywords must be strings", function_name);
    goto bad;
invalid_keyword:
    PyErr_Format(PyExc_TypeError,
    #if PY_MAJOR_VERSION < 3
        "%.200s() got an unexpected keyword argument '%.200s'",
        function_name, PyString_AsString(key));
    #else
        "%s() got an unexpected keyword argument '%U'",
        function_name, key);
    #endif
bad:
    return -1;
}

static void __Pyx_RaiseArgtupleInvalid(
    const char* func_name,
    int exact,
    Py_ssize_t num_min,
    Py_ssize_t num_max,
    Py_ssize_t num_found)
{
    Py_ssize_t num_expected;
    const char *more_or_less;
    if (num_found < num_min) {
        num_expected = num_min;
        more_or_less = "at least";
    } else {
        num_expected = num_max;
        more_or_less = "at most";
    }
    if (exact) {
        more_or_less = "exactly";
    }
    PyErr_Format(PyExc_TypeError,
                 "%.200s() takes %.8s %" CYTHON_FORMAT_SSIZE_T "d positional argument%.1s (%" CYTHON_FORMAT_SSIZE_T "d given)",
                 func_name, more_or_less, num_expected,
                 (num_expected == 1) ? "" : "s", num_found);
}

#if CYTHON_COMPILING_IN_CPYTHON
static CYTHON_INLINE PyObject* __Pyx_PyObject_Call(PyObject *func, PyObject *arg, PyObject *kw) {
    PyObject *result;
    ternaryfunc call = func->ob_type->tp_call;
    if (unlikely(!call))
        return PyObject_Call(func, arg, kw);
    if (unlikely(Py_EnterRecursiveCall((char*)" while calling a Python object")))
        return NULL;
    result = (*call)(func, arg, kw);
    Py_LeaveRecursiveCall();
    if (unlikely(!result) && unlikely(!PyErr_Occurred())) {
        PyErr_SetString(
            PyExc_SystemError,
            "NULL result without error in PyObject_Call");
    }
    return result;
}
#endif

static CYTHON_INLINE void __Pyx_ErrRestore(PyObject *type, PyObject *value, PyObject *tb) {
#if CYTHON_COMPILING_IN_CPYTHON
    PyObject *tmp_type, *tmp_value, *tmp_tb;
    PyThreadState *tstate = PyThreadState_GET();
    tmp_type = tstate->curexc_type;
    tmp_value = tstate->curexc_value;
    tmp_tb = tstate->curexc_traceback;
    tstate->curexc_type = type;
    tstate->curexc_value = value;
    tstate->curexc_traceback = tb;
    Py_XDECREF(tmp_type);
    Py_XDECREF(tmp_value);
    Py_XDECREF(tmp_tb);
#else
    PyErr_Restore(type, value, tb);
#endif
}
static CYTHON_INLINE void __Pyx_ErrFetch(PyObject **type, PyObject **value, PyObject **tb) {
#if CYTHON_COMPILING_IN_CPYTHON
    PyThreadState *tstate = PyThreadState_GET();
    *type = tstate->curexc_type;
    *value = tstate->curexc_value;
    *tb = tstate->curexc_traceback;
    tstate->curexc_type = 0;
    tstate->curexc_value = 0;
    tstate->curexc_traceback = 0;
#else
    PyErr_Fetch(type, value, tb);
#endif
}

static void __Pyx_WriteUnraisable(const char *name, CYTHON_UNUSED int clineno,
                                  CYTHON_UNUSED int lineno, CYTHON_UNUSED const char *filename,
                                  int full_traceback) {
    PyObject *old_exc, *old_val, *old_tb;
    PyObject *ctx;
    __Pyx_ErrFetch(&old_exc, &old_val, &old_tb);
    if (full_traceback) {
        Py_XINCREF(old_exc);
        Py_XINCREF(old_val);
        Py_XINCREF(old_tb);
        __Pyx_ErrRestore(old_exc, old_val, old_tb);
        PyErr_PrintEx(1);
    }
    #if PY_MAJOR_VERSION < 3
    ctx = PyString_FromString(name);
    #else
    ctx = PyUnicode_FromString(name);
    #endif
    __Pyx_ErrRestore(old_exc, old_val, old_tb);
    if (!ctx) {
        PyErr_WriteUnraisable(Py_None);
    } else {
        PyErr_WriteUnraisable(ctx);
        Py_DECREF(ctx);
    }
}

#if CYTHON_COMPILING_IN_CPYTHON
static CYTHON_INLINE PyObject* __Pyx_PyObject_CallMethO(PyObject *func, PyObject *arg) {
    PyObject *self, *result;
    PyCFunction cfunc;
    cfunc = PyCFunction_GET_FUNCTION(func);
    self = PyCFunction_GET_SELF(func);
    if (unlikely(Py_EnterRecursiveCall((char*)" while calling a Python object")))
        return NULL;
    result = cfunc(self, arg);
    Py_LeaveRecursiveCall();
    if (unlikely(!result) && unlikely(!PyErr_Occurred())) {
        PyErr_SetString(
            PyExc_SystemError,
            "NULL result without error in PyObject_Call");
    }
    return result;
}
#endif

#if CYTHON_COMPILING_IN_CPYTHON
static PyObject* __Pyx__PyObject_CallOneArg(PyObject *func, PyObject *arg) {
    PyObject *result;
    PyObject *args = PyTuple_New(1);
    if (unlikely(!args)) return NULL;
    Py_INCREF(arg);
    PyTuple_SET_ITEM(args, 0, arg);
    result = __Pyx_PyObject_Call(func, args, NULL);
    Py_DECREF(args);
    return result;
}
static CYTHON_INLINE PyObject* __Pyx_PyObject_CallOneArg(PyObject *func, PyObject *arg) {
#ifdef __Pyx_CyFunction_USED
    if (likely(PyCFunction_Check(func) || PyObject_TypeCheck(func, __pyx_CyFunctionType))) {
#else
    if (likely(PyCFunction_Check(func))) {
#endif
        if (likely(PyCFunction_GET_FLAGS(func) & METH_O)) {
            return __Pyx_PyObject_CallMethO(func, arg);
        }
    }
    return __Pyx__PyObject_CallOneArg(func, arg);
}
#else
static CYTHON_INLINE PyObject* __Pyx_PyObject_CallOneArg(PyObject *func, PyObject *arg) {
    PyObject* args = PyTuple_Pack(1, arg);
    return (likely(args)) ? __Pyx_PyObject_Call(func, args, NULL) : NULL;
}
#endif

#if CYTHON_COMPILING_IN_CPYTHON
static CYTHON_INLINE PyObject* __Pyx_PyObject_CallNoArg(PyObject *func) {
#ifdef __Pyx_CyFunction_USED
    if (likely(PyCFunction_Check(func) || PyObject_TypeCheck(func, __pyx_CyFunctionType))) {
#else
    if (likely(PyCFunction_Check(func))) {
#endif
        if (likely(PyCFunction_GET_FLAGS(func) & METH_NOARGS)) {
            return __Pyx_PyObject_CallMethO(func, NULL);
        }
    }
    return __Pyx_PyObject_Call(func, __pyx_empty_tuple, NULL);
}
#endif

static void __Pyx_call_next_tp_dealloc(PyObject* obj, destructor current_tp_dealloc) {
    PyTypeObject* type = Py_TYPE(obj);
    while (type && type->tp_dealloc != current_tp_dealloc)
        type = type->tp_base;
    while (type && type->tp_dealloc == current_tp_dealloc)
        type = type->tp_base;
    if (type)
        type->tp_dealloc(obj);
}

static int __Pyx_call_next_tp_traverse(PyObject* obj, visitproc v, void *a, traverseproc current_tp_traverse) {
    PyTypeObject* type = Py_TYPE(obj);
    while (type && type->tp_traverse != current_tp_traverse)
        type = type->tp_base;
    while (type && type->tp_traverse == current_tp_traverse)
        type = type->tp_base;
    if (type && type->tp_traverse)
        return type->tp_traverse(obj, v, a);
    return 0;
}

static void __Pyx_call_next_tp_clear(PyObject* obj, inquiry current_tp_clear) {
    PyTypeObject* type = Py_TYPE(obj);
    while (type && type->tp_clear != current_tp_clear)
        type = type->tp_base;
    while (type && type->tp_clear == current_tp_clear)
        type = type->tp_base;
    if (type && type->tp_clear)
        type->tp_clear(obj);
}

static void* __Pyx_GetVtable(PyObject *dict) {
    void* ptr;
    PyObject *ob = PyObject_GetItem(dict, __pyx_n_s_pyx_vtable);
    if (!ob)
        goto bad;
#if PY_VERSION_HEX >= 0x02070000
    ptr = PyCapsule_GetPointer(ob, 0);
#else
    ptr = PyCObject_AsVoidPtr(ob);
#endif
    if (!ptr && !PyErr_Occurred())
        PyErr_SetString(PyExc_RuntimeError, "invalid vtable found for imported type");
    Py_DECREF(ob);
    return ptr;
bad:
    Py_XDECREF(ob);
    return NULL;
}

static int __Pyx_SetVtable(PyObject *dict, void *vtable) {
#if PY_VERSION_HEX >= 0x02070000
    PyObject *ob = PyCapsule_New(vtable, 0, 0);
#else
    PyObject *ob = PyCObject_FromVoidPtr(vtable, 0);
#endif
    if (!ob)
        goto bad;
    if (PyDict_SetItem(dict, __pyx_n_s_pyx_vtable, ob) < 0)
        goto bad;
    Py_DECREF(ob);
    return 0;
bad:
    Py_XDECREF(ob);
    return -1;
}

static int __pyx_bisect_code_objects(__Pyx_CodeObjectCacheEntry* entries, int count, int code_line) {
    int start = 0, mid = 0, end = count - 1;
    if (end >= 0 && code_line > entries[end].code_line) {
        return count;
    }
    while (start < end) {
        mid = (start + end) / 2;
        if (code_line < entries[mid].code_line) {
            end = mid;
        } else if (code_line > entries[mid].code_line) {
             start = mid + 1;
        } else {
            return mid;
        }
    }
    if (code_line <= entries[mid].code_line) {
        return mid;
    } else {
        return mid + 1;
    }
}
static PyCodeObject *__pyx_find_code_object(int code_line) {
    PyCodeObject* code_object;
    int pos;
    if (unlikely(!code_line) || unlikely(!__pyx_code_cache.entries)) {
        return NULL;
    }
    pos = __pyx_bisect_code_objects(__pyx_code_cache.entries, __pyx_code_cache.count, code_line);
    if (unlikely(pos >= __pyx_code_cache.count) || unlikely(__pyx_code_cache.entries[pos].code_line != code_line)) {
        return NULL;
    }
    code_object = __pyx_code_cache.entries[pos].code_object;
    Py_INCREF(code_object);
    return code_object;
}
static void __pyx_insert_code_object(int code_line, PyCodeObject* code_object) {
    int pos, i;
    __Pyx_CodeObjectCacheEntry* entries = __pyx_code_cache.entries;
    if (unlikely(!code_line)) {
        return;
    }
    if (unlikely(!entries)) {
        entries = (__Pyx_CodeObjectCacheEntry*)PyMem_Malloc(64*sizeof(__Pyx_CodeObjectCacheEntry));
        if (likely(entries)) {
            __pyx_code_cache.entries = entries;
            __pyx_code_cache.max_count = 64;
            __pyx_code_cache.count = 1;
            entries[0].code_line = code_line;
            entries[0].code_object = code_object;
            Py_INCREF(code_object);
        }
        return;
    }
    pos = __pyx_bisect_code_objects(__pyx_code_cache.entries, __pyx_code_cache.count, code_line);
    if ((pos < __pyx_code_cache.count) && unlikely(__pyx_code_cache.entries[pos].code_line == code_line)) {
        PyCodeObject* tmp = entries[pos].code_object;
        entries[pos].code_object = code_object;
        Py_DECREF(tmp);
        return;
    }
    if (__pyx_code_cache.count == __pyx_code_cache.max_count) {
        int new_max = __pyx_code_cache.max_count + 64;
        entries = (__Pyx_CodeObjectCacheEntry*)PyMem_Realloc(
            __pyx_code_cache.entries, (size_t)new_max*sizeof(__Pyx_CodeObjectCacheEntry));
        if (unlikely(!entries)) {
            return;
        }
        __pyx_code_cache.entries = entries;
        __pyx_code_cache.max_count = new_max;
    }
    for (i=__pyx_code_cache.count; i>pos; i--) {
        entries[i] = entries[i-1];
    }
    entries[pos].code_line = code_line;
    entries[pos].code_object = code_object;
    __pyx_code_cache.count++;
    Py_INCREF(code_object);
}

#include "compile.h"
#include "frameobject.h"
#include "traceback.h"
static PyCodeObject* __Pyx_CreateCodeObjectForTraceback(
            const char *funcname, int c_line,
            int py_line, const char *filename) {
    PyCodeObject *py_code = 0;
    PyObject *py_srcfile = 0;
    PyObject *py_funcname = 0;
    #if PY_MAJOR_VERSION < 3
    py_srcfile = PyString_FromString(filename);
    #else
    py_srcfile = PyUnicode_FromString(filename);
    #endif
    if (!py_srcfile) goto bad;
    if (c_line) {
        #if PY_MAJOR_VERSION < 3
        py_funcname = PyString_FromFormat( "%s (%s:%d)", funcname, __pyx_cfilenm, c_line);
        #else
        py_funcname = PyUnicode_FromFormat( "%s (%s:%d)", funcname, __pyx_cfilenm, c_line);
        #endif
    }
    else {
        #if PY_MAJOR_VERSION < 3
        py_funcname = PyString_FromString(funcname);
        #else
        py_funcname = PyUnicode_FromString(funcname);
        #endif
    }
    if (!py_funcname) goto bad;
    py_code = __Pyx_PyCode_New(
        0,
        0,
        0,
        0,
        0,
        __pyx_empty_bytes, /*PyObject *code,*/
        __pyx_empty_tuple, /*PyObject *consts,*/
        __pyx_empty_tuple, /*PyObject *names,*/
        __pyx_empty_tuple, /*PyObject *varnames,*/
        __pyx_empty_tuple, /*PyObject *freevars,*/
        __pyx_empty_tuple, /*PyObject *cellvars,*/
        py_srcfile,   /*PyObject *filename,*/
        py_funcname,  /*PyObject *name,*/
        py_line,
        __pyx_empty_bytes  /*PyObject *lnotab*/
    );
    Py_DECREF(py_srcfile);
    Py_DECREF(py_funcname);
    return py_code;
bad:
    Py_XDECREF(py_srcfile);
    Py_XDECREF(py_funcname);
    return NULL;
}
static void __Pyx_AddTraceback(const char *funcname, int c_line,
                               int py_line, const char *filename) {
    PyCodeObject *py_code = 0;
    PyFrameObject *py_frame = 0;
    py_code = __pyx_find_code_object(c_line ? c_line : py_line);
    if (!py_code) {
        py_code = __Pyx_CreateCodeObjectForTraceback(
            funcname, c_line, py_line, filename);
        if (!py_code) goto bad;
        __pyx_insert_code_object(c_line ? c_line : py_line, py_code);
    }
    py_frame = PyFrame_New(
        PyThreadState_GET(), /*PyThreadState *tstate,*/
        py_code,             /*PyCodeObject *code,*/
        __pyx_d,      /*PyObject *globals,*/
        0                    /*PyObject *locals*/
    );
    if (!py_frame) goto bad;
    py_frame->f_lineno = py_line;
    PyTraceBack_Here(py_frame);
bad:
    Py_XDECREF(py_code);
    Py_XDECREF(py_frame);
}

static CYTHON_INLINE PyObject* __Pyx_PyInt_From_long(long value) {
    const long neg_one = (long) -1, const_zero = 0;
    const int is_unsigned = neg_one > const_zero;
    if (is_unsigned) {
        if (sizeof(long) < sizeof(long)) {
            return PyInt_FromLong((long) value);
        } else if (sizeof(long) <= sizeof(unsigned long)) {
            return PyLong_FromUnsignedLong((unsigned long) value);
        } else if (sizeof(long) <= sizeof(unsigned long long)) {
            return PyLong_FromUnsignedLongLong((unsigned long long) value);
        }
    } else {
        if (sizeof(long) <= sizeof(long)) {
            return PyInt_FromLong((long) value);
        } else if (sizeof(long) <= sizeof(long long)) {
            return PyLong_FromLongLong((long long) value);
        }
    }
    {
        int one = 1; int little = (int)*(unsigned char *)&one;
        unsigned char *bytes = (unsigned char *)&value;
        return _PyLong_FromByteArray(bytes, sizeof(long),
                                     little, !is_unsigned);
    }
}

#define __PYX_VERIFY_RETURN_INT(target_type, func_type, func_value)       \
    {                                                                     \
        func_type value = func_value;                                     \
        if (sizeof(target_type) < sizeof(func_type)) {                    \
            if (unlikely(value != (func_type) (target_type) value)) {     \
                func_type zero = 0;                                       \
                if (is_unsigned && unlikely(value < zero))                \
                    goto raise_neg_overflow;                              \
                else                                                      \
                    goto raise_overflow;                                  \
            }                                                             \
        }                                                                 \
        return (target_type) value;                                       \
    }

#if CYTHON_COMPILING_IN_CPYTHON && PY_MAJOR_VERSION >= 3
 #if CYTHON_USE_PYLONG_INTERNALS
  #include "longintrepr.h"
 #endif
#endif

static CYTHON_INLINE int __Pyx_PyInt_As_int(PyObject *x) {
    const int neg_one = (int) -1, const_zero = 0;
    const int is_unsigned = neg_one > const_zero;
#if PY_MAJOR_VERSION < 3
    if (likely(PyInt_Check(x))) {
        if (sizeof(int) < sizeof(long)) {
            __PYX_VERIFY_RETURN_INT(int, long, PyInt_AS_LONG(x))
        } else {
            long val = PyInt_AS_LONG(x);
            if (is_unsigned && unlikely(val < 0)) {
                goto raise_neg_overflow;
            }
            return (int) val;
        }
    } else
#endif
    if (likely(PyLong_Check(x))) {
        if (is_unsigned) {
#if CYTHON_COMPILING_IN_CPYTHON && PY_MAJOR_VERSION >= 3
 #if CYTHON_USE_PYLONG_INTERNALS
            switch (Py_SIZE(x)) {
                case  0: return 0;
                case  1: __PYX_VERIFY_RETURN_INT(int, digit, ((PyLongObject*)x)->ob_digit[0]);
            }
 #endif
#endif
            if (unlikely(Py_SIZE(x) < 0)) {
                goto raise_neg_overflow;
            }
            if (sizeof(int) <= sizeof(unsigned long)) {
                __PYX_VERIFY_RETURN_INT(int, unsigned long, PyLong_AsUnsignedLong(x))
            } else if (sizeof(int) <= sizeof(unsigned long long)) {
                __PYX_VERIFY_RETURN_INT(int, unsigned long long, PyLong_AsUnsignedLongLong(x))
            }
        } else {
#if CYTHON_COMPILING_IN_CPYTHON && PY_MAJOR_VERSION >= 3
 #if CYTHON_USE_PYLONG_INTERNALS
            switch (Py_SIZE(x)) {
                case  0: return 0;
                case  1: __PYX_VERIFY_RETURN_INT(int,  digit, +(((PyLongObject*)x)->ob_digit[0]));
                case -1: __PYX_VERIFY_RETURN_INT(int, sdigit, -(sdigit) ((PyLongObject*)x)->ob_digit[0]);
            }
 #endif
#endif
            if (sizeof(int) <= sizeof(long)) {
                __PYX_VERIFY_RETURN_INT(int, long, PyLong_AsLong(x))
            } else if (sizeof(int) <= sizeof(long long)) {
                __PYX_VERIFY_RETURN_INT(int, long long, PyLong_AsLongLong(x))
            }
        }
        {
#if CYTHON_COMPILING_IN_PYPY && !defined(_PyLong_AsByteArray)
            PyErr_SetString(PyExc_RuntimeError,
                            "_PyLong_AsByteArray() not available in PyPy, cannot convert large numbers");
#else
            int val;
            PyObject *v = __Pyx_PyNumber_Int(x);
 #if PY_MAJOR_VERSION < 3
            if (likely(v) && !PyLong_Check(v)) {
                PyObject *tmp = v;
                v = PyNumber_Long(tmp);
                Py_DECREF(tmp);
            }
 #endif
            if (likely(v)) {
                int one = 1; int is_little = (int)*(unsigned char *)&one;
                unsigned char *bytes = (unsigned char *)&val;
                int ret = _PyLong_AsByteArray((PyLongObject *)v,
                                              bytes, sizeof(val),
                                              is_little, !is_unsigned);
                Py_DECREF(v);
                if (likely(!ret))
                    return val;
            }
#endif
            return (int) -1;
        }
    } else {
        int val;
        PyObject *tmp = __Pyx_PyNumber_Int(x);
        if (!tmp) return (int) -1;
        val = __Pyx_PyInt_As_int(tmp);
        Py_DECREF(tmp);
        return val;
    }
raise_overflow:
    PyErr_SetString(PyExc_OverflowError,
        "value too large to convert to int");
    return (int) -1;
raise_neg_overflow:
    PyErr_SetString(PyExc_OverflowError,
        "can't convert negative value to int");
    return (int) -1;
}

static CYTHON_INLINE long __Pyx_PyInt_As_long(PyObject *x) {
    const long neg_one = (long) -1, const_zero = 0;
    const int is_unsigned = neg_one > const_zero;
#if PY_MAJOR_VERSION < 3
    if (likely(PyInt_Check(x))) {
        if (sizeof(long) < sizeof(long)) {
            __PYX_VERIFY_RETURN_INT(long, long, PyInt_AS_LONG(x))
        } else {
            long val = PyInt_AS_LONG(x);
            if (is_unsigned && unlikely(val < 0)) {
                goto raise_neg_overflow;
            }
            return (long) val;
        }
    } else
#endif
    if (likely(PyLong_Check(x))) {
        if (is_unsigned) {
#if CYTHON_COMPILING_IN_CPYTHON && PY_MAJOR_VERSION >= 3
 #if CYTHON_USE_PYLONG_INTERNALS
            switch (Py_SIZE(x)) {
                case  0: return 0;
                case  1: __PYX_VERIFY_RETURN_INT(long, digit, ((PyLongObject*)x)->ob_digit[0]);
            }
 #endif
#endif
            if (unlikely(Py_SIZE(x) < 0)) {
                goto raise_neg_overflow;
            }
            if (sizeof(long) <= sizeof(unsigned long)) {
                __PYX_VERIFY_RETURN_INT(long, unsigned long, PyLong_AsUnsignedLong(x))
            } else if (sizeof(long) <= sizeof(unsigned long long)) {
                __PYX_VERIFY_RETURN_INT(long, unsigned long long, PyLong_AsUnsignedLongLong(x))
            }
        } else {
#if CYTHON_COMPILING_IN_CPYTHON && PY_MAJOR_VERSION >= 3
 #if CYTHON_USE_PYLONG_INTERNALS
            switch (Py_SIZE(x)) {
                case  0: return 0;
                case  1: __PYX_VERIFY_RETURN_INT(long,  digit, +(((PyLongObject*)x)->ob_digit[0]));
                case -1: __PYX_VERIFY_RETURN_INT(long, sdigit, -(sdigit) ((PyLongObject*)x)->ob_digit[0]);
            }
 #endif
#endif
            if (sizeof(long) <= sizeof(long)) {
                __PYX_VERIFY_RETURN_INT(long, long, PyLong_AsLong(x))
            } else if (sizeof(long) <= sizeof(long long)) {
                __PYX_VERIFY_RETURN_INT(long, long long, PyLong_AsLongLong(x))
            }
        }
        {
#if CYTHON_COMPILING_IN_PYPY && !defined(_PyLong_AsByteArray)
            PyErr_SetString(PyExc_RuntimeError,
                            "_PyLong_AsByteArray() not available in PyPy, cannot convert large numbers");
#else
            long val;
            PyObject *v = __Pyx_PyNumber_Int(x);
 #if PY_MAJOR_VERSION < 3
            if (likely(v) && !PyLong_Check(v)) {
                PyObject *tmp = v;
                v = PyNumber_Long(tmp);
                Py_DECREF(tmp);
            }
 #endif
            if (likely(v)) {
                int one = 1; int is_little = (int)*(unsigned char *)&one;
                unsigned char *bytes = (unsigned char *)&val;
                int ret = _PyLong_AsByteArray((PyLongObject *)v,
                                              bytes, sizeof(val),
                                              is_little, !is_unsigned);
                Py_DECREF(v);
                if (likely(!ret))
                    return val;
            }
#endif
            return (long) -1;
        }
    } else {
        long val;
        PyObject *tmp = __Pyx_PyNumber_Int(x);
        if (!tmp) return (long) -1;
        val = __Pyx_PyInt_As_long(tmp);
        Py_DECREF(tmp);
        return val;
    }
raise_overflow:
    PyErr_SetString(PyExc_OverflowError,
        "value too large to convert to long");
    return (long) -1;
raise_neg_overflow:
    PyErr_SetString(PyExc_OverflowError,
        "can't convert negative value to long");
    return (long) -1;
}

static int __Pyx_check_binary_version(void) {
    char ctversion[4], rtversion[4];
    PyOS_snprintf(ctversion, 4, "%d.%d", PY_MAJOR_VERSION, PY_MINOR_VERSION);
    PyOS_snprintf(rtversion, 4, "%s", Py_GetVersion());
    if (ctversion[0] != rtversion[0] || ctversion[2] != rtversion[2]) {
        char message[200];
        PyOS_snprintf(message, sizeof(message),
                      "compiletime version %s of module '%.100s' "
                      "does not match runtime version %s",
                      ctversion, __Pyx_MODULE_NAME, rtversion);
        return PyErr_WarnEx(NULL, message, 1);
    }
    return 0;
}

#ifndef __PYX_HAVE_RT_ImportModule
#define __PYX_HAVE_RT_ImportModule
static PyObject *__Pyx_ImportModule(const char *name) {
    PyObject *py_name = 0;
    PyObject *py_module = 0;
    py_name = __Pyx_PyIdentifier_FromString(name);
    if (!py_name)
        goto bad;
    py_module = PyImport_Import(py_name);
    Py_DECREF(py_name);
    return py_module;
bad:
    Py_XDECREF(py_name);
    return 0;
}
#endif

#ifndef __PYX_HAVE_RT_ImportType
#define __PYX_HAVE_RT_ImportType
static PyTypeObject *__Pyx_ImportType(const char *module_name, const char *class_name,
    size_t size, int strict)
{
    PyObject *py_module = 0;
    PyObject *result = 0;
    PyObject *py_name = 0;
    char warning[200];
    Py_ssize_t basicsize;
#ifdef Py_LIMITED_API
    PyObject *py_basicsize;
#endif
    py_module = __Pyx_ImportModule(module_name);
    if (!py_module)
        goto bad;
    py_name = __Pyx_PyIdentifier_FromString(class_name);
    if (!py_name)
        goto bad;
    result = PyObject_GetAttr(py_module, py_name);
    Py_DECREF(py_name);
    py_name = 0;
    Py_DECREF(py_module);
    py_module = 0;
    if (!result)
        goto bad;
    if (!PyType_Check(result)) {
        PyErr_Format(PyExc_TypeError,
            "%.200s.%.200s is not a type object",
            module_name, class_name);
        goto bad;
    }
#ifndef Py_LIMITED_API
    basicsize = ((PyTypeObject *)result)->tp_basicsize;
#else
    py_basicsize = PyObject_GetAttrString(result, "__basicsize__");
    if (!py_basicsize)
        goto bad;
    basicsize = PyLong_AsSsize_t(py_basicsize);
    Py_DECREF(py_basicsize);
    py_basicsize = 0;
    if (basicsize == (Py_ssize_t)-1 && PyErr_Occurred())
        goto bad;
#endif
    if (!strict && (size_t)basicsize > size) {
        PyOS_snprintf(warning, sizeof(warning),
            "%s.%s size changed, may indicate binary incompatibility",
            module_name, class_name);
        if (PyErr_WarnEx(NULL, warning, 0) < 0) goto bad;
    }
    else if ((size_t)basicsize != size) {
        PyErr_Format(PyExc_ValueError,
            "%.200s.%.200s has the wrong size, try recompiling",
            module_name, class_name);
        goto bad;
    }
    return (PyTypeObject *)result;
bad:
    Py_XDECREF(py_module);
    Py_XDECREF(result);
    return NULL;
}
#endif

#ifndef __PYX_HAVE_RT_ImportFunction
#define __PYX_HAVE_RT_ImportFunction
static int __Pyx_ImportFunction(PyObject *module, const char *funcname, void (**f)(void), const char *sig) {
    PyObject *d = 0;
    PyObject *cobj = 0;
    union {
        void (*fp)(void);
        void *p;
    } tmp;
    d = PyObject_GetAttrString(module, (char *)"__pyx_capi__");
    if (!d)
        goto bad;
    cobj = PyDict_GetItemString(d, funcname);
    if (!cobj) {
        PyErr_Format(PyExc_ImportError,
            "%.200s does not export expected C function %.200s",
                PyModule_GetName(module), funcname);
        goto bad;
    }
#if PY_VERSION_HEX >= 0x02070000
    if (!PyCapsule_IsValid(cobj, sig)) {
        PyErr_Format(PyExc_TypeError,
            "C function %.200s.%.200s has wrong signature (expected %.500s, got %.500s)",
             PyModule_GetName(module), funcname, sig, PyCapsule_GetName(cobj));
        goto bad;
    }
    tmp.p = PyCapsule_GetPointer(cobj, sig);
#else
    {const char *desc, *s1, *s2;
    desc = (const char *)PyCObject_GetDesc(cobj);
    if (!desc)
        goto bad;
    s1 = desc; s2 = sig;
    while (*s1 != '\0' && *s1 == *s2) { s1++; s2++; }
    if (*s1 != *s2) {
        PyErr_Format(PyExc_TypeError,
            "C function %.200s.%.200s has wrong signature (expected %.500s, got %.500s)",
             PyModule_GetName(module), funcname, sig, desc);
        goto bad;
    }
    tmp.p = PyCObject_AsVoidPtr(cobj);}
#endif
    *f = tmp.fp;
    if (!(*f))
        goto bad;
    Py_DECREF(d);
    return 0;
bad:
    Py_XDECREF(d);
    return -1;
}
#endif

static int __Pyx_InitStrings(__Pyx_StringTabEntry *t) {
    while (t->p) {
        #if PY_MAJOR_VERSION < 3
        if (t->is_unicode) {
            *t->p = PyUnicode_DecodeUTF8(t->s, t->n - 1, NULL);
        } else if (t->intern) {
            *t->p = PyString_InternFromString(t->s);
        } else {
            *t->p = PyString_FromStringAndSize(t->s, t->n - 1);
        }
        #else
        if (t->is_unicode | t->is_str) {
            if (t->intern) {
                *t->p = PyUnicode_InternFromString(t->s);
            } else if (t->encoding) {
                *t->p = PyUnicode_Decode(t->s, t->n - 1, t->encoding, NULL);
            } else {
                *t->p = PyUnicode_FromStringAndSize(t->s, t->n - 1);
            }
        } else {
            *t->p = PyBytes_FromStringAndSize(t->s, t->n - 1);
        }
        #endif
        if (!*t->p)
            return -1;
        ++t;
    }
    return 0;
}

static CYTHON_INLINE PyObject* __Pyx_PyUnicode_FromString(const char* c_str) {
    return __Pyx_PyUnicode_FromStringAndSize(c_str, (Py_ssize_t)strlen(c_str));
}
static CYTHON_INLINE char* __Pyx_PyObject_AsString(PyObject* o) {
    Py_ssize_t ignore;
    return __Pyx_PyObject_AsStringAndSize(o, &ignore);
}
static CYTHON_INLINE char* __Pyx_PyObject_AsStringAndSize(PyObject* o, Py_ssize_t *length) {
#if __PYX_DEFAULT_STRING_ENCODING_IS_ASCII || __PYX_DEFAULT_STRING_ENCODING_IS_DEFAULT
    if (
#if PY_MAJOR_VERSION < 3 && __PYX_DEFAULT_STRING_ENCODING_IS_ASCII
            __Pyx_sys_getdefaultencoding_not_ascii &&
#endif
            PyUnicode_Check(o)) {
#if PY_VERSION_HEX < 0x03030000
        char* defenc_c;
        PyObject* defenc = _PyUnicode_AsDefaultEncodedString(o, NULL);
        if (!defenc) return NULL;
        defenc_c = PyBytes_AS_STRING(defenc);
#if __PYX_DEFAULT_STRING_ENCODING_IS_ASCII
        {
            char* end = defenc_c + PyBytes_GET_SIZE(defenc);
            char* c;
            for (c = defenc_c; c < end; c++) {
                if ((unsigned char) (*c) >= 128) {
                    PyUnicode_AsASCIIString(o);
                    return NULL;
                }
            }
        }
#endif
        *length = PyBytes_GET_SIZE(defenc);
        return defenc_c;
#else
        if (__Pyx_PyUnicode_READY(o) == -1) return NULL;
#if __PYX_DEFAULT_STRING_ENCODING_IS_ASCII
        if (PyUnicode_IS_ASCII(o)) {
            *length = PyUnicode_GET_LENGTH(o);
            return PyUnicode_AsUTF8(o);
        } else {
            PyUnicode_AsASCIIString(o);
            return NULL;
        }
#else
        return PyUnicode_AsUTF8AndSize(o, length);
#endif
#endif
    } else
#endif
#if !CYTHON_COMPILING_IN_PYPY
    if (PyByteArray_Check(o)) {
        *length = PyByteArray_GET_SIZE(o);
        return PyByteArray_AS_STRING(o);
    } else
#endif
    {
        char* result;
        int r = PyBytes_AsStringAndSize(o, &result, length);
        if (unlikely(r < 0)) {
            return NULL;
        } else {
            return result;
        }
    }
}
static CYTHON_INLINE int __Pyx_PyObject_IsTrue(PyObject* x) {
   int is_true = x == Py_True;
   if (is_true | (x == Py_False) | (x == Py_None)) return is_true;
   else return PyObject_IsTrue(x);
}
static CYTHON_INLINE PyObject* __Pyx_PyNumber_Int(PyObject* x) {
  PyNumberMethods *m;
  const char *name = NULL;
  PyObject *res = NULL;
#if PY_MAJOR_VERSION < 3
  if (PyInt_Check(x) || PyLong_Check(x))
#else
  if (PyLong_Check(x))
#endif
    return Py_INCREF(x), x;
  m = Py_TYPE(x)->tp_as_number;
#if PY_MAJOR_VERSION < 3
  if (m && m->nb_int) {
    name = "int";
    res = PyNumber_Int(x);
  }
  else if (m && m->nb_long) {
    name = "long";
    res = PyNumber_Long(x);
  }
#else
  if (m && m->nb_int) {
    name = "int";
    res = PyNumber_Long(x);
  }
#endif
  if (res) {
#if PY_MAJOR_VERSION < 3
    if (!PyInt_Check(res) && !PyLong_Check(res)) {
#else
    if (!PyLong_Check(res)) {
#endif
      PyErr_Format(PyExc_TypeError,
                   "__%.4s__ returned non-%.4s (type %.200s)",
                   name, name, Py_TYPE(res)->tp_name);
      Py_DECREF(res);
      return NULL;
    }
  }
  else if (!PyErr_Occurred()) {
    PyErr_SetString(PyExc_TypeError,
                    "an integer is required");
  }
  return res;
}
static CYTHON_INLINE Py_ssize_t __Pyx_PyIndex_AsSsize_t(PyObject* b) {
  Py_ssize_t ival;
  PyObject *x;
#if PY_MAJOR_VERSION < 3
  if (likely(PyInt_CheckExact(b)))
      return PyInt_AS_LONG(b);
#endif
  if (likely(PyLong_CheckExact(b))) {
    #if CYTHON_COMPILING_IN_CPYTHON && PY_MAJOR_VERSION >= 3
     #if CYTHON_USE_PYLONG_INTERNALS
       switch (Py_SIZE(b)) {
       case -1: return -(sdigit)((PyLongObject*)b)->ob_digit[0];
       case  0: return 0;
       case  1: return ((PyLongObject*)b)->ob_digit[0];
       }
     #endif
    #endif
    return PyLong_AsSsize_t(b);
  }
  x = PyNumber_Index(b);
  if (!x) return -1;
  ival = PyInt_AsSsize_t(x);
  Py_DECREF(x);
  return ival;
}
static CYTHON_INLINE PyObject * __Pyx_PyInt_FromSize_t(size_t ival) {
    return PyInt_FromSize_t(ival);
}


#endif /* Py_PYTHON_H */
