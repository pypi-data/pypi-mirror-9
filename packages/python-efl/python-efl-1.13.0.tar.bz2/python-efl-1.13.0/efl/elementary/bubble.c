/* Generated by Cython 0.21 */

#define PY_SSIZE_T_CLEAN
#ifndef CYTHON_USE_PYLONG_INTERNALS
#ifdef PYLONG_BITS_IN_DIGIT
#define CYTHON_USE_PYLONG_INTERNALS 0
#else
#include "pyconfig.h"
#ifdef PYLONG_BITS_IN_DIGIT
#define CYTHON_USE_PYLONG_INTERNALS 1
#else
#define CYTHON_USE_PYLONG_INTERNALS 0
#endif
#endif
#endif
#include "Python.h"
#ifndef Py_PYTHON_H
    #error Python headers needed to compile C extensions, please install development version of Python.
#elif PY_VERSION_HEX < 0x02060000 || (0x03000000 <= PY_VERSION_HEX && PY_VERSION_HEX < 0x03020000)
    #error Cython requires Python 2.6+ or Python 3.2+.
#else
#define CYTHON_ABI "0_21"
#include <stddef.h>
#ifndef offsetof
#define offsetof(type, member) ( (size_t) & ((type*)0) -> member )
#endif
#if !defined(WIN32) && !defined(MS_WINDOWS)
  #ifndef __stdcall
    #define __stdcall
  #endif
  #ifndef __cdecl
    #define __cdecl
  #endif
  #ifndef __fastcall
    #define __fastcall
  #endif
#endif
#ifndef DL_IMPORT
  #define DL_IMPORT(t) t
#endif
#ifndef DL_EXPORT
  #define DL_EXPORT(t) t
#endif
#ifndef PY_LONG_LONG
  #define PY_LONG_LONG LONG_LONG
#endif
#ifndef Py_HUGE_VAL
  #define Py_HUGE_VAL HUGE_VAL
#endif
#ifdef PYPY_VERSION
#define CYTHON_COMPILING_IN_PYPY 1
#define CYTHON_COMPILING_IN_CPYTHON 0
#else
#define CYTHON_COMPILING_IN_PYPY 0
#define CYTHON_COMPILING_IN_CPYTHON 1
#endif
#if CYTHON_COMPILING_IN_PYPY && PY_VERSION_HEX < 0x02070600
#define Py_OptimizeFlag 0
#endif
#define __PYX_BUILD_PY_SSIZE_T "n"
#define CYTHON_FORMAT_SSIZE_T "z"
#if PY_MAJOR_VERSION < 3
  #define __Pyx_BUILTIN_MODULE_NAME "__builtin__"
  #define __Pyx_PyCode_New(a, k, l, s, f, code, c, n, v, fv, cell, fn, name, fline, lnos) \
          PyCode_New(a+k, l, s, f, code, c, n, v, fv, cell, fn, name, fline, lnos)
  #define __Pyx_DefaultClassType PyClass_Type
#else
  #define __Pyx_BUILTIN_MODULE_NAME "builtins"
  #define __Pyx_PyCode_New(a, k, l, s, f, code, c, n, v, fv, cell, fn, name, fline, lnos) \
          PyCode_New(a, k, l, s, f, code, c, n, v, fv, cell, fn, name, fline, lnos)
  #define __Pyx_DefaultClassType PyType_Type
#endif
#if PY_MAJOR_VERSION >= 3
  #define Py_TPFLAGS_CHECKTYPES 0
  #define Py_TPFLAGS_HAVE_INDEX 0
#endif
#if PY_MAJOR_VERSION >= 3
  #define Py_TPFLAGS_HAVE_NEWBUFFER 0
#endif
#if PY_VERSION_HEX < 0x030400a1 && !defined(Py_TPFLAGS_HAVE_FINALIZE)
  #define Py_TPFLAGS_HAVE_FINALIZE 0
#endif
#if PY_VERSION_HEX > 0x03030000 && defined(PyUnicode_KIND)
  #define CYTHON_PEP393_ENABLED 1
  #define __Pyx_PyUnicode_READY(op)       (likely(PyUnicode_IS_READY(op)) ? \
                                              0 : _PyUnicode_Ready((PyObject *)(op)))
  #define __Pyx_PyUnicode_GET_LENGTH(u)   PyUnicode_GET_LENGTH(u)
  #define __Pyx_PyUnicode_READ_CHAR(u, i) PyUnicode_READ_CHAR(u, i)
  #define __Pyx_PyUnicode_KIND(u)         PyUnicode_KIND(u)
  #define __Pyx_PyUnicode_DATA(u)         PyUnicode_DATA(u)
  #define __Pyx_PyUnicode_READ(k, d, i)   PyUnicode_READ(k, d, i)
#else
  #define CYTHON_PEP393_ENABLED 0
  #define __Pyx_PyUnicode_READY(op)       (0)
  #define __Pyx_PyUnicode_GET_LENGTH(u)   PyUnicode_GET_SIZE(u)
  #define __Pyx_PyUnicode_READ_CHAR(u, i) ((Py_UCS4)(PyUnicode_AS_UNICODE(u)[i]))
  #define __Pyx_PyUnicode_KIND(u)         (sizeof(Py_UNICODE))
  #define __Pyx_PyUnicode_DATA(u)         ((void*)PyUnicode_AS_UNICODE(u))
  #define __Pyx_PyUnicode_READ(k, d, i)   ((void)(k), (Py_UCS4)(((Py_UNICODE*)d)[i]))
#endif
#if CYTHON_COMPILING_IN_PYPY
  #define __Pyx_PyUnicode_Concat(a, b)      PyNumber_Add(a, b)
  #define __Pyx_PyUnicode_ConcatSafe(a, b)  PyNumber_Add(a, b)
#else
  #define __Pyx_PyUnicode_Concat(a, b)      PyUnicode_Concat(a, b)
  #define __Pyx_PyUnicode_ConcatSafe(a, b)  ((unlikely((a) == Py_None) || unlikely((b) == Py_None)) ? \
      PyNumber_Add(a, b) : __Pyx_PyUnicode_Concat(a, b))
#endif
#define __Pyx_PyString_FormatSafe(a, b)   ((unlikely((a) == Py_None)) ? PyNumber_Remainder(a, b) : __Pyx_PyString_Format(a, b))
#define __Pyx_PyUnicode_FormatSafe(a, b)  ((unlikely((a) == Py_None)) ? PyNumber_Remainder(a, b) : PyUnicode_Format(a, b))
#if PY_MAJOR_VERSION >= 3
  #define __Pyx_PyString_Format(a, b)  PyUnicode_Format(a, b)
#else
  #define __Pyx_PyString_Format(a, b)  PyString_Format(a, b)
#endif
#if PY_MAJOR_VERSION >= 3
  #define PyBaseString_Type            PyUnicode_Type
  #define PyStringObject               PyUnicodeObject
  #define PyString_Type                PyUnicode_Type
  #define PyString_Check               PyUnicode_Check
  #define PyString_CheckExact          PyUnicode_CheckExact
#endif
#if PY_MAJOR_VERSION >= 3
  #define __Pyx_PyBaseString_Check(obj) PyUnicode_Check(obj)
  #define __Pyx_PyBaseString_CheckExact(obj) PyUnicode_CheckExact(obj)
#else
  #define __Pyx_PyBaseString_Check(obj) (PyString_Check(obj) || PyUnicode_Check(obj))
  #define __Pyx_PyBaseString_CheckExact(obj) (PyString_CheckExact(obj) || PyUnicode_CheckExact(obj))
#endif
#ifndef PySet_CheckExact
  #define PySet_CheckExact(obj)        (Py_TYPE(obj) == &PySet_Type)
#endif
#define __Pyx_TypeCheck(obj, type) PyObject_TypeCheck(obj, (PyTypeObject *)type)
#if PY_MAJOR_VERSION >= 3
  #define PyIntObject                  PyLongObject
  #define PyInt_Type                   PyLong_Type
  #define PyInt_Check(op)              PyLong_Check(op)
  #define PyInt_CheckExact(op)         PyLong_CheckExact(op)
  #define PyInt_FromString             PyLong_FromString
  #define PyInt_FromUnicode            PyLong_FromUnicode
  #define PyInt_FromLong               PyLong_FromLong
  #define PyInt_FromSize_t             PyLong_FromSize_t
  #define PyInt_FromSsize_t            PyLong_FromSsize_t
  #define PyInt_AsLong                 PyLong_AsLong
  #define PyInt_AS_LONG                PyLong_AS_LONG
  #define PyInt_AsSsize_t              PyLong_AsSsize_t
  #define PyInt_AsUnsignedLongMask     PyLong_AsUnsignedLongMask
  #define PyInt_AsUnsignedLongLongMask PyLong_AsUnsignedLongLongMask
  #define PyNumber_Int                 PyNumber_Long
#endif
#if PY_MAJOR_VERSION >= 3
  #define PyBoolObject                 PyLongObject
#endif
#if PY_VERSION_HEX < 0x030200A4
  typedef long Py_hash_t;
  #define __Pyx_PyInt_FromHash_t PyInt_FromLong
  #define __Pyx_PyInt_AsHash_t   PyInt_AsLong
#else
  #define __Pyx_PyInt_FromHash_t PyInt_FromSsize_t
  #define __Pyx_PyInt_AsHash_t   PyInt_AsSsize_t
#endif
#if PY_MAJOR_VERSION >= 3
  #define PyMethod_New(func, self, klass) ((self) ? PyMethod_New(func, self) : PyInstanceMethod_New(func))
#endif
#ifndef CYTHON_INLINE
  #if defined(__GNUC__)
    #define CYTHON_INLINE __inline__
  #elif defined(_MSC_VER)
    #define CYTHON_INLINE __inline
  #elif defined (__STDC_VERSION__) && __STDC_VERSION__ >= 199901L
    #define CYTHON_INLINE inline
  #else
    #define CYTHON_INLINE
  #endif
#endif
#ifndef CYTHON_RESTRICT
  #if defined(__GNUC__)
    #define CYTHON_RESTRICT __restrict__
  #elif defined(_MSC_VER) && _MSC_VER >= 1400
    #define CYTHON_RESTRICT __restrict
  #elif defined (__STDC_VERSION__) && __STDC_VERSION__ >= 199901L
    #define CYTHON_RESTRICT restrict
  #else
    #define CYTHON_RESTRICT
  #endif
#endif
#ifdef NAN
#define __PYX_NAN() ((float) NAN)
#else
static CYTHON_INLINE float __PYX_NAN() {
  /* Initialize NaN. The sign is irrelevant, an exponent with all bits 1 and
   a nonzero mantissa means NaN. If the first bit in the mantissa is 1, it is
   a quiet NaN. */
  float value;
  memset(&value, 0xFF, sizeof(value));
  return value;
}
#endif
#ifdef __cplusplus
template<typename T>
void __Pyx_call_destructor(T* x) {
    x->~T();
}
#endif


#if PY_MAJOR_VERSION >= 3
  #define __Pyx_PyNumber_Divide(x,y)         PyNumber_TrueDivide(x,y)
  #define __Pyx_PyNumber_InPlaceDivide(x,y)  PyNumber_InPlaceTrueDivide(x,y)
#else
  #define __Pyx_PyNumber_Divide(x,y)         PyNumber_Divide(x,y)
  #define __Pyx_PyNumber_InPlaceDivide(x,y)  PyNumber_InPlaceDivide(x,y)
#endif

#ifndef __PYX_EXTERN_C
  #ifdef __cplusplus
    #define __PYX_EXTERN_C extern "C"
  #else
    #define __PYX_EXTERN_C extern
  #endif
#endif

#if defined(WIN32) || defined(MS_WINDOWS)
#define _USE_MATH_DEFINES
#endif
#include <math.h>
#define __PYX_HAVE__efl__elementary__bubble
#define __PYX_HAVE_API__efl__elementary__bubble
#include "string.h"
#include "stdio.h"
#include "pythread.h"
#include "time.h"
#include "Eina.h"
#include "Eo.h"
#include "Evas.h"
#include "Elementary.h"
#include "Edje.h"
#ifdef _OPENMP
#include <omp.h>
#endif /* _OPENMP */

#ifdef PYREX_WITHOUT_ASSERTIONS
#define CYTHON_WITHOUT_ASSERTIONS
#endif

#ifndef CYTHON_UNUSED
# if defined(__GNUC__)
#   if !(defined(__cplusplus)) || (__GNUC__ > 3 || (__GNUC__ == 3 && __GNUC_MINOR__ >= 4))
#     define CYTHON_UNUSED __attribute__ ((__unused__))
#   else
#     define CYTHON_UNUSED
#   endif
# elif defined(__ICC) || (defined(__INTEL_COMPILER) && !defined(_MSC_VER))
#   define CYTHON_UNUSED __attribute__ ((__unused__))
# else
#   define CYTHON_UNUSED
# endif
#endif
typedef struct {PyObject **p; char *s; const Py_ssize_t n; const char* encoding;
                const char is_unicode; const char is_str; const char intern; } __Pyx_StringTabEntry;

#define __PYX_DEFAULT_STRING_ENCODING_IS_ASCII 0
#define __PYX_DEFAULT_STRING_ENCODING_IS_DEFAULT 0
#define __PYX_DEFAULT_STRING_ENCODING ""
#define __Pyx_PyObject_FromString __Pyx_PyBytes_FromString
#define __Pyx_PyObject_FromStringAndSize __Pyx_PyBytes_FromStringAndSize
#define __Pyx_fits_Py_ssize_t(v, type, is_signed)  (    \
    (sizeof(type) < sizeof(Py_ssize_t))  ||             \
    (sizeof(type) > sizeof(Py_ssize_t) &&               \
          likely(v < (type)PY_SSIZE_T_MAX ||            \
                 v == (type)PY_SSIZE_T_MAX)  &&         \
          (!is_signed || likely(v > (type)PY_SSIZE_T_MIN ||       \
                                v == (type)PY_SSIZE_T_MIN)))  ||  \
    (sizeof(type) == sizeof(Py_ssize_t) &&              \
          (is_signed || likely(v < (type)PY_SSIZE_T_MAX ||        \
                               v == (type)PY_SSIZE_T_MAX)))  )
static CYTHON_INLINE char* __Pyx_PyObject_AsString(PyObject*);
static CYTHON_INLINE char* __Pyx_PyObject_AsStringAndSize(PyObject*, Py_ssize_t* length);
#define __Pyx_PyByteArray_FromString(s) PyByteArray_FromStringAndSize((const char*)s, strlen((const char*)s))
#define __Pyx_PyByteArray_FromStringAndSize(s, l) PyByteArray_FromStringAndSize((const char*)s, l)
#define __Pyx_PyBytes_FromString        PyBytes_FromString
#define __Pyx_PyBytes_FromStringAndSize PyBytes_FromStringAndSize
static CYTHON_INLINE PyObject* __Pyx_PyUnicode_FromString(const char*);
#if PY_MAJOR_VERSION < 3
    #define __Pyx_PyStr_FromString        __Pyx_PyBytes_FromString
    #define __Pyx_PyStr_FromStringAndSize __Pyx_PyBytes_FromStringAndSize
#else
    #define __Pyx_PyStr_FromString        __Pyx_PyUnicode_FromString
    #define __Pyx_PyStr_FromStringAndSize __Pyx_PyUnicode_FromStringAndSize
#endif
#define __Pyx_PyObject_AsSString(s)    ((signed char*) __Pyx_PyObject_AsString(s))
#define __Pyx_PyObject_AsUString(s)    ((unsigned char*) __Pyx_PyObject_AsString(s))
#define __Pyx_PyObject_FromUString(s)  __Pyx_PyObject_FromString((const char*)s)
#define __Pyx_PyBytes_FromUString(s)   __Pyx_PyBytes_FromString((const char*)s)
#define __Pyx_PyByteArray_FromUString(s)   __Pyx_PyByteArray_FromString((const char*)s)
#define __Pyx_PyStr_FromUString(s)     __Pyx_PyStr_FromString((const char*)s)
#define __Pyx_PyUnicode_FromUString(s) __Pyx_PyUnicode_FromString((const char*)s)
#if PY_MAJOR_VERSION < 3
static CYTHON_INLINE size_t __Pyx_Py_UNICODE_strlen(const Py_UNICODE *u)
{
    const Py_UNICODE *u_end = u;
    while (*u_end++) ;
    return (size_t)(u_end - u - 1);
}
#else
#define __Pyx_Py_UNICODE_strlen Py_UNICODE_strlen
#endif
#define __Pyx_PyUnicode_FromUnicode(u)       PyUnicode_FromUnicode(u, __Pyx_Py_UNICODE_strlen(u))
#define __Pyx_PyUnicode_FromUnicodeAndLength PyUnicode_FromUnicode
#define __Pyx_PyUnicode_AsUnicode            PyUnicode_AsUnicode
#define __Pyx_Owned_Py_None(b) (Py_INCREF(Py_None), Py_None)
#define __Pyx_PyBool_FromLong(b) ((b) ? (Py_INCREF(Py_True), Py_True) : (Py_INCREF(Py_False), Py_False))
static CYTHON_INLINE int __Pyx_PyObject_IsTrue(PyObject*);
static CYTHON_INLINE PyObject* __Pyx_PyNumber_Int(PyObject* x);
static CYTHON_INLINE Py_ssize_t __Pyx_PyIndex_AsSsize_t(PyObject*);
static CYTHON_INLINE PyObject * __Pyx_PyInt_FromSize_t(size_t);
#if CYTHON_COMPILING_IN_CPYTHON
#define __pyx_PyFloat_AsDouble(x) (PyFloat_CheckExact(x) ? PyFloat_AS_DOUBLE(x) : PyFloat_AsDouble(x))
#else
#define __pyx_PyFloat_AsDouble(x) PyFloat_AsDouble(x)
#endif
#define __pyx_PyFloat_AsFloat(x) ((float) __pyx_PyFloat_AsDouble(x))
#if PY_MAJOR_VERSION < 3 && __PYX_DEFAULT_STRING_ENCODING_IS_ASCII
static int __Pyx_sys_getdefaultencoding_not_ascii;
static int __Pyx_init_sys_getdefaultencoding_params(void) {
    PyObject* sys;
    PyObject* default_encoding = NULL;
    PyObject* ascii_chars_u = NULL;
    PyObject* ascii_chars_b = NULL;
    const char* default_encoding_c;
    sys = PyImport_ImportModule("sys");
    if (!sys) goto bad;
    default_encoding = PyObject_CallMethod(sys, (char*) (const char*) "getdefaultencoding", NULL);
    Py_DECREF(sys);
    if (!default_encoding) goto bad;
    default_encoding_c = PyBytes_AsString(default_encoding);
    if (!default_encoding_c) goto bad;
    if (strcmp(default_encoding_c, "ascii") == 0) {
        __Pyx_sys_getdefaultencoding_not_ascii = 0;
    } else {
        char ascii_chars[128];
        int c;
        for (c = 0; c < 128; c++) {
            ascii_chars[c] = c;
        }
        __Pyx_sys_getdefaultencoding_not_ascii = 1;
        ascii_chars_u = PyUnicode_DecodeASCII(ascii_chars, 128, NULL);
        if (!ascii_chars_u) goto bad;
        ascii_chars_b = PyUnicode_AsEncodedString(ascii_chars_u, default_encoding_c, NULL);
        if (!ascii_chars_b || !PyBytes_Check(ascii_chars_b) || memcmp(ascii_chars, PyBytes_AS_STRING(ascii_chars_b), 128) != 0) {
            PyErr_Format(
                PyExc_ValueError,
                "This module compiled with c_string_encoding=ascii, but default encoding '%.200s' is not a superset of ascii.",
                default_encoding_c);
            goto bad;
        }
        Py_DECREF(ascii_chars_u);
        Py_DECREF(ascii_chars_b);
    }
    Py_DECREF(default_encoding);
    return 0;
bad:
    Py_XDECREF(default_encoding);
    Py_XDECREF(ascii_chars_u);
    Py_XDECREF(ascii_chars_b);
    return -1;
}
#endif
#if __PYX_DEFAULT_STRING_ENCODING_IS_DEFAULT && PY_MAJOR_VERSION >= 3
#define __Pyx_PyUnicode_FromStringAndSize(c_str, size) PyUnicode_DecodeUTF8(c_str, size, NULL)
#else
#define __Pyx_PyUnicode_FromStringAndSize(c_str, size) PyUnicode_Decode(c_str, size, __PYX_DEFAULT_STRING_ENCODING, NULL)
#if __PYX_DEFAULT_STRING_ENCODING_IS_DEFAULT
static char* __PYX_DEFAULT_STRING_ENCODING;
static int __Pyx_init_sys_getdefaultencoding_params(void) {
    PyObject* sys;
    PyObject* default_encoding = NULL;
    char* default_encoding_c;
    sys = PyImport_ImportModule("sys");
    if (!sys) goto bad;
    default_encoding = PyObject_CallMethod(sys, (char*) (const char*) "getdefaultencoding", NULL);
    Py_DECREF(sys);
    if (!default_encoding) goto bad;
    default_encoding_c = PyBytes_AsString(default_encoding);
    if (!default_encoding_c) goto bad;
    __PYX_DEFAULT_STRING_ENCODING = (char*) malloc(strlen(default_encoding_c));
    if (!__PYX_DEFAULT_STRING_ENCODING) goto bad;
    strcpy(__PYX_DEFAULT_STRING_ENCODING, default_encoding_c);
    Py_DECREF(default_encoding);
    return 0;
bad:
    Py_XDECREF(default_encoding);
    return -1;
}
#endif
#endif


/* Test for GCC > 2.95 */
#if defined(__GNUC__)     && (__GNUC__ > 2 || (__GNUC__ == 2 && (__GNUC_MINOR__ > 95)))
  #define likely(x)   __builtin_expect(!!(x), 1)
  #define unlikely(x) __builtin_expect(!!(x), 0)
#else /* !__GNUC__ or GCC < 2.95 */
  #define likely(x)   (x)
  #define unlikely(x) (x)
#endif /* __GNUC__ */

static PyObject *__pyx_m;
static PyObject *__pyx_d;
static PyObject *__pyx_b;
static PyObject *__pyx_empty_tuple;
static PyObject *__pyx_empty_bytes;
static int __pyx_lineno;
static int __pyx_clineno = 0;
static const char * __pyx_cfilenm= __FILE__;
static const char *__pyx_filename;


static const char *__pyx_f[] = {
  "efl/elementary/bubble.pyx",
  "type.pxd",
  "bool.pxd",
  "complex.pxd",
  "include/efl.eo.pxd",
  "include/efl.evas.pxd",
  "efl/elementary/object.pxd",
  "efl/elementary/bubble.pxd",
};

/*--- Type declarations ---*/
struct __pyx_obj_3efl_2eo_Eo;
struct __pyx_obj_3efl_4evas_Rect;
struct __pyx_obj_3efl_4evas_Canvas;
struct __pyx_obj_3efl_4evas_Map;
struct __pyx_obj_3efl_4evas_Object;
struct __pyx_obj_3efl_4evas_Rectangle;
struct __pyx_obj_3efl_4evas_Line;
struct __pyx_obj_3efl_4evas_Image;
struct __pyx_obj_3efl_4evas_FilledImage;
struct __pyx_obj_3efl_4evas_Polygon;
struct __pyx_obj_3efl_4evas_Text;
struct __pyx_obj_3efl_4evas_Textblock;
struct __pyx_obj_3efl_4evas_EventPoint;
struct __pyx_obj_3efl_4evas_EventCoordPoint;
struct __pyx_obj_3efl_4evas_EventPrecisionPoint;
struct __pyx_obj_3efl_4evas_EventPosition;
struct __pyx_obj_3efl_4evas_EventPrecisionPosition;
struct __pyx_obj_3efl_4evas_EventMouseIn;
struct __pyx_obj_3efl_4evas_EventMouseOut;
struct __pyx_obj_3efl_4evas_EventMouseDown;
struct __pyx_obj_3efl_4evas_EventMouseUp;
struct __pyx_obj_3efl_4evas_EventMouseMove;
struct __pyx_obj_3efl_4evas_EventMultiDown;
struct __pyx_obj_3efl_4evas_EventMultiUp;
struct __pyx_obj_3efl_4evas_EventMultiMove;
struct __pyx_obj_3efl_4evas_EventMouseWheel;
struct __pyx_obj_3efl_4evas_EventKeyDown;
struct __pyx_obj_3efl_4evas_EventKeyUp;
struct __pyx_obj_3efl_4evas_EventHold;
struct __pyx_obj_3efl_10elementary_6object_Canvas;
struct __pyx_obj_3efl_10elementary_6object_Object;
struct __pyx_obj_3efl_10elementary_12layout_class_LayoutClass;
struct __pyx_obj_3efl_10elementary_6bubble_Bubble;

/* "include/efl.eo.pxd":21
 * 
 * cdef:
 *     class Eo(object):             # <<<<<<<<<<<<<<
 *         cdef:
 *             cEo *obj
 */
struct __pyx_obj_3efl_2eo_Eo {
  PyObject_HEAD
  struct __pyx_vtabstruct_3efl_2eo_Eo *__pyx_vtab;
  Eo *obj;
  PyObject *data;
};


/* "include/efl.evas.pxd":1161
 * # Python classes
 * #
 * cdef class Rect:             # <<<<<<<<<<<<<<
 *     cdef int x0, y0, x1, y1, cx, cy, _w, _h
 * 
 */
struct __pyx_obj_3efl_4evas_Rect {
  PyObject_HEAD
  int x0;
  int y0;
  int x1;
  int y1;
  int cx;
  int cy;
  int _w;
  int _h;
};


/* "include/efl.evas.pxd":1165
 * 
 * 
 * cdef class Canvas(Eo):             # <<<<<<<<<<<<<<
 *     cdef list _event_callbacks
 * 
 */
struct __pyx_obj_3efl_4evas_Canvas {
  struct __pyx_obj_3efl_2eo_Eo __pyx_base;
  PyObject *_event_callbacks;
};


/* "include/efl.evas.pxd":1169
 * 
 * 
 * cdef class Map(object):             # <<<<<<<<<<<<<<
 *     cdef Evas_Map *map
 * 
 */
struct __pyx_obj_3efl_4evas_Map {
  PyObject_HEAD
  Evas_Map *map;
};


/* "include/efl.evas.pxd":1173
 * 
 * 
 * cdef class Object(Eo):             # <<<<<<<<<<<<<<
 *     cdef list _event_callbacks
 *     cdef int _set_properties_from_keyword_args(self, dict) except 0
 */
struct __pyx_obj_3efl_4evas_Object {
  struct __pyx_obj_3efl_2eo_Eo __pyx_base;
  PyObject *_event_callbacks;
};


/* "include/efl.evas.pxd":1177
 *     cdef int _set_properties_from_keyword_args(self, dict) except 0
 * 
 * cdef class Rectangle(Object):             # <<<<<<<<<<<<<<
 *     pass
 * 
 */
struct __pyx_obj_3efl_4evas_Rectangle {
  struct __pyx_obj_3efl_4evas_Object __pyx_base;
};


/* "include/efl.evas.pxd":1181
 * 
 * 
 * cdef class Line(Object):             # <<<<<<<<<<<<<<
 *     pass
 * 
 */
struct __pyx_obj_3efl_4evas_Line {
  struct __pyx_obj_3efl_4evas_Object __pyx_base;
};


/* "include/efl.evas.pxd":1185
 * 
 * 
 * cdef class Image(Object):             # <<<<<<<<<<<<<<
 *     pass
 * 
 */
struct __pyx_obj_3efl_4evas_Image {
  struct __pyx_obj_3efl_4evas_Object __pyx_base;
};


/* "include/efl.evas.pxd":1189
 * 
 * 
 * cdef class FilledImage(Image):             # <<<<<<<<<<<<<<
 *     pass
 * 
 */
struct __pyx_obj_3efl_4evas_FilledImage {
  struct __pyx_obj_3efl_4evas_Image __pyx_base;
};


/* "include/efl.evas.pxd":1193
 * 
 * 
 * cdef class Polygon(Object):             # <<<<<<<<<<<<<<
 *     pass
 * 
 */
struct __pyx_obj_3efl_4evas_Polygon {
  struct __pyx_obj_3efl_4evas_Object __pyx_base;
};


/* "include/efl.evas.pxd":1197
 * 
 * 
 * cdef class Text(Object):             # <<<<<<<<<<<<<<
 *     pass
 * 
 */
struct __pyx_obj_3efl_4evas_Text {
  struct __pyx_obj_3efl_4evas_Object __pyx_base;
};


/* "include/efl.evas.pxd":1201
 * 
 * 
 * cdef class Textblock(Object):             # <<<<<<<<<<<<<<
 *     pass
 * 
 */
struct __pyx_obj_3efl_4evas_Textblock {
  struct __pyx_obj_3efl_4evas_Object __pyx_base;
};


/* "include/efl.evas.pxd":1223
 * 
 * 
 * cdef class EventPoint:             # <<<<<<<<<<<<<<
 *     cdef Evas_Point *obj
 * 
 */
struct __pyx_obj_3efl_4evas_EventPoint {
  PyObject_HEAD
  struct __pyx_vtabstruct_3efl_4evas_EventPoint *__pyx_vtab;
  Evas_Point *obj;
};


/* "include/efl.evas.pxd":1231
 * 
 * 
 * cdef class EventCoordPoint:             # <<<<<<<<<<<<<<
 *     cdef Evas_Coord_Point *obj
 * 
 */
struct __pyx_obj_3efl_4evas_EventCoordPoint {
  PyObject_HEAD
  struct __pyx_vtabstruct_3efl_4evas_EventCoordPoint *__pyx_vtab;
  Evas_Coord_Point *obj;
};


/* "include/efl.evas.pxd":1239
 * 
 * 
 * cdef class EventPrecisionPoint:             # <<<<<<<<<<<<<<
 *     cdef Evas_Coord_Precision_Point *obj
 * 
 */
struct __pyx_obj_3efl_4evas_EventPrecisionPoint {
  PyObject_HEAD
  struct __pyx_vtabstruct_3efl_4evas_EventPrecisionPoint *__pyx_vtab;
  Evas_Coord_Precision_Point *obj;
};


/* "include/efl.evas.pxd":1247
 * 
 * 
 * cdef class EventPosition:             # <<<<<<<<<<<<<<
 *     cdef readonly EventPoint output
 *     cdef readonly EventCoordPoint canvas
 */
struct __pyx_obj_3efl_4evas_EventPosition {
  PyObject_HEAD
  struct __pyx_vtabstruct_3efl_4evas_EventPosition *__pyx_vtab;
  struct __pyx_obj_3efl_4evas_EventPoint *output;
  struct __pyx_obj_3efl_4evas_EventCoordPoint *canvas;
};


/* "include/efl.evas.pxd":1255
 * 
 * 
 * cdef class EventPrecisionPosition:             # <<<<<<<<<<<<<<
 *     cdef readonly EventPoint output
 *     cdef readonly EventPrecisionPoint canvas
 */
struct __pyx_obj_3efl_4evas_EventPrecisionPosition {
  PyObject_HEAD
  struct __pyx_vtabstruct_3efl_4evas_EventPrecisionPosition *__pyx_vtab;
  struct __pyx_obj_3efl_4evas_EventPoint *output;
  struct __pyx_obj_3efl_4evas_EventPrecisionPoint *canvas;
};


/* "include/efl.evas.pxd":1263
 * 
 * 
 * cdef class EventMouseIn:             # <<<<<<<<<<<<<<
 *     cdef Evas_Event_Mouse_In *obj
 *     cdef readonly EventPosition position
 */
struct __pyx_obj_3efl_4evas_EventMouseIn {
  PyObject_HEAD
  struct __pyx_vtabstruct_3efl_4evas_EventMouseIn *__pyx_vtab;
  Evas_Event_Mouse_In *obj;
  struct __pyx_obj_3efl_4evas_EventPosition *position;
};


/* "include/efl.evas.pxd":1272
 * 
 * 
 * cdef class EventMouseOut:             # <<<<<<<<<<<<<<
 *     cdef Evas_Event_Mouse_Out *obj
 *     cdef readonly EventPosition position
 */
struct __pyx_obj_3efl_4evas_EventMouseOut {
  PyObject_HEAD
  struct __pyx_vtabstruct_3efl_4evas_EventMouseOut *__pyx_vtab;
  Evas_Event_Mouse_Out *obj;
  struct __pyx_obj_3efl_4evas_EventPosition *position;
};


/* "include/efl.evas.pxd":1281
 * 
 * 
 * cdef class EventMouseDown:             # <<<<<<<<<<<<<<
 *     cdef Evas_Event_Mouse_Down *obj
 *     cdef readonly EventPosition position
 */
struct __pyx_obj_3efl_4evas_EventMouseDown {
  PyObject_HEAD
  struct __pyx_vtabstruct_3efl_4evas_EventMouseDown *__pyx_vtab;
  Evas_Event_Mouse_Down *obj;
  struct __pyx_obj_3efl_4evas_EventPosition *position;
};


/* "include/efl.evas.pxd":1290
 * 
 * 
 * cdef class EventMouseUp:             # <<<<<<<<<<<<<<
 *     cdef Evas_Event_Mouse_Up *obj
 *     cdef readonly EventPosition position
 */
struct __pyx_obj_3efl_4evas_EventMouseUp {
  PyObject_HEAD
  struct __pyx_vtabstruct_3efl_4evas_EventMouseUp *__pyx_vtab;
  Evas_Event_Mouse_Up *obj;
  struct __pyx_obj_3efl_4evas_EventPosition *position;
};


/* "include/efl.evas.pxd":1299
 * 
 * 
 * cdef class EventMouseMove:             # <<<<<<<<<<<<<<
 *     cdef Evas_Event_Mouse_Move *obj
 *     cdef readonly EventPosition position
 */
struct __pyx_obj_3efl_4evas_EventMouseMove {
  PyObject_HEAD
  struct __pyx_vtabstruct_3efl_4evas_EventMouseMove *__pyx_vtab;
  Evas_Event_Mouse_Move *obj;
  struct __pyx_obj_3efl_4evas_EventPosition *position;
  struct __pyx_obj_3efl_4evas_EventPosition *prev_position;
};


/* "include/efl.evas.pxd":1309
 * 
 * 
 * cdef class EventMultiDown:             # <<<<<<<<<<<<<<
 *     cdef Evas_Event_Multi_Down *obj
 *     cdef readonly EventPrecisionPosition position
 */
struct __pyx_obj_3efl_4evas_EventMultiDown {
  PyObject_HEAD
  struct __pyx_vtabstruct_3efl_4evas_EventMultiDown *__pyx_vtab;
  Evas_Event_Multi_Down *obj;
  struct __pyx_obj_3efl_4evas_EventPrecisionPosition *position;
};


/* "include/efl.evas.pxd":1318
 * 
 * 
 * cdef class EventMultiUp:             # <<<<<<<<<<<<<<
 *     cdef Evas_Event_Multi_Up *obj
 *     cdef readonly EventPrecisionPosition position
 */
struct __pyx_obj_3efl_4evas_EventMultiUp {
  PyObject_HEAD
  struct __pyx_vtabstruct_3efl_4evas_EventMultiUp *__pyx_vtab;
  Evas_Event_Multi_Up *obj;
  struct __pyx_obj_3efl_4evas_EventPrecisionPosition *position;
};


/* "include/efl.evas.pxd":1327
 * 
 * 
 * cdef class EventMultiMove:             # <<<<<<<<<<<<<<
 *     cdef Evas_Event_Multi_Move *obj
 *     cdef readonly EventPrecisionPosition position
 */
struct __pyx_obj_3efl_4evas_EventMultiMove {
  PyObject_HEAD
  struct __pyx_vtabstruct_3efl_4evas_EventMultiMove *__pyx_vtab;
  Evas_Event_Multi_Move *obj;
  struct __pyx_obj_3efl_4evas_EventPrecisionPosition *position;
};


/* "include/efl.evas.pxd":1336
 * 
 * 
 * cdef class EventMouseWheel:             # <<<<<<<<<<<<<<
 *     cdef Evas_Event_Mouse_Wheel *obj
 *     cdef readonly EventPosition position
 */
struct __pyx_obj_3efl_4evas_EventMouseWheel {
  PyObject_HEAD
  struct __pyx_vtabstruct_3efl_4evas_EventMouseWheel *__pyx_vtab;
  Evas_Event_Mouse_Wheel *obj;
  struct __pyx_obj_3efl_4evas_EventPosition *position;
};


/* "include/efl.evas.pxd":1345
 * 
 * 
 * cdef class EventKeyDown:             # <<<<<<<<<<<<<<
 *     cdef Evas_Event_Key_Down *obj
 * 
 */
struct __pyx_obj_3efl_4evas_EventKeyDown {
  PyObject_HEAD
  struct __pyx_vtabstruct_3efl_4evas_EventKeyDown *__pyx_vtab;
  Evas_Event_Key_Down *obj;
};


/* "include/efl.evas.pxd":1353
 * 
 * 
 * cdef class EventKeyUp:             # <<<<<<<<<<<<<<
 *     cdef Evas_Event_Key_Up *obj
 * 
 */
struct __pyx_obj_3efl_4evas_EventKeyUp {
  PyObject_HEAD
  struct __pyx_vtabstruct_3efl_4evas_EventKeyUp *__pyx_vtab;
  Evas_Event_Key_Up *obj;
};


/* "include/efl.evas.pxd":1361
 * 
 * 
 * cdef class EventHold:             # <<<<<<<<<<<<<<
 *     cdef Evas_Event_Hold *obj
 * 
 */
struct __pyx_obj_3efl_4evas_EventHold {
  PyObject_HEAD
  struct __pyx_vtabstruct_3efl_4evas_EventHold *__pyx_vtab;
  Evas_Event_Hold *obj;
};


/* "object.pxd":224
 * 
 * 
 * cdef class Canvas(evasCanvas):             # <<<<<<<<<<<<<<
 *     pass
 * 
 */
struct __pyx_obj_3efl_10elementary_6object_Canvas {
  struct __pyx_obj_3efl_4evas_Canvas __pyx_base;
};


/* "object.pxd":227
 *     pass
 * 
 * cdef class Object(evasObject):             # <<<<<<<<<<<<<<
 *     cdef:
 *         dict _elmcallbacks
 */
struct __pyx_obj_3efl_10elementary_6object_Object {
  struct __pyx_obj_3efl_4evas_Object __pyx_base;
  PyObject *_elmcallbacks;
  PyObject *_elm_event_cbs;
  PyObject *_elm_signal_cbs;
  PyObject *cnp_drop_cb;
  PyObject *cnp_drop_data;
  PyObject *cnp_selection_loss_cb;
  PyObject *cnp_selection_loss_data;
};


/* "layout_class.pxd":64
 *     Evas_Object *   elm_layout_end_get(const Evas_Object *obj)
 * 
 * cdef class LayoutClass(Object):             # <<<<<<<<<<<<<<
 *     cdef object _elm_layout_signal_cbs
 */
struct __pyx_obj_3efl_10elementary_12layout_class_LayoutClass {
  struct __pyx_obj_3efl_10elementary_6object_Object __pyx_base;
  PyObject *_elm_layout_signal_cbs;
};


/* "efl/elementary/bubble.pyx":113
 * 
 * 
 * cdef class Bubble(LayoutClass):             # <<<<<<<<<<<<<<
 *     """
 * 
 */
struct __pyx_obj_3efl_10elementary_6bubble_Bubble {
  struct __pyx_obj_3efl_10elementary_12layout_class_LayoutClass __pyx_base;
};



/* "include/efl.eo.pxd":21
 * 
 * cdef:
 *     class Eo(object):             # <<<<<<<<<<<<<<
 *         cdef:
 *             cEo *obj
 */

struct __pyx_vtabstruct_3efl_2eo_Eo {
  int (*_set_obj)(struct __pyx_obj_3efl_2eo_Eo *, Eo *);
  int (*_set_properties_from_keyword_args)(struct __pyx_obj_3efl_2eo_Eo *, PyObject *);
};
static struct __pyx_vtabstruct_3efl_2eo_Eo *__pyx_vtabptr_3efl_2eo_Eo;


/* "include/efl.evas.pxd":1165
 * 
 * 
 * cdef class Canvas(Eo):             # <<<<<<<<<<<<<<
 *     cdef list _event_callbacks
 * 
 */

struct __pyx_vtabstruct_3efl_4evas_Canvas {
  struct __pyx_vtabstruct_3efl_2eo_Eo __pyx_base;
};
static struct __pyx_vtabstruct_3efl_4evas_Canvas *__pyx_vtabptr_3efl_4evas_Canvas;


/* "include/efl.evas.pxd":1173
 * 
 * 
 * cdef class Object(Eo):             # <<<<<<<<<<<<<<
 *     cdef list _event_callbacks
 *     cdef int _set_properties_from_keyword_args(self, dict) except 0
 */

struct __pyx_vtabstruct_3efl_4evas_Object {
  struct __pyx_vtabstruct_3efl_2eo_Eo __pyx_base;
};
static struct __pyx_vtabstruct_3efl_4evas_Object *__pyx_vtabptr_3efl_4evas_Object;


/* "include/efl.evas.pxd":1177
 *     cdef int _set_properties_from_keyword_args(self, dict) except 0
 * 
 * cdef class Rectangle(Object):             # <<<<<<<<<<<<<<
 *     pass
 * 
 */

struct __pyx_vtabstruct_3efl_4evas_Rectangle {
  struct __pyx_vtabstruct_3efl_4evas_Object __pyx_base;
};
static struct __pyx_vtabstruct_3efl_4evas_Rectangle *__pyx_vtabptr_3efl_4evas_Rectangle;


/* "include/efl.evas.pxd":1181
 * 
 * 
 * cdef class Line(Object):             # <<<<<<<<<<<<<<
 *     pass
 * 
 */

struct __pyx_vtabstruct_3efl_4evas_Line {
  struct __pyx_vtabstruct_3efl_4evas_Object __pyx_base;
};
static struct __pyx_vtabstruct_3efl_4evas_Line *__pyx_vtabptr_3efl_4evas_Line;


/* "include/efl.evas.pxd":1185
 * 
 * 
 * cdef class Image(Object):             # <<<<<<<<<<<<<<
 *     pass
 * 
 */

struct __pyx_vtabstruct_3efl_4evas_Image {
  struct __pyx_vtabstruct_3efl_4evas_Object __pyx_base;
};
static struct __pyx_vtabstruct_3efl_4evas_Image *__pyx_vtabptr_3efl_4evas_Image;


/* "include/efl.evas.pxd":1189
 * 
 * 
 * cdef class FilledImage(Image):             # <<<<<<<<<<<<<<
 *     pass
 * 
 */

struct __pyx_vtabstruct_3efl_4evas_FilledImage {
  struct __pyx_vtabstruct_3efl_4evas_Image __pyx_base;
};
static struct __pyx_vtabstruct_3efl_4evas_FilledImage *__pyx_vtabptr_3efl_4evas_FilledImage;


/* "include/efl.evas.pxd":1193
 * 
 * 
 * cdef class Polygon(Object):             # <<<<<<<<<<<<<<
 *     pass
 * 
 */

struct __pyx_vtabstruct_3efl_4evas_Polygon {
  struct __pyx_vtabstruct_3efl_4evas_Object __pyx_base;
};
static struct __pyx_vtabstruct_3efl_4evas_Polygon *__pyx_vtabptr_3efl_4evas_Polygon;


/* "include/efl.evas.pxd":1197
 * 
 * 
 * cdef class Text(Object):             # <<<<<<<<<<<<<<
 *     pass
 * 
 */

struct __pyx_vtabstruct_3efl_4evas_Text {
  struct __pyx_vtabstruct_3efl_4evas_Object __pyx_base;
};
static struct __pyx_vtabstruct_3efl_4evas_Text *__pyx_vtabptr_3efl_4evas_Text;


/* "include/efl.evas.pxd":1201
 * 
 * 
 * cdef class Textblock(Object):             # <<<<<<<<<<<<<<
 *     pass
 * 
 */

struct __pyx_vtabstruct_3efl_4evas_Textblock {
  struct __pyx_vtabstruct_3efl_4evas_Object __pyx_base;
};
static struct __pyx_vtabstruct_3efl_4evas_Textblock *__pyx_vtabptr_3efl_4evas_Textblock;


/* "include/efl.evas.pxd":1223
 * 
 * 
 * cdef class EventPoint:             # <<<<<<<<<<<<<<
 *     cdef Evas_Point *obj
 * 
 */

struct __pyx_vtabstruct_3efl_4evas_EventPoint {
  void (*_set_obj)(struct __pyx_obj_3efl_4evas_EventPoint *, Evas_Point *);
  void (*_unset_obj)(struct __pyx_obj_3efl_4evas_EventPoint *);
  int (*_check_validity)(struct __pyx_obj_3efl_4evas_EventPoint *);
};
static struct __pyx_vtabstruct_3efl_4evas_EventPoint *__pyx_vtabptr_3efl_4evas_EventPoint;


/* "include/efl.evas.pxd":1231
 * 
 * 
 * cdef class EventCoordPoint:             # <<<<<<<<<<<<<<
 *     cdef Evas_Coord_Point *obj
 * 
 */

struct __pyx_vtabstruct_3efl_4evas_EventCoordPoint {
  void (*_set_obj)(struct __pyx_obj_3efl_4evas_EventCoordPoint *, Evas_Coord_Point *);
  void (*_unset_obj)(struct __pyx_obj_3efl_4evas_EventCoordPoint *);
  int (*_check_validity)(struct __pyx_obj_3efl_4evas_EventCoordPoint *);
};
static struct __pyx_vtabstruct_3efl_4evas_EventCoordPoint *__pyx_vtabptr_3efl_4evas_EventCoordPoint;


/* "include/efl.evas.pxd":1239
 * 
 * 
 * cdef class EventPrecisionPoint:             # <<<<<<<<<<<<<<
 *     cdef Evas_Coord_Precision_Point *obj
 * 
 */

struct __pyx_vtabstruct_3efl_4evas_EventPrecisionPoint {
  void (*_set_obj)(struct __pyx_obj_3efl_4evas_EventPrecisionPoint *, Evas_Coord_Precision_Point *);
  void (*_unset_obj)(struct __pyx_obj_3efl_4evas_EventPrecisionPoint *);
  int (*_check_validity)(struct __pyx_obj_3efl_4evas_EventPrecisionPoint *);
};
static struct __pyx_vtabstruct_3efl_4evas_EventPrecisionPoint *__pyx_vtabptr_3efl_4evas_EventPrecisionPoint;


/* "include/efl.evas.pxd":1247
 * 
 * 
 * cdef class EventPosition:             # <<<<<<<<<<<<<<
 *     cdef readonly EventPoint output
 *     cdef readonly EventCoordPoint canvas
 */

struct __pyx_vtabstruct_3efl_4evas_EventPosition {
  void (*_set_objs)(struct __pyx_obj_3efl_4evas_EventPosition *, Evas_Point *, Evas_Coord_Point *);
  void (*_unset_objs)(struct __pyx_obj_3efl_4evas_EventPosition *);
};
static struct __pyx_vtabstruct_3efl_4evas_EventPosition *__pyx_vtabptr_3efl_4evas_EventPosition;


/* "include/efl.evas.pxd":1255
 * 
 * 
 * cdef class EventPrecisionPosition:             # <<<<<<<<<<<<<<
 *     cdef readonly EventPoint output
 *     cdef readonly EventPrecisionPoint canvas
 */

struct __pyx_vtabstruct_3efl_4evas_EventPrecisionPosition {
  void (*_set_objs)(struct __pyx_obj_3efl_4evas_EventPrecisionPosition *, Evas_Point *, Evas_Coord_Precision_Point *);
  void (*_unset_objs)(struct __pyx_obj_3efl_4evas_EventPrecisionPosition *);
};
static struct __pyx_vtabstruct_3efl_4evas_EventPrecisionPosition *__pyx_vtabptr_3efl_4evas_EventPrecisionPosition;


/* "include/efl.evas.pxd":1263
 * 
 * 
 * cdef class EventMouseIn:             # <<<<<<<<<<<<<<
 *     cdef Evas_Event_Mouse_In *obj
 *     cdef readonly EventPosition position
 */

struct __pyx_vtabstruct_3efl_4evas_EventMouseIn {
  void (*_set_obj)(struct __pyx_obj_3efl_4evas_EventMouseIn *, void *);
  void (*_unset_obj)(struct __pyx_obj_3efl_4evas_EventMouseIn *);
  int (*_check_validity)(struct __pyx_obj_3efl_4evas_EventMouseIn *);
};
static struct __pyx_vtabstruct_3efl_4evas_EventMouseIn *__pyx_vtabptr_3efl_4evas_EventMouseIn;


/* "include/efl.evas.pxd":1272
 * 
 * 
 * cdef class EventMouseOut:             # <<<<<<<<<<<<<<
 *     cdef Evas_Event_Mouse_Out *obj
 *     cdef readonly EventPosition position
 */

struct __pyx_vtabstruct_3efl_4evas_EventMouseOut {
  void (*_set_obj)(struct __pyx_obj_3efl_4evas_EventMouseOut *, void *);
  void (*_unset_obj)(struct __pyx_obj_3efl_4evas_EventMouseOut *);
  int (*_check_validity)(struct __pyx_obj_3efl_4evas_EventMouseOut *);
};
static struct __pyx_vtabstruct_3efl_4evas_EventMouseOut *__pyx_vtabptr_3efl_4evas_EventMouseOut;


/* "include/efl.evas.pxd":1281
 * 
 * 
 * cdef class EventMouseDown:             # <<<<<<<<<<<<<<
 *     cdef Evas_Event_Mouse_Down *obj
 *     cdef readonly EventPosition position
 */

struct __pyx_vtabstruct_3efl_4evas_EventMouseDown {
  void (*_set_obj)(struct __pyx_obj_3efl_4evas_EventMouseDown *, void *);
  void (*_unset_obj)(struct __pyx_obj_3efl_4evas_EventMouseDown *);
  int (*_check_validity)(struct __pyx_obj_3efl_4evas_EventMouseDown *);
};
static struct __pyx_vtabstruct_3efl_4evas_EventMouseDown *__pyx_vtabptr_3efl_4evas_EventMouseDown;


/* "include/efl.evas.pxd":1290
 * 
 * 
 * cdef class EventMouseUp:             # <<<<<<<<<<<<<<
 *     cdef Evas_Event_Mouse_Up *obj
 *     cdef readonly EventPosition position
 */

struct __pyx_vtabstruct_3efl_4evas_EventMouseUp {
  void (*_set_obj)(struct __pyx_obj_3efl_4evas_EventMouseUp *, void *);
  void (*_unset_obj)(struct __pyx_obj_3efl_4evas_EventMouseUp *);
  int (*_check_validity)(struct __pyx_obj_3efl_4evas_EventMouseUp *);
};
static struct __pyx_vtabstruct_3efl_4evas_EventMouseUp *__pyx_vtabptr_3efl_4evas_EventMouseUp;


/* "include/efl.evas.pxd":1299
 * 
 * 
 * cdef class EventMouseMove:             # <<<<<<<<<<<<<<
 *     cdef Evas_Event_Mouse_Move *obj
 *     cdef readonly EventPosition position
 */

struct __pyx_vtabstruct_3efl_4evas_EventMouseMove {
  void (*_set_obj)(struct __pyx_obj_3efl_4evas_EventMouseMove *, void *);
  void (*_unset_obj)(struct __pyx_obj_3efl_4evas_EventMouseMove *);
  int (*_check_validity)(struct __pyx_obj_3efl_4evas_EventMouseMove *);
};
static struct __pyx_vtabstruct_3efl_4evas_EventMouseMove *__pyx_vtabptr_3efl_4evas_EventMouseMove;


/* "include/efl.evas.pxd":1309
 * 
 * 
 * cdef class EventMultiDown:             # <<<<<<<<<<<<<<
 *     cdef Evas_Event_Multi_Down *obj
 *     cdef readonly EventPrecisionPosition position
 */

struct __pyx_vtabstruct_3efl_4evas_EventMultiDown {
  void (*_set_obj)(struct __pyx_obj_3efl_4evas_EventMultiDown *, void *);
  void (*_unset_obj)(struct __pyx_obj_3efl_4evas_EventMultiDown *);
  int (*_check_validity)(struct __pyx_obj_3efl_4evas_EventMultiDown *);
};
static struct __pyx_vtabstruct_3efl_4evas_EventMultiDown *__pyx_vtabptr_3efl_4evas_EventMultiDown;


/* "include/efl.evas.pxd":1318
 * 
 * 
 * cdef class EventMultiUp:             # <<<<<<<<<<<<<<
 *     cdef Evas_Event_Multi_Up *obj
 *     cdef readonly EventPrecisionPosition position
 */

struct __pyx_vtabstruct_3efl_4evas_EventMultiUp {
  void (*_set_obj)(struct __pyx_obj_3efl_4evas_EventMultiUp *, void *);
  void (*_unset_obj)(struct __pyx_obj_3efl_4evas_EventMultiUp *);
  int (*_check_validity)(struct __pyx_obj_3efl_4evas_EventMultiUp *);
};
static struct __pyx_vtabstruct_3efl_4evas_EventMultiUp *__pyx_vtabptr_3efl_4evas_EventMultiUp;


/* "include/efl.evas.pxd":1327
 * 
 * 
 * cdef class EventMultiMove:             # <<<<<<<<<<<<<<
 *     cdef Evas_Event_Multi_Move *obj
 *     cdef readonly EventPrecisionPosition position
 */

struct __pyx_vtabstruct_3efl_4evas_EventMultiMove {
  void (*_set_obj)(struct __pyx_obj_3efl_4evas_EventMultiMove *, void *);
  void (*_unset_obj)(struct __pyx_obj_3efl_4evas_EventMultiMove *);
  int (*_check_validity)(struct __pyx_obj_3efl_4evas_EventMultiMove *);
};
static struct __pyx_vtabstruct_3efl_4evas_EventMultiMove *__pyx_vtabptr_3efl_4evas_EventMultiMove;


/* "include/efl.evas.pxd":1336
 * 
 * 
 * cdef class EventMouseWheel:             # <<<<<<<<<<<<<<
 *     cdef Evas_Event_Mouse_Wheel *obj
 *     cdef readonly EventPosition position
 */

struct __pyx_vtabstruct_3efl_4evas_EventMouseWheel {
  void (*_set_obj)(struct __pyx_obj_3efl_4evas_EventMouseWheel *, void *);
  void (*_unset_obj)(struct __pyx_obj_3efl_4evas_EventMouseWheel *);
  int (*_check_validity)(struct __pyx_obj_3efl_4evas_EventMouseWheel *);
};
static struct __pyx_vtabstruct_3efl_4evas_EventMouseWheel *__pyx_vtabptr_3efl_4evas_EventMouseWheel;


/* "include/efl.evas.pxd":1345
 * 
 * 
 * cdef class EventKeyDown:             # <<<<<<<<<<<<<<
 *     cdef Evas_Event_Key_Down *obj
 * 
 */

struct __pyx_vtabstruct_3efl_4evas_EventKeyDown {
  void (*_set_obj)(struct __pyx_obj_3efl_4evas_EventKeyDown *, void *);
  void (*_unset_obj)(struct __pyx_obj_3efl_4evas_EventKeyDown *);
  int (*_check_validity)(struct __pyx_obj_3efl_4evas_EventKeyDown *);
};
static struct __pyx_vtabstruct_3efl_4evas_EventKeyDown *__pyx_vtabptr_3efl_4evas_EventKeyDown;


/* "include/efl.evas.pxd":1353
 * 
 * 
 * cdef class EventKeyUp:             # <<<<<<<<<<<<<<
 *     cdef Evas_Event_Key_Up *obj
 * 
 */

struct __pyx_vtabstruct_3efl_4evas_EventKeyUp {
  void (*_set_obj)(struct __pyx_obj_3efl_4evas_EventKeyUp *, void *);
  void (*_unset_obj)(struct __pyx_obj_3efl_4evas_EventKeyUp *);
  int (*_check_validity)(struct __pyx_obj_3efl_4evas_EventKeyUp *);
};
static struct __pyx_vtabstruct_3efl_4evas_EventKeyUp *__pyx_vtabptr_3efl_4evas_EventKeyUp;


/* "include/efl.evas.pxd":1361
 * 
 * 
 * cdef class EventHold:             # <<<<<<<<<<<<<<
 *     cdef Evas_Event_Hold *obj
 * 
 */

struct __pyx_vtabstruct_3efl_4evas_EventHold {
  void (*_set_obj)(struct __pyx_obj_3efl_4evas_EventHold *, void *);
  void (*_unset_obj)(struct __pyx_obj_3efl_4evas_EventHold *);
  int (*_check_validity)(struct __pyx_obj_3efl_4evas_EventHold *);
};
static struct __pyx_vtabstruct_3efl_4evas_EventHold *__pyx_vtabptr_3efl_4evas_EventHold;


/* "object.pxd":224
 * 
 * 
 * cdef class Canvas(evasCanvas):             # <<<<<<<<<<<<<<
 *     pass
 * 
 */

struct __pyx_vtabstruct_3efl_10elementary_6object_Canvas {
  struct __pyx_vtabstruct_3efl_4evas_Canvas __pyx_base;
};
static struct __pyx_vtabstruct_3efl_10elementary_6object_Canvas *__pyx_vtabptr_3efl_10elementary_6object_Canvas;


/* "object.pxd":227
 *     pass
 * 
 * cdef class Object(evasObject):             # <<<<<<<<<<<<<<
 *     cdef:
 *         dict _elmcallbacks
 */

struct __pyx_vtabstruct_3efl_10elementary_6object_Object {
  struct __pyx_vtabstruct_3efl_4evas_Object __pyx_base;
};
static struct __pyx_vtabstruct_3efl_10elementary_6object_Object *__pyx_vtabptr_3efl_10elementary_6object_Object;


/* "layout_class.pxd":64
 *     Evas_Object *   elm_layout_end_get(const Evas_Object *obj)
 * 
 * cdef class LayoutClass(Object):             # <<<<<<<<<<<<<<
 *     cdef object _elm_layout_signal_cbs
 */

struct __pyx_vtabstruct_3efl_10elementary_12layout_class_LayoutClass {
  struct __pyx_vtabstruct_3efl_10elementary_6object_Object __pyx_base;
};
static struct __pyx_vtabstruct_3efl_10elementary_12layout_class_LayoutClass *__pyx_vtabptr_3efl_10elementary_12layout_class_LayoutClass;


/* "efl/elementary/bubble.pyx":113
 * 
 * 
 * cdef class Bubble(LayoutClass):             # <<<<<<<<<<<<<<
 *     """
 * 
 */

struct __pyx_vtabstruct_3efl_10elementary_6bubble_Bubble {
  struct __pyx_vtabstruct_3efl_10elementary_12layout_class_LayoutClass __pyx_base;
};
static struct __pyx_vtabstruct_3efl_10elementary_6bubble_Bubble *__pyx_vtabptr_3efl_10elementary_6bubble_Bubble;
#ifndef CYTHON_REFNANNY
  #define CYTHON_REFNANNY 0
#endif
#if CYTHON_REFNANNY
  typedef struct {
    void (*INCREF)(void*, PyObject*, int);
    void (*DECREF)(void*, PyObject*, int);
    void (*GOTREF)(void*, PyObject*, int);
    void (*GIVEREF)(void*, PyObject*, int);
    void* (*SetupContext)(const char*, int, const char*);
    void (*FinishContext)(void**);
  } __Pyx_RefNannyAPIStruct;
  static __Pyx_RefNannyAPIStruct *__Pyx_RefNanny = NULL;
  static __Pyx_RefNannyAPIStruct *__Pyx_RefNannyImportAPI(const char *modname);
  #define __Pyx_RefNannyDeclarations void *__pyx_refnanny = NULL;
#ifdef WITH_THREAD
  #define __Pyx_RefNannySetupContext(name, acquire_gil) \
          if (acquire_gil) { \
              PyGILState_STATE __pyx_gilstate_save = PyGILState_Ensure(); \
              __pyx_refnanny = __Pyx_RefNanny->SetupContext((name), __LINE__, __FILE__); \
              PyGILState_Release(__pyx_gilstate_save); \
          } else { \
              __pyx_refnanny = __Pyx_RefNanny->SetupContext((name), __LINE__, __FILE__); \
          }
#else
  #define __Pyx_RefNannySetupContext(name, acquire_gil) \
          __pyx_refnanny = __Pyx_RefNanny->SetupContext((name), __LINE__, __FILE__)
#endif
  #define __Pyx_RefNannyFinishContext() \
          __Pyx_RefNanny->FinishContext(&__pyx_refnanny)
  #define __Pyx_INCREF(r)  __Pyx_RefNanny->INCREF(__pyx_refnanny, (PyObject *)(r), __LINE__)
  #define __Pyx_DECREF(r)  __Pyx_RefNanny->DECREF(__pyx_refnanny, (PyObject *)(r), __LINE__)
  #define __Pyx_GOTREF(r)  __Pyx_RefNanny->GOTREF(__pyx_refnanny, (PyObject *)(r), __LINE__)
  #define __Pyx_GIVEREF(r) __Pyx_RefNanny->GIVEREF(__pyx_refnanny, (PyObject *)(r), __LINE__)
  #define __Pyx_XINCREF(r)  do { if((r) != NULL) {__Pyx_INCREF(r); }} while(0)
  #define __Pyx_XDECREF(r)  do { if((r) != NULL) {__Pyx_DECREF(r); }} while(0)
  #define __Pyx_XGOTREF(r)  do { if((r) != NULL) {__Pyx_GOTREF(r); }} while(0)
  #define __Pyx_XGIVEREF(r) do { if((r) != NULL) {__Pyx_GIVEREF(r);}} while(0)
#else
  #define __Pyx_RefNannyDeclarations
  #define __Pyx_RefNannySetupContext(name, acquire_gil)
  #define __Pyx_RefNannyFinishContext()
  #define __Pyx_INCREF(r) Py_INCREF(r)
  #define __Pyx_DECREF(r) Py_DECREF(r)
  #define __Pyx_GOTREF(r)
  #define __Pyx_GIVEREF(r)
  #define __Pyx_XINCREF(r) Py_XINCREF(r)
  #define __Pyx_XDECREF(r) Py_XDECREF(r)
  #define __Pyx_XGOTREF(r)
  #define __Pyx_XGIVEREF(r)
#endif
#define __Pyx_XDECREF_SET(r, v) do {                            \
        PyObject *tmp = (PyObject *) r;                         \
        r = v; __Pyx_XDECREF(tmp);                              \
    } while (0)
#define __Pyx_DECREF_SET(r, v) do {                             \
        PyObject *tmp = (PyObject *) r;                         \
        r = v; __Pyx_DECREF(tmp);                               \
    } while (0)
#define __Pyx_CLEAR(r)    do { PyObject* tmp = ((PyObject*)(r)); r = NULL; __Pyx_DECREF(tmp);} while(0)
#define __Pyx_XCLEAR(r)   do { if((r) != NULL) {PyObject* tmp = ((PyObject*)(r)); r = NULL; __Pyx_DECREF(tmp);}} while(0)

static void __Pyx_RaiseDoubleKeywordsError(const char* func_name, PyObject* kw_name);

static int __Pyx_ParseOptionalKeywords(PyObject *kwds, PyObject **argnames[], \
    PyObject *kwds2, PyObject *values[], Py_ssize_t num_pos_args, \
    const char* function_name);

static void __Pyx_RaiseArgtupleInvalid(const char* func_name, int exact,
    Py_ssize_t num_min, Py_ssize_t num_max, Py_ssize_t num_found);

static CYTHON_INLINE int __Pyx_ArgTypeTest(PyObject *obj, PyTypeObject *type, int none_allowed,
    const char *name, int exact);

#if CYTHON_COMPILING_IN_CPYTHON
static CYTHON_INLINE PyObject* __Pyx_PyObject_GetAttrStr(PyObject* obj, PyObject* attr_name) {
    PyTypeObject* tp = Py_TYPE(obj);
    if (likely(tp->tp_getattro))
        return tp->tp_getattro(obj, attr_name);
#if PY_MAJOR_VERSION < 3
    if (likely(tp->tp_getattr))
        return tp->tp_getattr(obj, PyString_AS_STRING(attr_name));
#endif
    return PyObject_GetAttr(obj, attr_name);
}
#else
#define __Pyx_PyObject_GetAttrStr(o,n) PyObject_GetAttr(o,n)
#endif

#if CYTHON_COMPILING_IN_CPYTHON
static CYTHON_INLINE PyObject* __Pyx_PyObject_Call(PyObject *func, PyObject *arg, PyObject *kw);
#else
#define __Pyx_PyObject_Call(func, arg, kw) PyObject_Call(func, arg, kw)
#endif

static void __Pyx_call_next_tp_dealloc(PyObject* obj, destructor current_tp_dealloc);

static int __Pyx_call_next_tp_traverse(PyObject* obj, visitproc v, void *a, traverseproc current_tp_traverse);

static void __Pyx_call_next_tp_clear(PyObject* obj, inquiry current_tp_dealloc);

static void* __Pyx_GetVtable(PyObject *dict);

static int __Pyx_SetVtable(PyObject *dict, void *vtable);

typedef struct {
    int code_line;
    PyCodeObject* code_object;
} __Pyx_CodeObjectCacheEntry;
struct __Pyx_CodeObjectCache {
    int count;
    int max_count;
    __Pyx_CodeObjectCacheEntry* entries;
};
static struct __Pyx_CodeObjectCache __pyx_code_cache = {0,0,NULL};
static int __pyx_bisect_code_objects(__Pyx_CodeObjectCacheEntry* entries, int count, int code_line);
static PyCodeObject *__pyx_find_code_object(int code_line);
static void __pyx_insert_code_object(int code_line, PyCodeObject* code_object);

static void __Pyx_AddTraceback(const char *funcname, int c_line,
                               int py_line, const char *filename);

static CYTHON_INLINE PyObject* __Pyx_PyInt_From_long(long value);

static CYTHON_INLINE long __Pyx_PyInt_As_long(PyObject *);

static CYTHON_INLINE int __Pyx_PyInt_As_int(PyObject *);

static int __Pyx_check_binary_version(void);

#if !defined(__Pyx_PyIdentifier_FromString)
#if PY_MAJOR_VERSION < 3
  #define __Pyx_PyIdentifier_FromString(s) PyString_FromString(s)
#else
  #define __Pyx_PyIdentifier_FromString(s) PyUnicode_FromString(s)
#endif
#endif

static PyObject *__Pyx_ImportModule(const char *name);

static PyTypeObject *__Pyx_ImportType(const char *module_name, const char *class_name, size_t size, int strict);

static int __Pyx_ImportFunction(PyObject *module, const char *funcname, void (**f)(void), const char *sig);

static int __Pyx_InitStrings(__Pyx_StringTabEntry *t);


/* Module declarations from 'cpython.version' */

/* Module declarations from 'cpython.ref' */

/* Module declarations from 'cpython.exc' */

/* Module declarations from 'cpython.module' */

/* Module declarations from 'cpython.mem' */

/* Module declarations from 'cpython.tuple' */

/* Module declarations from 'cpython.list' */

/* Module declarations from 'libc.string' */

/* Module declarations from 'libc.stdio' */

/* Module declarations from 'cpython.object' */

/* Module declarations from 'cpython.sequence' */

/* Module declarations from 'cpython.mapping' */

/* Module declarations from 'cpython.iterator' */

/* Module declarations from '__builtin__' */

/* Module declarations from 'cpython.type' */
static PyTypeObject *__pyx_ptype_7cpython_4type_type = 0;

/* Module declarations from 'cpython.number' */

/* Module declarations from 'cpython.int' */

/* Module declarations from '__builtin__' */

/* Module declarations from 'cpython.bool' */
static PyTypeObject *__pyx_ptype_7cpython_4bool_bool = 0;

/* Module declarations from 'cpython.long' */

/* Module declarations from 'cpython.float' */

/* Module declarations from '__builtin__' */

/* Module declarations from 'cpython.complex' */
static PyTypeObject *__pyx_ptype_7cpython_7complex_complex = 0;

/* Module declarations from 'cpython.string' */

/* Module declarations from 'cpython.unicode' */

/* Module declarations from 'cpython.dict' */

/* Module declarations from 'cpython.instance' */

/* Module declarations from 'cpython.function' */

/* Module declarations from 'cpython.method' */

/* Module declarations from 'cpython.weakref' */

/* Module declarations from 'cpython.getargs' */

/* Module declarations from 'cpython.pythread' */

/* Module declarations from 'cpython.pystate' */

/* Module declarations from 'cpython.cobject' */

/* Module declarations from 'cpython.oldbuffer' */

/* Module declarations from 'cpython.set' */

/* Module declarations from 'cpython.buffer' */

/* Module declarations from 'cpython.bytes' */

/* Module declarations from 'cpython.pycapsule' */

/* Module declarations from 'cpython' */

/* Module declarations from 'efl.eina' */

/* Module declarations from 'efl.c_eo' */

/* Module declarations from 'efl.eo' */
static PyTypeObject *__pyx_ptype_3efl_2eo_Eo = 0;
static void (*__pyx_f_3efl_2eo__object_mapping_register)(char *, PyObject *); /*proto*/
static PyObject *(*__pyx_f_3efl_2eo_object_from_instance)(Eo *); /*proto*/
static Eo *(*__pyx_f_3efl_2eo_instance_from_object)(PyObject *); /*proto*/

/* Module declarations from 'efl.evas' */
static PyTypeObject *__pyx_ptype_3efl_4evas_Rect = 0;
static PyTypeObject *__pyx_ptype_3efl_4evas_Canvas = 0;
static PyTypeObject *__pyx_ptype_3efl_4evas_Map = 0;
static PyTypeObject *__pyx_ptype_3efl_4evas_Object = 0;
static PyTypeObject *__pyx_ptype_3efl_4evas_Rectangle = 0;
static PyTypeObject *__pyx_ptype_3efl_4evas_Line = 0;
static PyTypeObject *__pyx_ptype_3efl_4evas_Image = 0;
static PyTypeObject *__pyx_ptype_3efl_4evas_FilledImage = 0;
static PyTypeObject *__pyx_ptype_3efl_4evas_Polygon = 0;
static PyTypeObject *__pyx_ptype_3efl_4evas_Text = 0;
static PyTypeObject *__pyx_ptype_3efl_4evas_Textblock = 0;
static PyTypeObject *__pyx_ptype_3efl_4evas_EventPoint = 0;
static PyTypeObject *__pyx_ptype_3efl_4evas_EventCoordPoint = 0;
static PyTypeObject *__pyx_ptype_3efl_4evas_EventPrecisionPoint = 0;
static PyTypeObject *__pyx_ptype_3efl_4evas_EventPosition = 0;
static PyTypeObject *__pyx_ptype_3efl_4evas_EventPrecisionPosition = 0;
static PyTypeObject *__pyx_ptype_3efl_4evas_EventMouseIn = 0;
static PyTypeObject *__pyx_ptype_3efl_4evas_EventMouseOut = 0;
static PyTypeObject *__pyx_ptype_3efl_4evas_EventMouseDown = 0;
static PyTypeObject *__pyx_ptype_3efl_4evas_EventMouseUp = 0;
static PyTypeObject *__pyx_ptype_3efl_4evas_EventMouseMove = 0;
static PyTypeObject *__pyx_ptype_3efl_4evas_EventMultiDown = 0;
static PyTypeObject *__pyx_ptype_3efl_4evas_EventMultiUp = 0;
static PyTypeObject *__pyx_ptype_3efl_4evas_EventMultiMove = 0;
static PyTypeObject *__pyx_ptype_3efl_4evas_EventMouseWheel = 0;
static PyTypeObject *__pyx_ptype_3efl_4evas_EventKeyDown = 0;
static PyTypeObject *__pyx_ptype_3efl_4evas_EventKeyUp = 0;
static PyTypeObject *__pyx_ptype_3efl_4evas_EventHold = 0;

/* Module declarations from 'efl.elementary.object' */
static PyTypeObject *__pyx_ptype_3efl_10elementary_6object_Canvas = 0;
static PyTypeObject *__pyx_ptype_3efl_10elementary_6object_Object = 0;

/* Module declarations from 'efl.elementary.layout_class' */
static PyTypeObject *__pyx_ptype_3efl_10elementary_12layout_class_LayoutClass = 0;

/* Module declarations from 'efl.elementary.bubble' */
static PyTypeObject *__pyx_ptype_3efl_10elementary_6bubble_Bubble = 0;
#define __Pyx_MODULE_NAME "efl.elementary.bubble"
int __pyx_module_is_main_efl__elementary__bubble = 0;

/* Implementation of 'efl.elementary.bubble' */
static int __pyx_pf_3efl_10elementary_6bubble_6Bubble___init__(struct __pyx_obj_3efl_10elementary_6bubble_Bubble *__pyx_v_self, struct __pyx_obj_3efl_4evas_Object *__pyx_v_parent, CYTHON_UNUSED PyObject *__pyx_v_args, PyObject *__pyx_v_kwargs); /* proto */
static PyObject *__pyx_pf_3efl_10elementary_6bubble_6Bubble_3pos___get__(struct __pyx_obj_3efl_10elementary_6bubble_Bubble *__pyx_v_self); /* proto */
static int __pyx_pf_3efl_10elementary_6bubble_6Bubble_3pos_2__set__(struct __pyx_obj_3efl_10elementary_6bubble_Bubble *__pyx_v_self, PyObject *__pyx_v_value); /* proto */
static PyObject *__pyx_pf_3efl_10elementary_6bubble_6Bubble_2pos_set(struct __pyx_obj_3efl_10elementary_6bubble_Bubble *__pyx_v_self, PyObject *__pyx_v_pos); /* proto */
static PyObject *__pyx_pf_3efl_10elementary_6bubble_6Bubble_4pos_get(struct __pyx_obj_3efl_10elementary_6bubble_Bubble *__pyx_v_self); /* proto */
static PyObject *__pyx_pf_3efl_10elementary_6bubble_6Bubble_6callback_clicked_add(struct __pyx_obj_3efl_10elementary_6bubble_Bubble *__pyx_v_self, PyObject *__pyx_v_func, PyObject *__pyx_v_args, PyObject *__pyx_v_kwargs); /* proto */
static PyObject *__pyx_pf_3efl_10elementary_6bubble_6Bubble_8callback_clicked_del(struct __pyx_obj_3efl_10elementary_6bubble_Bubble *__pyx_v_self, PyObject *__pyx_v_func); /* proto */
static PyObject *__pyx_pf_3efl_10elementary_6bubble_6Bubble_10callback_focused_add(struct __pyx_obj_3efl_10elementary_6bubble_Bubble *__pyx_v_self, PyObject *__pyx_v_func, PyObject *__pyx_v_args, PyObject *__pyx_v_kwargs); /* proto */
static PyObject *__pyx_pf_3efl_10elementary_6bubble_6Bubble_12callback_focused_del(struct __pyx_obj_3efl_10elementary_6bubble_Bubble *__pyx_v_self, PyObject *__pyx_v_func); /* proto */
static PyObject *__pyx_pf_3efl_10elementary_6bubble_6Bubble_14callback_unfocused_add(struct __pyx_obj_3efl_10elementary_6bubble_Bubble *__pyx_v_self, PyObject *__pyx_v_func, PyObject *__pyx_v_args, PyObject *__pyx_v_kwargs); /* proto */
static PyObject *__pyx_pf_3efl_10elementary_6bubble_6Bubble_16callback_unfocused_del(struct __pyx_obj_3efl_10elementary_6bubble_Bubble *__pyx_v_self, PyObject *__pyx_v_func); /* proto */
static PyObject *__pyx_tp_new_3efl_10elementary_6bubble_Bubble(PyTypeObject *t, PyObject *a, PyObject *k); /*proto*/
static char __pyx_k_func[] = "func";
static char __pyx_k_main[] = "__main__";
static char __pyx_k_test[] = "__test__";
static char __pyx_k_parent[] = "parent";
static char __pyx_k_clicked[] = "clicked";
static char __pyx_k_focused[] = "focused";
static char __pyx_k_unfocused[] = "unfocused";
static char __pyx_k_Elm_Bubble[] = "Elm_Bubble";
static char __pyx_k_pyx_vtable[] = "__pyx_vtable__";
static char __pyx_k_callback_add[] = "_callback_add";
static char __pyx_k_callback_del[] = "_callback_del";
static char __pyx_k_mod_bubble_Module_image_images[] = "\n\n:mod:`bubble` Module\n####################\n\n.. image:: /images/bubble-preview.png\n\n\nWidget description\n==================\n\nThe Bubble is a widget to show text similar to how speech is\nrepresented in comics.\n\nThe bubble widget contains 5 important visual elements:\n\n- The frame is a rectangle with rounded edjes and an \"arrow\".\n- The ``icon`` is an image to which the frame's arrow points to.\n- The ``label`` is a text which appears to the right of the icon if the\n    corner is **top_left** or **bottom_left** and is right aligned to\n    the frame otherwise.\n- The ``info`` is a text which appears to the right of the label. Info's\n    font is of a lighter color than label.\n- The ``content`` is an evas object that is shown inside the frame.\n\nThe position of the arrow, icon, label and info depends on which corner is\nselected. The four available corners are:\n\n- ``top_left`` - Default\n- ``top_right``\n- ``bottom_left``\n- ``bottom_right``\n\n\nLayout content parts\n====================\n\n- ``default`` - A content of the bubble\n- ``icon`` - An icon of the bubble\n\n\nLayout text parts\n=================\n\n- ``default`` - Label of the bubble\n- ``info`` - info of the bubble\n\n\nEmitted signals\n===============\n\n- ``clicked`` - This is called when a user has clicked the bubble.\n- ``focused`` - When the bubble has received focus. (since 1.8)\n- ``unfocused`` - When the bubble has lost focus. (since 1.8)\n\n\nEnumerations\n============\n\n.. _Elm_Bubble_Pos:\n\nBubble arrow positions\n----------------------\n\n.. data:: ELM_BUBBLE_POS_TOP_LEFT\n\n    Top left position\n\n.. data:: ELM_BUBBLE_POS_TOP_RIGHT\n\n    Top right position\n\n.. data:: ELM_BUBBLE_POS_BOTTOM_LEFT\n\n    Bottom left position\n\n.. data:: ELM_BUBBLE_POS_BOTTOM_RIGHT\n\n    Bottom right position\n\n\nInheritance diagram\n===================\n\n.. inheritance-diagram:: efl.elementary.bubble\n    :parts: 2\n\n";
static char __pyx_k_The_corner_of_the_bubble_This_pr[] = "The corner of the bubble\n\n        This property reflects the corner of the bubble. The corner will be\n        used to determine where the arrow in the frame points to and where\n        label, icon and info are shown.\n\n        :type: :ref:`Elm_Bubble_Pos`\n\n        ";
static PyObject *__pyx_n_s_callback_add;
static PyObject *__pyx_n_s_callback_del;
static PyObject *__pyx_n_s_clicked;
static PyObject *__pyx_n_s_focused;
static PyObject *__pyx_n_s_func;
static PyObject *__pyx_n_s_main;
static PyObject *__pyx_n_s_parent;
static PyObject *__pyx_n_s_pyx_vtable;
static PyObject *__pyx_n_s_test;
static PyObject *__pyx_n_s_unfocused;

/* "efl/elementary/bubble.pyx":120
 *     """
 * 
 *     def __init__(self, evasObject parent, *args, **kwargs):             # <<<<<<<<<<<<<<
 *         """Bubble(...)
 * 
 */

/* Python wrapper */
static int __pyx_pw_3efl_10elementary_6bubble_6Bubble_1__init__(PyObject *__pyx_v_self, PyObject *__pyx_args, PyObject *__pyx_kwds); /*proto*/
static char __pyx_doc_3efl_10elementary_6bubble_6Bubble___init__[] = "Bubble(...)\n\n        :param parent: The parent object\n        :type parent: :py:class:`efl.evas.Object`\n        :param \\**kwargs: All the remaining keyword arguments are interpreted\n                          as properties of the instance\n\n        ";
#if CYTHON_COMPILING_IN_CPYTHON
struct wrapperbase __pyx_wrapperbase_3efl_10elementary_6bubble_6Bubble___init__;
#endif
static int __pyx_pw_3efl_10elementary_6bubble_6Bubble_1__init__(PyObject *__pyx_v_self, PyObject *__pyx_args, PyObject *__pyx_kwds) {
  struct __pyx_obj_3efl_4evas_Object *__pyx_v_parent = 0;
  CYTHON_UNUSED PyObject *__pyx_v_args = 0;
  PyObject *__pyx_v_kwargs = 0;
  int __pyx_lineno = 0;
  const char *__pyx_filename = NULL;
  int __pyx_clineno = 0;
  int __pyx_r;
  __Pyx_RefNannyDeclarations
  __Pyx_RefNannySetupContext("__init__ (wrapper)", 0);
  __pyx_v_kwargs = PyDict_New(); if (unlikely(!__pyx_v_kwargs)) return -1;
  __Pyx_GOTREF(__pyx_v_kwargs);
  if (PyTuple_GET_SIZE(__pyx_args) > 1) {
    __pyx_v_args = PyTuple_GetSlice(__pyx_args, 1, PyTuple_GET_SIZE(__pyx_args));
    if (unlikely(!__pyx_v_args)) {
      __Pyx_DECREF(__pyx_v_kwargs); __pyx_v_kwargs = 0;
      __Pyx_RefNannyFinishContext();
      return -1;
    }
    __Pyx_GOTREF(__pyx_v_args);
  } else {
    __pyx_v_args = __pyx_empty_tuple; __Pyx_INCREF(__pyx_empty_tuple);
  }
  {
    static PyObject **__pyx_pyargnames[] = {&__pyx_n_s_parent,0};
    PyObject* values[1] = {0};
    if (unlikely(__pyx_kwds)) {
      Py_ssize_t kw_args;
      const Py_ssize_t pos_args = PyTuple_GET_SIZE(__pyx_args);
      switch (pos_args) {
        default:
        case  1: values[0] = PyTuple_GET_ITEM(__pyx_args, 0);
        case  0: break;
      }
      kw_args = PyDict_Size(__pyx_kwds);
      switch (pos_args) {
        case  0:
        if (likely((values[0] = PyDict_GetItem(__pyx_kwds, __pyx_n_s_parent)) != 0)) kw_args--;
        else goto __pyx_L5_argtuple_error;
      }
      if (unlikely(kw_args > 0)) {
        const Py_ssize_t used_pos_args = (pos_args < 1) ? pos_args : 1;
        if (unlikely(__Pyx_ParseOptionalKeywords(__pyx_kwds, __pyx_pyargnames, __pyx_v_kwargs, values, used_pos_args, "__init__") < 0)) {__pyx_filename = __pyx_f[0]; __pyx_lineno = 120; __pyx_clineno = __LINE__; goto __pyx_L3_error;}
      }
    } else if (PyTuple_GET_SIZE(__pyx_args) < 1) {
      goto __pyx_L5_argtuple_error;
    } else {
      values[0] = PyTuple_GET_ITEM(__pyx_args, 0);
    }
    __pyx_v_parent = ((struct __pyx_obj_3efl_4evas_Object *)values[0]);
  }
  goto __pyx_L4_argument_unpacking_done;
  __pyx_L5_argtuple_error:;
  __Pyx_RaiseArgtupleInvalid("__init__", 0, 1, 1, PyTuple_GET_SIZE(__pyx_args)); {__pyx_filename = __pyx_f[0]; __pyx_lineno = 120; __pyx_clineno = __LINE__; goto __pyx_L3_error;}
  __pyx_L3_error:;
  __Pyx_DECREF(__pyx_v_args); __pyx_v_args = 0;
  __Pyx_DECREF(__pyx_v_kwargs); __pyx_v_kwargs = 0;
  __Pyx_AddTraceback("efl.elementary.bubble.Bubble.__init__", __pyx_clineno, __pyx_lineno, __pyx_filename);
  __Pyx_RefNannyFinishContext();
  return -1;
  __pyx_L4_argument_unpacking_done:;
  if (unlikely(!__Pyx_ArgTypeTest(((PyObject *)__pyx_v_parent), __pyx_ptype_3efl_4evas_Object, 1, "parent", 0))) {__pyx_filename = __pyx_f[0]; __pyx_lineno = 120; __pyx_clineno = __LINE__; goto __pyx_L1_error;}
  __pyx_r = __pyx_pf_3efl_10elementary_6bubble_6Bubble___init__(((struct __pyx_obj_3efl_10elementary_6bubble_Bubble *)__pyx_v_self), __pyx_v_parent, __pyx_v_args, __pyx_v_kwargs);

  /* function exit code */
  goto __pyx_L0;
  __pyx_L1_error:;
  __pyx_r = -1;
  __pyx_L0:;
  __Pyx_XDECREF(__pyx_v_args);
  __Pyx_XDECREF(__pyx_v_kwargs);
  __Pyx_RefNannyFinishContext();
  return __pyx_r;
}

static int __pyx_pf_3efl_10elementary_6bubble_6Bubble___init__(struct __pyx_obj_3efl_10elementary_6bubble_Bubble *__pyx_v_self, struct __pyx_obj_3efl_4evas_Object *__pyx_v_parent, CYTHON_UNUSED PyObject *__pyx_v_args, PyObject *__pyx_v_kwargs) {
  int __pyx_r;
  __Pyx_RefNannyDeclarations
  int __pyx_t_1;
  int __pyx_lineno = 0;
  const char *__pyx_filename = NULL;
  int __pyx_clineno = 0;
  __Pyx_RefNannySetupContext("__init__", 0);

  /* "efl/elementary/bubble.pyx":129
 * 
 *         """
 *         self._set_obj(elm_bubble_add(parent.obj))             # <<<<<<<<<<<<<<
 *         self._set_properties_from_keyword_args(kwargs)
 * 
 */
  __pyx_t_1 = ((struct __pyx_vtabstruct_3efl_10elementary_6bubble_Bubble *)__pyx_v_self->__pyx_base.__pyx_base.__pyx_base.__pyx_base.__pyx_vtab)->__pyx_base.__pyx_base.__pyx_base.__pyx_base._set_obj(((struct __pyx_obj_3efl_2eo_Eo *)__pyx_v_self), elm_bubble_add(__pyx_v_parent->__pyx_base.obj)); if (unlikely(__pyx_t_1 == 0)) {__pyx_filename = __pyx_f[0]; __pyx_lineno = 129; __pyx_clineno = __LINE__; goto __pyx_L1_error;}

  /* "efl/elementary/bubble.pyx":130
 *         """
 *         self._set_obj(elm_bubble_add(parent.obj))
 *         self._set_properties_from_keyword_args(kwargs)             # <<<<<<<<<<<<<<
 * 
 *     property pos:
 */
  __pyx_t_1 = ((struct __pyx_vtabstruct_3efl_10elementary_6bubble_Bubble *)__pyx_v_self->__pyx_base.__pyx_base.__pyx_base.__pyx_base.__pyx_vtab)->__pyx_base.__pyx_base.__pyx_base.__pyx_base._set_properties_from_keyword_args(((struct __pyx_obj_3efl_2eo_Eo *)__pyx_v_self), __pyx_v_kwargs); if (unlikely(__pyx_t_1 == 0)) {__pyx_filename = __pyx_f[0]; __pyx_lineno = 130; __pyx_clineno = __LINE__; goto __pyx_L1_error;}

  /* "efl/elementary/bubble.pyx":120
 *     """
 * 
 *     def __init__(self, evasObject parent, *args, **kwargs):             # <<<<<<<<<<<<<<
 *         """Bubble(...)
 * 
 */

  /* function exit code */
  __pyx_r = 0;
  goto __pyx_L0;
  __pyx_L1_error:;
  __Pyx_AddTraceback("efl.elementary.bubble.Bubble.__init__", __pyx_clineno, __pyx_lineno, __pyx_filename);
  __pyx_r = -1;
  __pyx_L0:;
  __Pyx_RefNannyFinishContext();
  return __pyx_r;
}

/* "efl/elementary/bubble.pyx":142
 * 
 *         """
 *         def __get__(self):             # <<<<<<<<<<<<<<
 *             return elm_bubble_pos_get(self.obj)
 * 
 */

/* Python wrapper */
static PyObject *__pyx_pw_3efl_10elementary_6bubble_6Bubble_3pos_1__get__(PyObject *__pyx_v_self); /*proto*/
static PyObject *__pyx_pw_3efl_10elementary_6bubble_6Bubble_3pos_1__get__(PyObject *__pyx_v_self) {
  PyObject *__pyx_r = 0;
  __Pyx_RefNannyDeclarations
  __Pyx_RefNannySetupContext("__get__ (wrapper)", 0);
  __pyx_r = __pyx_pf_3efl_10elementary_6bubble_6Bubble_3pos___get__(((struct __pyx_obj_3efl_10elementary_6bubble_Bubble *)__pyx_v_self));

  /* function exit code */
  __Pyx_RefNannyFinishContext();
  return __pyx_r;
}

static PyObject *__pyx_pf_3efl_10elementary_6bubble_6Bubble_3pos___get__(struct __pyx_obj_3efl_10elementary_6bubble_Bubble *__pyx_v_self) {
  PyObject *__pyx_r = NULL;
  __Pyx_RefNannyDeclarations
  PyObject *__pyx_t_1 = NULL;
  int __pyx_lineno = 0;
  const char *__pyx_filename = NULL;
  int __pyx_clineno = 0;
  __Pyx_RefNannySetupContext("__get__", 0);

  /* "efl/elementary/bubble.pyx":143
 *         """
 *         def __get__(self):
 *             return elm_bubble_pos_get(self.obj)             # <<<<<<<<<<<<<<
 * 
 *         def __set__(self, value):
 */
  __Pyx_XDECREF(__pyx_r);
  __pyx_t_1 = PyInt_FromLong(elm_bubble_pos_get(__pyx_v_self->__pyx_base.__pyx_base.__pyx_base.__pyx_base.obj)); if (unlikely(!__pyx_t_1)) {__pyx_filename = __pyx_f[0]; __pyx_lineno = 143; __pyx_clineno = __LINE__; goto __pyx_L1_error;}
  __Pyx_GOTREF(__pyx_t_1);
  __pyx_r = __pyx_t_1;
  __pyx_t_1 = 0;
  goto __pyx_L0;

  /* "efl/elementary/bubble.pyx":142
 * 
 *         """
 *         def __get__(self):             # <<<<<<<<<<<<<<
 *             return elm_bubble_pos_get(self.obj)
 * 
 */

  /* function exit code */
  __pyx_L1_error:;
  __Pyx_XDECREF(__pyx_t_1);
  __Pyx_AddTraceback("efl.elementary.bubble.Bubble.pos.__get__", __pyx_clineno, __pyx_lineno, __pyx_filename);
  __pyx_r = NULL;
  __pyx_L0:;
  __Pyx_XGIVEREF(__pyx_r);
  __Pyx_RefNannyFinishContext();
  return __pyx_r;
}

/* "efl/elementary/bubble.pyx":145
 *             return elm_bubble_pos_get(self.obj)
 * 
 *         def __set__(self, value):             # <<<<<<<<<<<<<<
 *             elm_bubble_pos_set(self.obj, value)
 * 
 */

/* Python wrapper */
static int __pyx_pw_3efl_10elementary_6bubble_6Bubble_3pos_3__set__(PyObject *__pyx_v_self, PyObject *__pyx_v_value); /*proto*/
static int __pyx_pw_3efl_10elementary_6bubble_6Bubble_3pos_3__set__(PyObject *__pyx_v_self, PyObject *__pyx_v_value) {
  int __pyx_r;
  __Pyx_RefNannyDeclarations
  __Pyx_RefNannySetupContext("__set__ (wrapper)", 0);
  __pyx_r = __pyx_pf_3efl_10elementary_6bubble_6Bubble_3pos_2__set__(((struct __pyx_obj_3efl_10elementary_6bubble_Bubble *)__pyx_v_self), ((PyObject *)__pyx_v_value));

  /* function exit code */
  __Pyx_RefNannyFinishContext();
  return __pyx_r;
}

static int __pyx_pf_3efl_10elementary_6bubble_6Bubble_3pos_2__set__(struct __pyx_obj_3efl_10elementary_6bubble_Bubble *__pyx_v_self, PyObject *__pyx_v_value) {
  int __pyx_r;
  __Pyx_RefNannyDeclarations
  Elm_Bubble_Pos __pyx_t_1;
  int __pyx_lineno = 0;
  const char *__pyx_filename = NULL;
  int __pyx_clineno = 0;
  __Pyx_RefNannySetupContext("__set__", 0);

  /* "efl/elementary/bubble.pyx":146
 * 
 *         def __set__(self, value):
 *             elm_bubble_pos_set(self.obj, value)             # <<<<<<<<<<<<<<
 * 
 *     def pos_set(self, pos):
 */
  __pyx_t_1 = ((Elm_Bubble_Pos)PyInt_AsLong(__pyx_v_value)); if (unlikely(PyErr_Occurred())) {__pyx_filename = __pyx_f[0]; __pyx_lineno = 146; __pyx_clineno = __LINE__; goto __pyx_L1_error;}
  elm_bubble_pos_set(__pyx_v_self->__pyx_base.__pyx_base.__pyx_base.__pyx_base.obj, __pyx_t_1);

  /* "efl/elementary/bubble.pyx":145
 *             return elm_bubble_pos_get(self.obj)
 * 
 *         def __set__(self, value):             # <<<<<<<<<<<<<<
 *             elm_bubble_pos_set(self.obj, value)
 * 
 */

  /* function exit code */
  __pyx_r = 0;
  goto __pyx_L0;
  __pyx_L1_error:;
  __Pyx_AddTraceback("efl.elementary.bubble.Bubble.pos.__set__", __pyx_clineno, __pyx_lineno, __pyx_filename);
  __pyx_r = -1;
  __pyx_L0:;
  __Pyx_RefNannyFinishContext();
  return __pyx_r;
}

/* "efl/elementary/bubble.pyx":148
 *             elm_bubble_pos_set(self.obj, value)
 * 
 *     def pos_set(self, pos):             # <<<<<<<<<<<<<<
 *         elm_bubble_pos_set(self.obj, pos)
 *     def pos_get(self):
 */

/* Python wrapper */
static PyObject *__pyx_pw_3efl_10elementary_6bubble_6Bubble_3pos_set(PyObject *__pyx_v_self, PyObject *__pyx_v_pos); /*proto*/
static char __pyx_doc_3efl_10elementary_6bubble_6Bubble_2pos_set[] = "Bubble.pos_set(self, pos)";
static PyObject *__pyx_pw_3efl_10elementary_6bubble_6Bubble_3pos_set(PyObject *__pyx_v_self, PyObject *__pyx_v_pos) {
  PyObject *__pyx_r = 0;
  __Pyx_RefNannyDeclarations
  __Pyx_RefNannySetupContext("pos_set (wrapper)", 0);
  __pyx_r = __pyx_pf_3efl_10elementary_6bubble_6Bubble_2pos_set(((struct __pyx_obj_3efl_10elementary_6bubble_Bubble *)__pyx_v_self), ((PyObject *)__pyx_v_pos));

  /* function exit code */
  __Pyx_RefNannyFinishContext();
  return __pyx_r;
}

static PyObject *__pyx_pf_3efl_10elementary_6bubble_6Bubble_2pos_set(struct __pyx_obj_3efl_10elementary_6bubble_Bubble *__pyx_v_self, PyObject *__pyx_v_pos) {
  PyObject *__pyx_r = NULL;
  __Pyx_RefNannyDeclarations
  Elm_Bubble_Pos __pyx_t_1;
  int __pyx_lineno = 0;
  const char *__pyx_filename = NULL;
  int __pyx_clineno = 0;
  __Pyx_RefNannySetupContext("pos_set", 0);

  /* "efl/elementary/bubble.pyx":149
 * 
 *     def pos_set(self, pos):
 *         elm_bubble_pos_set(self.obj, pos)             # <<<<<<<<<<<<<<
 *     def pos_get(self):
 *         return elm_bubble_pos_get(self.obj)
 */
  __pyx_t_1 = ((Elm_Bubble_Pos)PyInt_AsLong(__pyx_v_pos)); if (unlikely(PyErr_Occurred())) {__pyx_filename = __pyx_f[0]; __pyx_lineno = 149; __pyx_clineno = __LINE__; goto __pyx_L1_error;}
  elm_bubble_pos_set(__pyx_v_self->__pyx_base.__pyx_base.__pyx_base.__pyx_base.obj, __pyx_t_1);

  /* "efl/elementary/bubble.pyx":148
 *             elm_bubble_pos_set(self.obj, value)
 * 
 *     def pos_set(self, pos):             # <<<<<<<<<<<<<<
 *         elm_bubble_pos_set(self.obj, pos)
 *     def pos_get(self):
 */

  /* function exit code */
  __pyx_r = Py_None; __Pyx_INCREF(Py_None);
  goto __pyx_L0;
  __pyx_L1_error:;
  __Pyx_AddTraceback("efl.elementary.bubble.Bubble.pos_set", __pyx_clineno, __pyx_lineno, __pyx_filename);
  __pyx_r = NULL;
  __pyx_L0:;
  __Pyx_XGIVEREF(__pyx_r);
  __Pyx_RefNannyFinishContext();
  return __pyx_r;
}

/* "efl/elementary/bubble.pyx":150
 *     def pos_set(self, pos):
 *         elm_bubble_pos_set(self.obj, pos)
 *     def pos_get(self):             # <<<<<<<<<<<<<<
 *         return elm_bubble_pos_get(self.obj)
 * 
 */

/* Python wrapper */
static PyObject *__pyx_pw_3efl_10elementary_6bubble_6Bubble_5pos_get(PyObject *__pyx_v_self, CYTHON_UNUSED PyObject *unused); /*proto*/
static char __pyx_doc_3efl_10elementary_6bubble_6Bubble_4pos_get[] = "Bubble.pos_get(self)";
static PyObject *__pyx_pw_3efl_10elementary_6bubble_6Bubble_5pos_get(PyObject *__pyx_v_self, CYTHON_UNUSED PyObject *unused) {
  PyObject *__pyx_r = 0;
  __Pyx_RefNannyDeclarations
  __Pyx_RefNannySetupContext("pos_get (wrapper)", 0);
  __pyx_r = __pyx_pf_3efl_10elementary_6bubble_6Bubble_4pos_get(((struct __pyx_obj_3efl_10elementary_6bubble_Bubble *)__pyx_v_self));

  /* function exit code */
  __Pyx_RefNannyFinishContext();
  return __pyx_r;
}

static PyObject *__pyx_pf_3efl_10elementary_6bubble_6Bubble_4pos_get(struct __pyx_obj_3efl_10elementary_6bubble_Bubble *__pyx_v_self) {
  PyObject *__pyx_r = NULL;
  __Pyx_RefNannyDeclarations
  PyObject *__pyx_t_1 = NULL;
  int __pyx_lineno = 0;
  const char *__pyx_filename = NULL;
  int __pyx_clineno = 0;
  __Pyx_RefNannySetupContext("pos_get", 0);

  /* "efl/elementary/bubble.pyx":151
 *         elm_bubble_pos_set(self.obj, pos)
 *     def pos_get(self):
 *         return elm_bubble_pos_get(self.obj)             # <<<<<<<<<<<<<<
 * 
 *     def callback_clicked_add(self, func, *args, **kwargs):
 */
  __Pyx_XDECREF(__pyx_r);
  __pyx_t_1 = PyInt_FromLong(elm_bubble_pos_get(__pyx_v_self->__pyx_base.__pyx_base.__pyx_base.__pyx_base.obj)); if (unlikely(!__pyx_t_1)) {__pyx_filename = __pyx_f[0]; __pyx_lineno = 151; __pyx_clineno = __LINE__; goto __pyx_L1_error;}
  __Pyx_GOTREF(__pyx_t_1);
  __pyx_r = __pyx_t_1;
  __pyx_t_1 = 0;
  goto __pyx_L0;

  /* "efl/elementary/bubble.pyx":150
 *     def pos_set(self, pos):
 *         elm_bubble_pos_set(self.obj, pos)
 *     def pos_get(self):             # <<<<<<<<<<<<<<
 *         return elm_bubble_pos_get(self.obj)
 * 
 */

  /* function exit code */
  __pyx_L1_error:;
  __Pyx_XDECREF(__pyx_t_1);
  __Pyx_AddTraceback("efl.elementary.bubble.Bubble.pos_get", __pyx_clineno, __pyx_lineno, __pyx_filename);
  __pyx_r = NULL;
  __pyx_L0:;
  __Pyx_XGIVEREF(__pyx_r);
  __Pyx_RefNannyFinishContext();
  return __pyx_r;
}

/* "efl/elementary/bubble.pyx":153
 *         return elm_bubble_pos_get(self.obj)
 * 
 *     def callback_clicked_add(self, func, *args, **kwargs):             # <<<<<<<<<<<<<<
 *         """This is called when a user has clicked the bubble."""
 *         self._callback_add("clicked", func, *args, **kwargs)
 */

/* Python wrapper */
static PyObject *__pyx_pw_3efl_10elementary_6bubble_6Bubble_7callback_clicked_add(PyObject *__pyx_v_self, PyObject *__pyx_args, PyObject *__pyx_kwds); /*proto*/
static char __pyx_doc_3efl_10elementary_6bubble_6Bubble_6callback_clicked_add[] = "Bubble.callback_clicked_add(self, func, *args, **kwargs)\nThis is called when a user has clicked the bubble.";
static PyObject *__pyx_pw_3efl_10elementary_6bubble_6Bubble_7callback_clicked_add(PyObject *__pyx_v_self, PyObject *__pyx_args, PyObject *__pyx_kwds) {
  PyObject *__pyx_v_func = 0;
  PyObject *__pyx_v_args = 0;
  PyObject *__pyx_v_kwargs = 0;
  int __pyx_lineno = 0;
  const char *__pyx_filename = NULL;
  int __pyx_clineno = 0;
  PyObject *__pyx_r = 0;
  __Pyx_RefNannyDeclarations
  __Pyx_RefNannySetupContext("callback_clicked_add (wrapper)", 0);
  __pyx_v_kwargs = PyDict_New(); if (unlikely(!__pyx_v_kwargs)) return NULL;
  __Pyx_GOTREF(__pyx_v_kwargs);
  if (PyTuple_GET_SIZE(__pyx_args) > 1) {
    __pyx_v_args = PyTuple_GetSlice(__pyx_args, 1, PyTuple_GET_SIZE(__pyx_args));
    if (unlikely(!__pyx_v_args)) {
      __Pyx_DECREF(__pyx_v_kwargs); __pyx_v_kwargs = 0;
      __Pyx_RefNannyFinishContext();
      return NULL;
    }
    __Pyx_GOTREF(__pyx_v_args);
  } else {
    __pyx_v_args = __pyx_empty_tuple; __Pyx_INCREF(__pyx_empty_tuple);
  }
  {
    static PyObject **__pyx_pyargnames[] = {&__pyx_n_s_func,0};
    PyObject* values[1] = {0};
    if (unlikely(__pyx_kwds)) {
      Py_ssize_t kw_args;
      const Py_ssize_t pos_args = PyTuple_GET_SIZE(__pyx_args);
      switch (pos_args) {
        default:
        case  1: values[0] = PyTuple_GET_ITEM(__pyx_args, 0);
        case  0: break;
      }
      kw_args = PyDict_Size(__pyx_kwds);
      switch (pos_args) {
        case  0:
        if (likely((values[0] = PyDict_GetItem(__pyx_kwds, __pyx_n_s_func)) != 0)) kw_args--;
        else goto __pyx_L5_argtuple_error;
      }
      if (unlikely(kw_args > 0)) {
        const Py_ssize_t used_pos_args = (pos_args < 1) ? pos_args : 1;
        if (unlikely(__Pyx_ParseOptionalKeywords(__pyx_kwds, __pyx_pyargnames, __pyx_v_kwargs, values, used_pos_args, "callback_clicked_add") < 0)) {__pyx_filename = __pyx_f[0]; __pyx_lineno = 153; __pyx_clineno = __LINE__; goto __pyx_L3_error;}
      }
    } else if (PyTuple_GET_SIZE(__pyx_args) < 1) {
      goto __pyx_L5_argtuple_error;
    } else {
      values[0] = PyTuple_GET_ITEM(__pyx_args, 0);
    }
    __pyx_v_func = values[0];
  }
  goto __pyx_L4_argument_unpacking_done;
  __pyx_L5_argtuple_error:;
  __Pyx_RaiseArgtupleInvalid("callback_clicked_add", 0, 1, 1, PyTuple_GET_SIZE(__pyx_args)); {__pyx_filename = __pyx_f[0]; __pyx_lineno = 153; __pyx_clineno = __LINE__; goto __pyx_L3_error;}
  __pyx_L3_error:;
  __Pyx_DECREF(__pyx_v_args); __pyx_v_args = 0;
  __Pyx_DECREF(__pyx_v_kwargs); __pyx_v_kwargs = 0;
  __Pyx_AddTraceback("efl.elementary.bubble.Bubble.callback_clicked_add", __pyx_clineno, __pyx_lineno, __pyx_filename);
  __Pyx_RefNannyFinishContext();
  return NULL;
  __pyx_L4_argument_unpacking_done:;
  __pyx_r = __pyx_pf_3efl_10elementary_6bubble_6Bubble_6callback_clicked_add(((struct __pyx_obj_3efl_10elementary_6bubble_Bubble *)__pyx_v_self), __pyx_v_func, __pyx_v_args, __pyx_v_kwargs);

  /* function exit code */
  __Pyx_XDECREF(__pyx_v_args);
  __Pyx_XDECREF(__pyx_v_kwargs);
  __Pyx_RefNannyFinishContext();
  return __pyx_r;
}

static PyObject *__pyx_pf_3efl_10elementary_6bubble_6Bubble_6callback_clicked_add(struct __pyx_obj_3efl_10elementary_6bubble_Bubble *__pyx_v_self, PyObject *__pyx_v_func, PyObject *__pyx_v_args, PyObject *__pyx_v_kwargs) {
  PyObject *__pyx_r = NULL;
  __Pyx_RefNannyDeclarations
  PyObject *__pyx_t_1 = NULL;
  PyObject *__pyx_t_2 = NULL;
  PyObject *__pyx_t_3 = NULL;
  PyObject *__pyx_t_4 = NULL;
  int __pyx_lineno = 0;
  const char *__pyx_filename = NULL;
  int __pyx_clineno = 0;
  __Pyx_RefNannySetupContext("callback_clicked_add", 0);

  /* "efl/elementary/bubble.pyx":155
 *     def callback_clicked_add(self, func, *args, **kwargs):
 *         """This is called when a user has clicked the bubble."""
 *         self._callback_add("clicked", func, *args, **kwargs)             # <<<<<<<<<<<<<<
 * 
 *     def callback_clicked_del(self, func):
 */
  __pyx_t_1 = __Pyx_PyObject_GetAttrStr(((PyObject *)__pyx_v_self), __pyx_n_s_callback_add); if (unlikely(!__pyx_t_1)) {__pyx_filename = __pyx_f[0]; __pyx_lineno = 155; __pyx_clineno = __LINE__; goto __pyx_L1_error;}
  __Pyx_GOTREF(__pyx_t_1);
  __pyx_t_2 = PyTuple_New(2); if (unlikely(!__pyx_t_2)) {__pyx_filename = __pyx_f[0]; __pyx_lineno = 155; __pyx_clineno = __LINE__; goto __pyx_L1_error;}
  __Pyx_GOTREF(__pyx_t_2);
  __Pyx_INCREF(__pyx_n_s_clicked);
  PyTuple_SET_ITEM(__pyx_t_2, 0, __pyx_n_s_clicked);
  __Pyx_GIVEREF(__pyx_n_s_clicked);
  __Pyx_INCREF(__pyx_v_func);
  PyTuple_SET_ITEM(__pyx_t_2, 1, __pyx_v_func);
  __Pyx_GIVEREF(__pyx_v_func);
  __pyx_t_3 = PySequence_Tuple(__pyx_v_args); if (unlikely(!__pyx_t_3)) {__pyx_filename = __pyx_f[0]; __pyx_lineno = 155; __pyx_clineno = __LINE__; goto __pyx_L1_error;}
  __Pyx_GOTREF(__pyx_t_3);
  __pyx_t_4 = PyNumber_Add(__pyx_t_2, __pyx_t_3); if (unlikely(!__pyx_t_4)) {__pyx_filename = __pyx_f[0]; __pyx_lineno = 155; __pyx_clineno = __LINE__; goto __pyx_L1_error;}
  __Pyx_GOTREF(__pyx_t_4);
  __Pyx_DECREF(__pyx_t_2); __pyx_t_2 = 0;
  __Pyx_DECREF(__pyx_t_3); __pyx_t_3 = 0;
  __pyx_t_3 = __pyx_v_kwargs;
  __Pyx_INCREF(__pyx_t_3);
  __pyx_t_2 = __Pyx_PyObject_Call(__pyx_t_1, __pyx_t_4, __pyx_t_3); if (unlikely(!__pyx_t_2)) {__pyx_filename = __pyx_f[0]; __pyx_lineno = 155; __pyx_clineno = __LINE__; goto __pyx_L1_error;}
  __Pyx_GOTREF(__pyx_t_2);
  __Pyx_DECREF(__pyx_t_1); __pyx_t_1 = 0;
  __Pyx_DECREF(__pyx_t_4); __pyx_t_4 = 0;
  __Pyx_DECREF(__pyx_t_3); __pyx_t_3 = 0;
  __Pyx_DECREF(__pyx_t_2); __pyx_t_2 = 0;

  /* "efl/elementary/bubble.pyx":153
 *         return elm_bubble_pos_get(self.obj)
 * 
 *     def callback_clicked_add(self, func, *args, **kwargs):             # <<<<<<<<<<<<<<
 *         """This is called when a user has clicked the bubble."""
 *         self._callback_add("clicked", func, *args, **kwargs)
 */

  /* function exit code */
  __pyx_r = Py_None; __Pyx_INCREF(Py_None);
  goto __pyx_L0;
  __pyx_L1_error:;
  __Pyx_XDECREF(__pyx_t_1);
  __Pyx_XDECREF(__pyx_t_2);
  __Pyx_XDECREF(__pyx_t_3);
  __Pyx_XDECREF(__pyx_t_4);
  __Pyx_AddTraceback("efl.elementary.bubble.Bubble.callback_clicked_add", __pyx_clineno, __pyx_lineno, __pyx_filename);
  __pyx_r = NULL;
  __pyx_L0:;
  __Pyx_XGIVEREF(__pyx_r);
  __Pyx_RefNannyFinishContext();
  return __pyx_r;
}

/* "efl/elementary/bubble.pyx":157
 *         self._callback_add("clicked", func, *args, **kwargs)
 * 
 *     def callback_clicked_del(self, func):             # <<<<<<<<<<<<<<
 *         self._callback_del("clicked", func)
 * 
 */

/* Python wrapper */
static PyObject *__pyx_pw_3efl_10elementary_6bubble_6Bubble_9callback_clicked_del(PyObject *__pyx_v_self, PyObject *__pyx_v_func); /*proto*/
static char __pyx_doc_3efl_10elementary_6bubble_6Bubble_8callback_clicked_del[] = "Bubble.callback_clicked_del(self, func)";
static PyObject *__pyx_pw_3efl_10elementary_6bubble_6Bubble_9callback_clicked_del(PyObject *__pyx_v_self, PyObject *__pyx_v_func) {
  PyObject *__pyx_r = 0;
  __Pyx_RefNannyDeclarations
  __Pyx_RefNannySetupContext("callback_clicked_del (wrapper)", 0);
  __pyx_r = __pyx_pf_3efl_10elementary_6bubble_6Bubble_8callback_clicked_del(((struct __pyx_obj_3efl_10elementary_6bubble_Bubble *)__pyx_v_self), ((PyObject *)__pyx_v_func));

  /* function exit code */
  __Pyx_RefNannyFinishContext();
  return __pyx_r;
}

static PyObject *__pyx_pf_3efl_10elementary_6bubble_6Bubble_8callback_clicked_del(struct __pyx_obj_3efl_10elementary_6bubble_Bubble *__pyx_v_self, PyObject *__pyx_v_func) {
  PyObject *__pyx_r = NULL;
  __Pyx_RefNannyDeclarations
  PyObject *__pyx_t_1 = NULL;
  PyObject *__pyx_t_2 = NULL;
  PyObject *__pyx_t_3 = NULL;
  Py_ssize_t __pyx_t_4;
  PyObject *__pyx_t_5 = NULL;
  int __pyx_lineno = 0;
  const char *__pyx_filename = NULL;
  int __pyx_clineno = 0;
  __Pyx_RefNannySetupContext("callback_clicked_del", 0);

  /* "efl/elementary/bubble.pyx":158
 * 
 *     def callback_clicked_del(self, func):
 *         self._callback_del("clicked", func)             # <<<<<<<<<<<<<<
 * 
 *     def callback_focused_add(self, func, *args, **kwargs):
 */
  __pyx_t_2 = __Pyx_PyObject_GetAttrStr(((PyObject *)__pyx_v_self), __pyx_n_s_callback_del); if (unlikely(!__pyx_t_2)) {__pyx_filename = __pyx_f[0]; __pyx_lineno = 158; __pyx_clineno = __LINE__; goto __pyx_L1_error;}
  __Pyx_GOTREF(__pyx_t_2);
  __pyx_t_3 = NULL;
  __pyx_t_4 = 0;
  if (CYTHON_COMPILING_IN_CPYTHON && likely(PyMethod_Check(__pyx_t_2))) {
    __pyx_t_3 = PyMethod_GET_SELF(__pyx_t_2);
    if (likely(__pyx_t_3)) {
      PyObject* function = PyMethod_GET_FUNCTION(__pyx_t_2);
      __Pyx_INCREF(__pyx_t_3);
      __Pyx_INCREF(function);
      __Pyx_DECREF_SET(__pyx_t_2, function);
      __pyx_t_4 = 1;
    }
  }
  __pyx_t_5 = PyTuple_New(2+__pyx_t_4); if (unlikely(!__pyx_t_5)) {__pyx_filename = __pyx_f[0]; __pyx_lineno = 158; __pyx_clineno = __LINE__; goto __pyx_L1_error;}
  __Pyx_GOTREF(__pyx_t_5);
  if (__pyx_t_3) {
    PyTuple_SET_ITEM(__pyx_t_5, 0, __pyx_t_3); __Pyx_GIVEREF(__pyx_t_3); __pyx_t_3 = NULL;
  }
  __Pyx_INCREF(__pyx_n_s_clicked);
  PyTuple_SET_ITEM(__pyx_t_5, 0+__pyx_t_4, __pyx_n_s_clicked);
  __Pyx_GIVEREF(__pyx_n_s_clicked);
  __Pyx_INCREF(__pyx_v_func);
  PyTuple_SET_ITEM(__pyx_t_5, 1+__pyx_t_4, __pyx_v_func);
  __Pyx_GIVEREF(__pyx_v_func);
  __pyx_t_1 = __Pyx_PyObject_Call(__pyx_t_2, __pyx_t_5, NULL); if (unlikely(!__pyx_t_1)) {__pyx_filename = __pyx_f[0]; __pyx_lineno = 158; __pyx_clineno = __LINE__; goto __pyx_L1_error;}
  __Pyx_GOTREF(__pyx_t_1);
  __Pyx_DECREF(__pyx_t_5); __pyx_t_5 = 0;
  __Pyx_DECREF(__pyx_t_2); __pyx_t_2 = 0;
  __Pyx_DECREF(__pyx_t_1); __pyx_t_1 = 0;

  /* "efl/elementary/bubble.pyx":157
 *         self._callback_add("clicked", func, *args, **kwargs)
 * 
 *     def callback_clicked_del(self, func):             # <<<<<<<<<<<<<<
 *         self._callback_del("clicked", func)
 * 
 */

  /* function exit code */
  __pyx_r = Py_None; __Pyx_INCREF(Py_None);
  goto __pyx_L0;
  __pyx_L1_error:;
  __Pyx_XDECREF(__pyx_t_1);
  __Pyx_XDECREF(__pyx_t_2);
  __Pyx_XDECREF(__pyx_t_3);
  __Pyx_XDECREF(__pyx_t_5);
  __Pyx_AddTraceback("efl.elementary.bubble.Bubble.callback_clicked_del", __pyx_clineno, __pyx_lineno, __pyx_filename);
  __pyx_r = NULL;
  __pyx_L0:;
  __Pyx_XGIVEREF(__pyx_r);
  __Pyx_RefNannyFinishContext();
  return __pyx_r;
}

/* "efl/elementary/bubble.pyx":160
 *         self._callback_del("clicked", func)
 * 
 *     def callback_focused_add(self, func, *args, **kwargs):             # <<<<<<<<<<<<<<
 *         """When the bubble has received focus.
 * 
 */

/* Python wrapper */
static PyObject *__pyx_pw_3efl_10elementary_6bubble_6Bubble_11callback_focused_add(PyObject *__pyx_v_self, PyObject *__pyx_args, PyObject *__pyx_kwds); /*proto*/
static char __pyx_doc_3efl_10elementary_6bubble_6Bubble_10callback_focused_add[] = "Bubble.callback_focused_add(self, func, *args, **kwargs)\nWhen the bubble has received focus.\n\n        .. versionadded:: 1.8\n\n        ";
static PyObject *__pyx_pw_3efl_10elementary_6bubble_6Bubble_11callback_focused_add(PyObject *__pyx_v_self, PyObject *__pyx_args, PyObject *__pyx_kwds) {
  PyObject *__pyx_v_func = 0;
  PyObject *__pyx_v_args = 0;
  PyObject *__pyx_v_kwargs = 0;
  int __pyx_lineno = 0;
  const char *__pyx_filename = NULL;
  int __pyx_clineno = 0;
  PyObject *__pyx_r = 0;
  __Pyx_RefNannyDeclarations
  __Pyx_RefNannySetupContext("callback_focused_add (wrapper)", 0);
  __pyx_v_kwargs = PyDict_New(); if (unlikely(!__pyx_v_kwargs)) return NULL;
  __Pyx_GOTREF(__pyx_v_kwargs);
  if (PyTuple_GET_SIZE(__pyx_args) > 1) {
    __pyx_v_args = PyTuple_GetSlice(__pyx_args, 1, PyTuple_GET_SIZE(__pyx_args));
    if (unlikely(!__pyx_v_args)) {
      __Pyx_DECREF(__pyx_v_kwargs); __pyx_v_kwargs = 0;
      __Pyx_RefNannyFinishContext();
      return NULL;
    }
    __Pyx_GOTREF(__pyx_v_args);
  } else {
    __pyx_v_args = __pyx_empty_tuple; __Pyx_INCREF(__pyx_empty_tuple);
  }
  {
    static PyObject **__pyx_pyargnames[] = {&__pyx_n_s_func,0};
    PyObject* values[1] = {0};
    if (unlikely(__pyx_kwds)) {
      Py_ssize_t kw_args;
      const Py_ssize_t pos_args = PyTuple_GET_SIZE(__pyx_args);
      switch (pos_args) {
        default:
        case  1: values[0] = PyTuple_GET_ITEM(__pyx_args, 0);
        case  0: break;
      }
      kw_args = PyDict_Size(__pyx_kwds);
      switch (pos_args) {
        case  0:
        if (likely((values[0] = PyDict_GetItem(__pyx_kwds, __pyx_n_s_func)) != 0)) kw_args--;
        else goto __pyx_L5_argtuple_error;
      }
      if (unlikely(kw_args > 0)) {
        const Py_ssize_t used_pos_args = (pos_args < 1) ? pos_args : 1;
        if (unlikely(__Pyx_ParseOptionalKeywords(__pyx_kwds, __pyx_pyargnames, __pyx_v_kwargs, values, used_pos_args, "callback_focused_add") < 0)) {__pyx_filename = __pyx_f[0]; __pyx_lineno = 160; __pyx_clineno = __LINE__; goto __pyx_L3_error;}
      }
    } else if (PyTuple_GET_SIZE(__pyx_args) < 1) {
      goto __pyx_L5_argtuple_error;
    } else {
      values[0] = PyTuple_GET_ITEM(__pyx_args, 0);
    }
    __pyx_v_func = values[0];
  }
  goto __pyx_L4_argument_unpacking_done;
  __pyx_L5_argtuple_error:;
  __Pyx_RaiseArgtupleInvalid("callback_focused_add", 0, 1, 1, PyTuple_GET_SIZE(__pyx_args)); {__pyx_filename = __pyx_f[0]; __pyx_lineno = 160; __pyx_clineno = __LINE__; goto __pyx_L3_error;}
  __pyx_L3_error:;
  __Pyx_DECREF(__pyx_v_args); __pyx_v_args = 0;
  __Pyx_DECREF(__pyx_v_kwargs); __pyx_v_kwargs = 0;
  __Pyx_AddTraceback("efl.elementary.bubble.Bubble.callback_focused_add", __pyx_clineno, __pyx_lineno, __pyx_filename);
  __Pyx_RefNannyFinishContext();
  return NULL;
  __pyx_L4_argument_unpacking_done:;
  __pyx_r = __pyx_pf_3efl_10elementary_6bubble_6Bubble_10callback_focused_add(((struct __pyx_obj_3efl_10elementary_6bubble_Bubble *)__pyx_v_self), __pyx_v_func, __pyx_v_args, __pyx_v_kwargs);

  /* function exit code */
  __Pyx_XDECREF(__pyx_v_args);
  __Pyx_XDECREF(__pyx_v_kwargs);
  __Pyx_RefNannyFinishContext();
  return __pyx_r;
}

static PyObject *__pyx_pf_3efl_10elementary_6bubble_6Bubble_10callback_focused_add(struct __pyx_obj_3efl_10elementary_6bubble_Bubble *__pyx_v_self, PyObject *__pyx_v_func, PyObject *__pyx_v_args, PyObject *__pyx_v_kwargs) {
  PyObject *__pyx_r = NULL;
  __Pyx_RefNannyDeclarations
  PyObject *__pyx_t_1 = NULL;
  PyObject *__pyx_t_2 = NULL;
  PyObject *__pyx_t_3 = NULL;
  PyObject *__pyx_t_4 = NULL;
  int __pyx_lineno = 0;
  const char *__pyx_filename = NULL;
  int __pyx_clineno = 0;
  __Pyx_RefNannySetupContext("callback_focused_add", 0);

  /* "efl/elementary/bubble.pyx":166
 * 
 *         """
 *         self._callback_add("focused", func, *args, **kwargs)             # <<<<<<<<<<<<<<
 * 
 *     def callback_focused_del(self, func):
 */
  __pyx_t_1 = __Pyx_PyObject_GetAttrStr(((PyObject *)__pyx_v_self), __pyx_n_s_callback_add); if (unlikely(!__pyx_t_1)) {__pyx_filename = __pyx_f[0]; __pyx_lineno = 166; __pyx_clineno = __LINE__; goto __pyx_L1_error;}
  __Pyx_GOTREF(__pyx_t_1);
  __pyx_t_2 = PyTuple_New(2); if (unlikely(!__pyx_t_2)) {__pyx_filename = __pyx_f[0]; __pyx_lineno = 166; __pyx_clineno = __LINE__; goto __pyx_L1_error;}
  __Pyx_GOTREF(__pyx_t_2);
  __Pyx_INCREF(__pyx_n_s_focused);
  PyTuple_SET_ITEM(__pyx_t_2, 0, __pyx_n_s_focused);
  __Pyx_GIVEREF(__pyx_n_s_focused);
  __Pyx_INCREF(__pyx_v_func);
  PyTuple_SET_ITEM(__pyx_t_2, 1, __pyx_v_func);
  __Pyx_GIVEREF(__pyx_v_func);
  __pyx_t_3 = PySequence_Tuple(__pyx_v_args); if (unlikely(!__pyx_t_3)) {__pyx_filename = __pyx_f[0]; __pyx_lineno = 166; __pyx_clineno = __LINE__; goto __pyx_L1_error;}
  __Pyx_GOTREF(__pyx_t_3);
  __pyx_t_4 = PyNumber_Add(__pyx_t_2, __pyx_t_3); if (unlikely(!__pyx_t_4)) {__pyx_filename = __pyx_f[0]; __pyx_lineno = 166; __pyx_clineno = __LINE__; goto __pyx_L1_error;}
  __Pyx_GOTREF(__pyx_t_4);
  __Pyx_DECREF(__pyx_t_2); __pyx_t_2 = 0;
  __Pyx_DECREF(__pyx_t_3); __pyx_t_3 = 0;
  __pyx_t_3 = __pyx_v_kwargs;
  __Pyx_INCREF(__pyx_t_3);
  __pyx_t_2 = __Pyx_PyObject_Call(__pyx_t_1, __pyx_t_4, __pyx_t_3); if (unlikely(!__pyx_t_2)) {__pyx_filename = __pyx_f[0]; __pyx_lineno = 166; __pyx_clineno = __LINE__; goto __pyx_L1_error;}
  __Pyx_GOTREF(__pyx_t_2);
  __Pyx_DECREF(__pyx_t_1); __pyx_t_1 = 0;
  __Pyx_DECREF(__pyx_t_4); __pyx_t_4 = 0;
  __Pyx_DECREF(__pyx_t_3); __pyx_t_3 = 0;
  __Pyx_DECREF(__pyx_t_2); __pyx_t_2 = 0;

  /* "efl/elementary/bubble.pyx":160
 *         self._callback_del("clicked", func)
 * 
 *     def callback_focused_add(self, func, *args, **kwargs):             # <<<<<<<<<<<<<<
 *         """When the bubble has received focus.
 * 
 */

  /* function exit code */
  __pyx_r = Py_None; __Pyx_INCREF(Py_None);
  goto __pyx_L0;
  __pyx_L1_error:;
  __Pyx_XDECREF(__pyx_t_1);
  __Pyx_XDECREF(__pyx_t_2);
  __Pyx_XDECREF(__pyx_t_3);
  __Pyx_XDECREF(__pyx_t_4);
  __Pyx_AddTraceback("efl.elementary.bubble.Bubble.callback_focused_add", __pyx_clineno, __pyx_lineno, __pyx_filename);
  __pyx_r = NULL;
  __pyx_L0:;
  __Pyx_XGIVEREF(__pyx_r);
  __Pyx_RefNannyFinishContext();
  return __pyx_r;
}

/* "efl/elementary/bubble.pyx":168
 *         self._callback_add("focused", func, *args, **kwargs)
 * 
 *     def callback_focused_del(self, func):             # <<<<<<<<<<<<<<
 *         self._callback_del("focused", func)
 * 
 */

/* Python wrapper */
static PyObject *__pyx_pw_3efl_10elementary_6bubble_6Bubble_13callback_focused_del(PyObject *__pyx_v_self, PyObject *__pyx_v_func); /*proto*/
static char __pyx_doc_3efl_10elementary_6bubble_6Bubble_12callback_focused_del[] = "Bubble.callback_focused_del(self, func)";
static PyObject *__pyx_pw_3efl_10elementary_6bubble_6Bubble_13callback_focused_del(PyObject *__pyx_v_self, PyObject *__pyx_v_func) {
  PyObject *__pyx_r = 0;
  __Pyx_RefNannyDeclarations
  __Pyx_RefNannySetupContext("callback_focused_del (wrapper)", 0);
  __pyx_r = __pyx_pf_3efl_10elementary_6bubble_6Bubble_12callback_focused_del(((struct __pyx_obj_3efl_10elementary_6bubble_Bubble *)__pyx_v_self), ((PyObject *)__pyx_v_func));

  /* function exit code */
  __Pyx_RefNannyFinishContext();
  return __pyx_r;
}

static PyObject *__pyx_pf_3efl_10elementary_6bubble_6Bubble_12callback_focused_del(struct __pyx_obj_3efl_10elementary_6bubble_Bubble *__pyx_v_self, PyObject *__pyx_v_func) {
  PyObject *__pyx_r = NULL;
  __Pyx_RefNannyDeclarations
  PyObject *__pyx_t_1 = NULL;
  PyObject *__pyx_t_2 = NULL;
  PyObject *__pyx_t_3 = NULL;
  Py_ssize_t __pyx_t_4;
  PyObject *__pyx_t_5 = NULL;
  int __pyx_lineno = 0;
  const char *__pyx_filename = NULL;
  int __pyx_clineno = 0;
  __Pyx_RefNannySetupContext("callback_focused_del", 0);

  /* "efl/elementary/bubble.pyx":169
 * 
 *     def callback_focused_del(self, func):
 *         self._callback_del("focused", func)             # <<<<<<<<<<<<<<
 * 
 *     def callback_unfocused_add(self, func, *args, **kwargs):
 */
  __pyx_t_2 = __Pyx_PyObject_GetAttrStr(((PyObject *)__pyx_v_self), __pyx_n_s_callback_del); if (unlikely(!__pyx_t_2)) {__pyx_filename = __pyx_f[0]; __pyx_lineno = 169; __pyx_clineno = __LINE__; goto __pyx_L1_error;}
  __Pyx_GOTREF(__pyx_t_2);
  __pyx_t_3 = NULL;
  __pyx_t_4 = 0;
  if (CYTHON_COMPILING_IN_CPYTHON && likely(PyMethod_Check(__pyx_t_2))) {
    __pyx_t_3 = PyMethod_GET_SELF(__pyx_t_2);
    if (likely(__pyx_t_3)) {
      PyObject* function = PyMethod_GET_FUNCTION(__pyx_t_2);
      __Pyx_INCREF(__pyx_t_3);
      __Pyx_INCREF(function);
      __Pyx_DECREF_SET(__pyx_t_2, function);
      __pyx_t_4 = 1;
    }
  }
  __pyx_t_5 = PyTuple_New(2+__pyx_t_4); if (unlikely(!__pyx_t_5)) {__pyx_filename = __pyx_f[0]; __pyx_lineno = 169; __pyx_clineno = __LINE__; goto __pyx_L1_error;}
  __Pyx_GOTREF(__pyx_t_5);
  if (__pyx_t_3) {
    PyTuple_SET_ITEM(__pyx_t_5, 0, __pyx_t_3); __Pyx_GIVEREF(__pyx_t_3); __pyx_t_3 = NULL;
  }
  __Pyx_INCREF(__pyx_n_s_focused);
  PyTuple_SET_ITEM(__pyx_t_5, 0+__pyx_t_4, __pyx_n_s_focused);
  __Pyx_GIVEREF(__pyx_n_s_focused);
  __Pyx_INCREF(__pyx_v_func);
  PyTuple_SET_ITEM(__pyx_t_5, 1+__pyx_t_4, __pyx_v_func);
  __Pyx_GIVEREF(__pyx_v_func);
  __pyx_t_1 = __Pyx_PyObject_Call(__pyx_t_2, __pyx_t_5, NULL); if (unlikely(!__pyx_t_1)) {__pyx_filename = __pyx_f[0]; __pyx_lineno = 169; __pyx_clineno = __LINE__; goto __pyx_L1_error;}
  __Pyx_GOTREF(__pyx_t_1);
  __Pyx_DECREF(__pyx_t_5); __pyx_t_5 = 0;
  __Pyx_DECREF(__pyx_t_2); __pyx_t_2 = 0;
  __Pyx_DECREF(__pyx_t_1); __pyx_t_1 = 0;

  /* "efl/elementary/bubble.pyx":168
 *         self._callback_add("focused", func, *args, **kwargs)
 * 
 *     def callback_focused_del(self, func):             # <<<<<<<<<<<<<<
 *         self._callback_del("focused", func)
 * 
 */

  /* function exit code */
  __pyx_r = Py_None; __Pyx_INCREF(Py_None);
  goto __pyx_L0;
  __pyx_L1_error:;
  __Pyx_XDECREF(__pyx_t_1);
  __Pyx_XDECREF(__pyx_t_2);
  __Pyx_XDECREF(__pyx_t_3);
  __Pyx_XDECREF(__pyx_t_5);
  __Pyx_AddTraceback("efl.elementary.bubble.Bubble.callback_focused_del", __pyx_clineno, __pyx_lineno, __pyx_filename);
  __pyx_r = NULL;
  __pyx_L0:;
  __Pyx_XGIVEREF(__pyx_r);
  __Pyx_RefNannyFinishContext();
  return __pyx_r;
}

/* "efl/elementary/bubble.pyx":171
 *         self._callback_del("focused", func)
 * 
 *     def callback_unfocused_add(self, func, *args, **kwargs):             # <<<<<<<<<<<<<<
 *         """When the bubble has lost focus.
 * 
 */

/* Python wrapper */
static PyObject *__pyx_pw_3efl_10elementary_6bubble_6Bubble_15callback_unfocused_add(PyObject *__pyx_v_self, PyObject *__pyx_args, PyObject *__pyx_kwds); /*proto*/
static char __pyx_doc_3efl_10elementary_6bubble_6Bubble_14callback_unfocused_add[] = "Bubble.callback_unfocused_add(self, func, *args, **kwargs)\nWhen the bubble has lost focus.\n\n        .. versionadded:: 1.8\n\n        ";
static PyObject *__pyx_pw_3efl_10elementary_6bubble_6Bubble_15callback_unfocused_add(PyObject *__pyx_v_self, PyObject *__pyx_args, PyObject *__pyx_kwds) {
  PyObject *__pyx_v_func = 0;
  PyObject *__pyx_v_args = 0;
  PyObject *__pyx_v_kwargs = 0;
  int __pyx_lineno = 0;
  const char *__pyx_filename = NULL;
  int __pyx_clineno = 0;
  PyObject *__pyx_r = 0;
  __Pyx_RefNannyDeclarations
  __Pyx_RefNannySetupContext("callback_unfocused_add (wrapper)", 0);
  __pyx_v_kwargs = PyDict_New(); if (unlikely(!__pyx_v_kwargs)) return NULL;
  __Pyx_GOTREF(__pyx_v_kwargs);
  if (PyTuple_GET_SIZE(__pyx_args) > 1) {
    __pyx_v_args = PyTuple_GetSlice(__pyx_args, 1, PyTuple_GET_SIZE(__pyx_args));
    if (unlikely(!__pyx_v_args)) {
      __Pyx_DECREF(__pyx_v_kwargs); __pyx_v_kwargs = 0;
      __Pyx_RefNannyFinishContext();
      return NULL;
    }
    __Pyx_GOTREF(__pyx_v_args);
  } else {
    __pyx_v_args = __pyx_empty_tuple; __Pyx_INCREF(__pyx_empty_tuple);
  }
  {
    static PyObject **__pyx_pyargnames[] = {&__pyx_n_s_func,0};
    PyObject* values[1] = {0};
    if (unlikely(__pyx_kwds)) {
      Py_ssize_t kw_args;
      const Py_ssize_t pos_args = PyTuple_GET_SIZE(__pyx_args);
      switch (pos_args) {
        default:
        case  1: values[0] = PyTuple_GET_ITEM(__pyx_args, 0);
        case  0: break;
      }
      kw_args = PyDict_Size(__pyx_kwds);
      switch (pos_args) {
        case  0:
        if (likely((values[0] = PyDict_GetItem(__pyx_kwds, __pyx_n_s_func)) != 0)) kw_args--;
        else goto __pyx_L5_argtuple_error;
      }
      if (unlikely(kw_args > 0)) {
        const Py_ssize_t used_pos_args = (pos_args < 1) ? pos_args : 1;
        if (unlikely(__Pyx_ParseOptionalKeywords(__pyx_kwds, __pyx_pyargnames, __pyx_v_kwargs, values, used_pos_args, "callback_unfocused_add") < 0)) {__pyx_filename = __pyx_f[0]; __pyx_lineno = 171; __pyx_clineno = __LINE__; goto __pyx_L3_error;}
      }
    } else if (PyTuple_GET_SIZE(__pyx_args) < 1) {
      goto __pyx_L5_argtuple_error;
    } else {
      values[0] = PyTuple_GET_ITEM(__pyx_args, 0);
    }
    __pyx_v_func = values[0];
  }
  goto __pyx_L4_argument_unpacking_done;
  __pyx_L5_argtuple_error:;
  __Pyx_RaiseArgtupleInvalid("callback_unfocused_add", 0, 1, 1, PyTuple_GET_SIZE(__pyx_args)); {__pyx_filename = __pyx_f[0]; __pyx_lineno = 171; __pyx_clineno = __LINE__; goto __pyx_L3_error;}
  __pyx_L3_error:;
  __Pyx_DECREF(__pyx_v_args); __pyx_v_args = 0;
  __Pyx_DECREF(__pyx_v_kwargs); __pyx_v_kwargs = 0;
  __Pyx_AddTraceback("efl.elementary.bubble.Bubble.callback_unfocused_add", __pyx_clineno, __pyx_lineno, __pyx_filename);
  __Pyx_RefNannyFinishContext();
  return NULL;
  __pyx_L4_argument_unpacking_done:;
  __pyx_r = __pyx_pf_3efl_10elementary_6bubble_6Bubble_14callback_unfocused_add(((struct __pyx_obj_3efl_10elementary_6bubble_Bubble *)__pyx_v_self), __pyx_v_func, __pyx_v_args, __pyx_v_kwargs);

  /* function exit code */
  __Pyx_XDECREF(__pyx_v_args);
  __Pyx_XDECREF(__pyx_v_kwargs);
  __Pyx_RefNannyFinishContext();
  return __pyx_r;
}

static PyObject *__pyx_pf_3efl_10elementary_6bubble_6Bubble_14callback_unfocused_add(struct __pyx_obj_3efl_10elementary_6bubble_Bubble *__pyx_v_self, PyObject *__pyx_v_func, PyObject *__pyx_v_args, PyObject *__pyx_v_kwargs) {
  PyObject *__pyx_r = NULL;
  __Pyx_RefNannyDeclarations
  PyObject *__pyx_t_1 = NULL;
  PyObject *__pyx_t_2 = NULL;
  PyObject *__pyx_t_3 = NULL;
  PyObject *__pyx_t_4 = NULL;
  int __pyx_lineno = 0;
  const char *__pyx_filename = NULL;
  int __pyx_clineno = 0;
  __Pyx_RefNannySetupContext("callback_unfocused_add", 0);

  /* "efl/elementary/bubble.pyx":177
 * 
 *         """
 *         self._callback_add("unfocused", func, *args, **kwargs)             # <<<<<<<<<<<<<<
 * 
 *     def callback_unfocused_del(self, func):
 */
  __pyx_t_1 = __Pyx_PyObject_GetAttrStr(((PyObject *)__pyx_v_self), __pyx_n_s_callback_add); if (unlikely(!__pyx_t_1)) {__pyx_filename = __pyx_f[0]; __pyx_lineno = 177; __pyx_clineno = __LINE__; goto __pyx_L1_error;}
  __Pyx_GOTREF(__pyx_t_1);
  __pyx_t_2 = PyTuple_New(2); if (unlikely(!__pyx_t_2)) {__pyx_filename = __pyx_f[0]; __pyx_lineno = 177; __pyx_clineno = __LINE__; goto __pyx_L1_error;}
  __Pyx_GOTREF(__pyx_t_2);
  __Pyx_INCREF(__pyx_n_s_unfocused);
  PyTuple_SET_ITEM(__pyx_t_2, 0, __pyx_n_s_unfocused);
  __Pyx_GIVEREF(__pyx_n_s_unfocused);
  __Pyx_INCREF(__pyx_v_func);
  PyTuple_SET_ITEM(__pyx_t_2, 1, __pyx_v_func);
  __Pyx_GIVEREF(__pyx_v_func);
  __pyx_t_3 = PySequence_Tuple(__pyx_v_args); if (unlikely(!__pyx_t_3)) {__pyx_filename = __pyx_f[0]; __pyx_lineno = 177; __pyx_clineno = __LINE__; goto __pyx_L1_error;}
  __Pyx_GOTREF(__pyx_t_3);
  __pyx_t_4 = PyNumber_Add(__pyx_t_2, __pyx_t_3); if (unlikely(!__pyx_t_4)) {__pyx_filename = __pyx_f[0]; __pyx_lineno = 177; __pyx_clineno = __LINE__; goto __pyx_L1_error;}
  __Pyx_GOTREF(__pyx_t_4);
  __Pyx_DECREF(__pyx_t_2); __pyx_t_2 = 0;
  __Pyx_DECREF(__pyx_t_3); __pyx_t_3 = 0;
  __pyx_t_3 = __pyx_v_kwargs;
  __Pyx_INCREF(__pyx_t_3);
  __pyx_t_2 = __Pyx_PyObject_Call(__pyx_t_1, __pyx_t_4, __pyx_t_3); if (unlikely(!__pyx_t_2)) {__pyx_filename = __pyx_f[0]; __pyx_lineno = 177; __pyx_clineno = __LINE__; goto __pyx_L1_error;}
  __Pyx_GOTREF(__pyx_t_2);
  __Pyx_DECREF(__pyx_t_1); __pyx_t_1 = 0;
  __Pyx_DECREF(__pyx_t_4); __pyx_t_4 = 0;
  __Pyx_DECREF(__pyx_t_3); __pyx_t_3 = 0;
  __Pyx_DECREF(__pyx_t_2); __pyx_t_2 = 0;

  /* "efl/elementary/bubble.pyx":171
 *         self._callback_del("focused", func)
 * 
 *     def callback_unfocused_add(self, func, *args, **kwargs):             # <<<<<<<<<<<<<<
 *         """When the bubble has lost focus.
 * 
 */

  /* function exit code */
  __pyx_r = Py_None; __Pyx_INCREF(Py_None);
  goto __pyx_L0;
  __pyx_L1_error:;
  __Pyx_XDECREF(__pyx_t_1);
  __Pyx_XDECREF(__pyx_t_2);
  __Pyx_XDECREF(__pyx_t_3);
  __Pyx_XDECREF(__pyx_t_4);
  __Pyx_AddTraceback("efl.elementary.bubble.Bubble.callback_unfocused_add", __pyx_clineno, __pyx_lineno, __pyx_filename);
  __pyx_r = NULL;
  __pyx_L0:;
  __Pyx_XGIVEREF(__pyx_r);
  __Pyx_RefNannyFinishContext();
  return __pyx_r;
}

/* "efl/elementary/bubble.pyx":179
 *         self._callback_add("unfocused", func, *args, **kwargs)
 * 
 *     def callback_unfocused_del(self, func):             # <<<<<<<<<<<<<<
 *         self._callback_del("unfocused", func)
 * 
 */

/* Python wrapper */
static PyObject *__pyx_pw_3efl_10elementary_6bubble_6Bubble_17callback_unfocused_del(PyObject *__pyx_v_self, PyObject *__pyx_v_func); /*proto*/
static char __pyx_doc_3efl_10elementary_6bubble_6Bubble_16callback_unfocused_del[] = "Bubble.callback_unfocused_del(self, func)";
static PyObject *__pyx_pw_3efl_10elementary_6bubble_6Bubble_17callback_unfocused_del(PyObject *__pyx_v_self, PyObject *__pyx_v_func) {
  PyObject *__pyx_r = 0;
  __Pyx_RefNannyDeclarations
  __Pyx_RefNannySetupContext("callback_unfocused_del (wrapper)", 0);
  __pyx_r = __pyx_pf_3efl_10elementary_6bubble_6Bubble_16callback_unfocused_del(((struct __pyx_obj_3efl_10elementary_6bubble_Bubble *)__pyx_v_self), ((PyObject *)__pyx_v_func));

  /* function exit code */
  __Pyx_RefNannyFinishContext();
  return __pyx_r;
}

static PyObject *__pyx_pf_3efl_10elementary_6bubble_6Bubble_16callback_unfocused_del(struct __pyx_obj_3efl_10elementary_6bubble_Bubble *__pyx_v_self, PyObject *__pyx_v_func) {
  PyObject *__pyx_r = NULL;
  __Pyx_RefNannyDeclarations
  PyObject *__pyx_t_1 = NULL;
  PyObject *__pyx_t_2 = NULL;
  PyObject *__pyx_t_3 = NULL;
  Py_ssize_t __pyx_t_4;
  PyObject *__pyx_t_5 = NULL;
  int __pyx_lineno = 0;
  const char *__pyx_filename = NULL;
  int __pyx_clineno = 0;
  __Pyx_RefNannySetupContext("callback_unfocused_del", 0);

  /* "efl/elementary/bubble.pyx":180
 * 
 *     def callback_unfocused_del(self, func):
 *         self._callback_del("unfocused", func)             # <<<<<<<<<<<<<<
 * 
 * _object_mapping_register("Elm_Bubble", Bubble)
 */
  __pyx_t_2 = __Pyx_PyObject_GetAttrStr(((PyObject *)__pyx_v_self), __pyx_n_s_callback_del); if (unlikely(!__pyx_t_2)) {__pyx_filename = __pyx_f[0]; __pyx_lineno = 180; __pyx_clineno = __LINE__; goto __pyx_L1_error;}
  __Pyx_GOTREF(__pyx_t_2);
  __pyx_t_3 = NULL;
  __pyx_t_4 = 0;
  if (CYTHON_COMPILING_IN_CPYTHON && likely(PyMethod_Check(__pyx_t_2))) {
    __pyx_t_3 = PyMethod_GET_SELF(__pyx_t_2);
    if (likely(__pyx_t_3)) {
      PyObject* function = PyMethod_GET_FUNCTION(__pyx_t_2);
      __Pyx_INCREF(__pyx_t_3);
      __Pyx_INCREF(function);
      __Pyx_DECREF_SET(__pyx_t_2, function);
      __pyx_t_4 = 1;
    }
  }
  __pyx_t_5 = PyTuple_New(2+__pyx_t_4); if (unlikely(!__pyx_t_5)) {__pyx_filename = __pyx_f[0]; __pyx_lineno = 180; __pyx_clineno = __LINE__; goto __pyx_L1_error;}
  __Pyx_GOTREF(__pyx_t_5);
  if (__pyx_t_3) {
    PyTuple_SET_ITEM(__pyx_t_5, 0, __pyx_t_3); __Pyx_GIVEREF(__pyx_t_3); __pyx_t_3 = NULL;
  }
  __Pyx_INCREF(__pyx_n_s_unfocused);
  PyTuple_SET_ITEM(__pyx_t_5, 0+__pyx_t_4, __pyx_n_s_unfocused);
  __Pyx_GIVEREF(__pyx_n_s_unfocused);
  __Pyx_INCREF(__pyx_v_func);
  PyTuple_SET_ITEM(__pyx_t_5, 1+__pyx_t_4, __pyx_v_func);
  __Pyx_GIVEREF(__pyx_v_func);
  __pyx_t_1 = __Pyx_PyObject_Call(__pyx_t_2, __pyx_t_5, NULL); if (unlikely(!__pyx_t_1)) {__pyx_filename = __pyx_f[0]; __pyx_lineno = 180; __pyx_clineno = __LINE__; goto __pyx_L1_error;}
  __Pyx_GOTREF(__pyx_t_1);
  __Pyx_DECREF(__pyx_t_5); __pyx_t_5 = 0;
  __Pyx_DECREF(__pyx_t_2); __pyx_t_2 = 0;
  __Pyx_DECREF(__pyx_t_1); __pyx_t_1 = 0;

  /* "efl/elementary/bubble.pyx":179
 *         self._callback_add("unfocused", func, *args, **kwargs)
 * 
 *     def callback_unfocused_del(self, func):             # <<<<<<<<<<<<<<
 *         self._callback_del("unfocused", func)
 * 
 */

  /* function exit code */
  __pyx_r = Py_None; __Pyx_INCREF(Py_None);
  goto __pyx_L0;
  __pyx_L1_error:;
  __Pyx_XDECREF(__pyx_t_1);
  __Pyx_XDECREF(__pyx_t_2);
  __Pyx_XDECREF(__pyx_t_3);
  __Pyx_XDECREF(__pyx_t_5);
  __Pyx_AddTraceback("efl.elementary.bubble.Bubble.callback_unfocused_del", __pyx_clineno, __pyx_lineno, __pyx_filename);
  __pyx_r = NULL;
  __pyx_L0:;
  __Pyx_XGIVEREF(__pyx_r);
  __Pyx_RefNannyFinishContext();
  return __pyx_r;
}
static struct __pyx_vtabstruct_3efl_10elementary_6bubble_Bubble __pyx_vtable_3efl_10elementary_6bubble_Bubble;

static PyObject *__pyx_tp_new_3efl_10elementary_6bubble_Bubble(PyTypeObject *t, PyObject *a, PyObject *k) {
  struct __pyx_obj_3efl_10elementary_6bubble_Bubble *p;
  PyObject *o = __pyx_ptype_3efl_10elementary_12layout_class_LayoutClass->tp_new(t, a, k);
  if (unlikely(!o)) return 0;
  p = ((struct __pyx_obj_3efl_10elementary_6bubble_Bubble *)o);
  p->__pyx_base.__pyx_base.__pyx_base.__pyx_base.__pyx_vtab = (struct __pyx_vtabstruct_3efl_2eo_Eo*)__pyx_vtabptr_3efl_10elementary_6bubble_Bubble;
  return o;
}

static void __pyx_tp_dealloc_3efl_10elementary_6bubble_Bubble(PyObject *o) {
  #if PY_VERSION_HEX >= 0x030400a1
  if (unlikely(Py_TYPE(o)->tp_finalize) && !_PyGC_FINALIZED(o)) {
    if (PyObject_CallFinalizerFromDealloc(o)) return;
  }
  #endif
  PyObject_GC_UnTrack(o);
  PyObject_GC_Track(o);
  if (likely(__pyx_ptype_3efl_10elementary_12layout_class_LayoutClass)) __pyx_ptype_3efl_10elementary_12layout_class_LayoutClass->tp_dealloc(o); else __Pyx_call_next_tp_dealloc(o, __pyx_tp_dealloc_3efl_10elementary_6bubble_Bubble);
}

static int __pyx_tp_traverse_3efl_10elementary_6bubble_Bubble(PyObject *o, visitproc v, void *a) {
  int e;
  e = ((likely(__pyx_ptype_3efl_10elementary_12layout_class_LayoutClass)) ? ((__pyx_ptype_3efl_10elementary_12layout_class_LayoutClass->tp_traverse) ? __pyx_ptype_3efl_10elementary_12layout_class_LayoutClass->tp_traverse(o, v, a) : 0) : __Pyx_call_next_tp_traverse(o, v, a, __pyx_tp_traverse_3efl_10elementary_6bubble_Bubble)); if (e) return e;
  return 0;
}

static int __pyx_tp_clear_3efl_10elementary_6bubble_Bubble(PyObject *o) {
  if (likely(__pyx_ptype_3efl_10elementary_12layout_class_LayoutClass)) { if (__pyx_ptype_3efl_10elementary_12layout_class_LayoutClass->tp_clear) __pyx_ptype_3efl_10elementary_12layout_class_LayoutClass->tp_clear(o); } else __Pyx_call_next_tp_clear(o, __pyx_tp_clear_3efl_10elementary_6bubble_Bubble);
  return 0;
}

static PyObject *__pyx_getprop_3efl_10elementary_6bubble_6Bubble_pos(PyObject *o, CYTHON_UNUSED void *x) {
  return __pyx_pw_3efl_10elementary_6bubble_6Bubble_3pos_1__get__(o);
}

static int __pyx_setprop_3efl_10elementary_6bubble_6Bubble_pos(PyObject *o, PyObject *v, CYTHON_UNUSED void *x) {
  if (v) {
    return __pyx_pw_3efl_10elementary_6bubble_6Bubble_3pos_3__set__(o, v);
  }
  else {
    PyErr_SetString(PyExc_NotImplementedError, "__del__");
    return -1;
  }
}

static PyMethodDef __pyx_methods_3efl_10elementary_6bubble_Bubble[] = {
  {"pos_set", (PyCFunction)__pyx_pw_3efl_10elementary_6bubble_6Bubble_3pos_set, METH_O, __pyx_doc_3efl_10elementary_6bubble_6Bubble_2pos_set},
  {"pos_get", (PyCFunction)__pyx_pw_3efl_10elementary_6bubble_6Bubble_5pos_get, METH_NOARGS, __pyx_doc_3efl_10elementary_6bubble_6Bubble_4pos_get},
  {"callback_clicked_add", (PyCFunction)__pyx_pw_3efl_10elementary_6bubble_6Bubble_7callback_clicked_add, METH_VARARGS|METH_KEYWORDS, __pyx_doc_3efl_10elementary_6bubble_6Bubble_6callback_clicked_add},
  {"callback_clicked_del", (PyCFunction)__pyx_pw_3efl_10elementary_6bubble_6Bubble_9callback_clicked_del, METH_O, __pyx_doc_3efl_10elementary_6bubble_6Bubble_8callback_clicked_del},
  {"callback_focused_add", (PyCFunction)__pyx_pw_3efl_10elementary_6bubble_6Bubble_11callback_focused_add, METH_VARARGS|METH_KEYWORDS, __pyx_doc_3efl_10elementary_6bubble_6Bubble_10callback_focused_add},
  {"callback_focused_del", (PyCFunction)__pyx_pw_3efl_10elementary_6bubble_6Bubble_13callback_focused_del, METH_O, __pyx_doc_3efl_10elementary_6bubble_6Bubble_12callback_focused_del},
  {"callback_unfocused_add", (PyCFunction)__pyx_pw_3efl_10elementary_6bubble_6Bubble_15callback_unfocused_add, METH_VARARGS|METH_KEYWORDS, __pyx_doc_3efl_10elementary_6bubble_6Bubble_14callback_unfocused_add},
  {"callback_unfocused_del", (PyCFunction)__pyx_pw_3efl_10elementary_6bubble_6Bubble_17callback_unfocused_del, METH_O, __pyx_doc_3efl_10elementary_6bubble_6Bubble_16callback_unfocused_del},
  {0, 0, 0, 0}
};

static struct PyGetSetDef __pyx_getsets_3efl_10elementary_6bubble_Bubble[] = {
  {(char *)"pos", __pyx_getprop_3efl_10elementary_6bubble_6Bubble_pos, __pyx_setprop_3efl_10elementary_6bubble_6Bubble_pos, __pyx_k_The_corner_of_the_bubble_This_pr, 0},
  {0, 0, 0, 0, 0}
};

static PyTypeObject __pyx_type_3efl_10elementary_6bubble_Bubble = {
  PyVarObject_HEAD_INIT(0, 0)
  "efl.elementary.bubble.Bubble", /*tp_name*/
  sizeof(struct __pyx_obj_3efl_10elementary_6bubble_Bubble), /*tp_basicsize*/
  0, /*tp_itemsize*/
  __pyx_tp_dealloc_3efl_10elementary_6bubble_Bubble, /*tp_dealloc*/
  0, /*tp_print*/
  0, /*tp_getattr*/
  0, /*tp_setattr*/
  #if PY_MAJOR_VERSION < 3
  0, /*tp_compare*/
  #else
  0, /*reserved*/
  #endif
  0, /*tp_repr*/
  0, /*tp_as_number*/
  0, /*tp_as_sequence*/
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  0, /*tp_as_buffer*/
  Py_TPFLAGS_DEFAULT|Py_TPFLAGS_HAVE_VERSION_TAG|Py_TPFLAGS_CHECKTYPES|Py_TPFLAGS_HAVE_NEWBUFFER|Py_TPFLAGS_BASETYPE|Py_TPFLAGS_HAVE_GC, /*tp_flags*/
  "Bubble(Object parent, *args, **kwargs)\n\n\n    This is the class that actually implements the widget.\n\n    ", /*tp_doc*/
  __pyx_tp_traverse_3efl_10elementary_6bubble_Bubble, /*tp_traverse*/
  __pyx_tp_clear_3efl_10elementary_6bubble_Bubble, /*tp_clear*/
  0, /*tp_richcompare*/
  0, /*tp_weaklistoffset*/
  0, /*tp_iter*/
  0, /*tp_iternext*/
  __pyx_methods_3efl_10elementary_6bubble_Bubble, /*tp_methods*/
  0, /*tp_members*/
  __pyx_getsets_3efl_10elementary_6bubble_Bubble, /*tp_getset*/
  0, /*tp_base*/
  0, /*tp_dict*/
  0, /*tp_descr_get*/
  0, /*tp_descr_set*/
  0, /*tp_dictoffset*/
  __pyx_pw_3efl_10elementary_6bubble_6Bubble_1__init__, /*tp_init*/
  0, /*tp_alloc*/
  __pyx_tp_new_3efl_10elementary_6bubble_Bubble, /*tp_new*/
  0, /*tp_free*/
  0, /*tp_is_gc*/
  0, /*tp_bases*/
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  0, /*tp_version_tag*/
  #if PY_VERSION_HEX >= 0x030400a1
  0, /*tp_finalize*/
  #endif
};

static PyMethodDef __pyx_methods[] = {
  {0, 0, 0, 0}
};

#if PY_MAJOR_VERSION >= 3
static struct PyModuleDef __pyx_moduledef = {
  #if PY_VERSION_HEX < 0x03020000
    { PyObject_HEAD_INIT(NULL) NULL, 0, NULL },
  #else
    PyModuleDef_HEAD_INIT,
  #endif
    "bubble",
    __pyx_k_mod_bubble_Module_image_images, /* m_doc */
    -1, /* m_size */
    __pyx_methods /* m_methods */,
    NULL, /* m_reload */
    NULL, /* m_traverse */
    NULL, /* m_clear */
    NULL /* m_free */
};
#endif

static __Pyx_StringTabEntry __pyx_string_tab[] = {
  {&__pyx_n_s_callback_add, __pyx_k_callback_add, sizeof(__pyx_k_callback_add), 0, 0, 1, 1},
  {&__pyx_n_s_callback_del, __pyx_k_callback_del, sizeof(__pyx_k_callback_del), 0, 0, 1, 1},
  {&__pyx_n_s_clicked, __pyx_k_clicked, sizeof(__pyx_k_clicked), 0, 0, 1, 1},
  {&__pyx_n_s_focused, __pyx_k_focused, sizeof(__pyx_k_focused), 0, 0, 1, 1},
  {&__pyx_n_s_func, __pyx_k_func, sizeof(__pyx_k_func), 0, 0, 1, 1},
  {&__pyx_n_s_main, __pyx_k_main, sizeof(__pyx_k_main), 0, 0, 1, 1},
  {&__pyx_n_s_parent, __pyx_k_parent, sizeof(__pyx_k_parent), 0, 0, 1, 1},
  {&__pyx_n_s_pyx_vtable, __pyx_k_pyx_vtable, sizeof(__pyx_k_pyx_vtable), 0, 0, 1, 1},
  {&__pyx_n_s_test, __pyx_k_test, sizeof(__pyx_k_test), 0, 0, 1, 1},
  {&__pyx_n_s_unfocused, __pyx_k_unfocused, sizeof(__pyx_k_unfocused), 0, 0, 1, 1},
  {0, 0, 0, 0, 0, 0, 0}
};
static int __Pyx_InitCachedBuiltins(void) {
  return 0;
}

static int __Pyx_InitCachedConstants(void) {
  __Pyx_RefNannyDeclarations
  __Pyx_RefNannySetupContext("__Pyx_InitCachedConstants", 0);
  __Pyx_RefNannyFinishContext();
  return 0;
}

static int __Pyx_InitGlobals(void) {
  if (__Pyx_InitStrings(__pyx_string_tab) < 0) {__pyx_filename = __pyx_f[0]; __pyx_lineno = 1; __pyx_clineno = __LINE__; goto __pyx_L1_error;};
  return 0;
  __pyx_L1_error:;
  return -1;
}

#if PY_MAJOR_VERSION < 3
PyMODINIT_FUNC initbubble(void); /*proto*/
PyMODINIT_FUNC initbubble(void)
#else
PyMODINIT_FUNC PyInit_bubble(void); /*proto*/
PyMODINIT_FUNC PyInit_bubble(void)
#endif
{
  PyObject *__pyx_t_1 = NULL;
  PyObject *__pyx_t_2 = NULL;
  int __pyx_lineno = 0;
  const char *__pyx_filename = NULL;
  int __pyx_clineno = 0;
  __Pyx_RefNannyDeclarations
  #if CYTHON_REFNANNY
  __Pyx_RefNanny = __Pyx_RefNannyImportAPI("refnanny");
  if (!__Pyx_RefNanny) {
      PyErr_Clear();
      __Pyx_RefNanny = __Pyx_RefNannyImportAPI("Cython.Runtime.refnanny");
      if (!__Pyx_RefNanny)
          Py_FatalError("failed to import 'refnanny' module");
  }
  #endif
  __Pyx_RefNannySetupContext("PyMODINIT_FUNC PyInit_bubble(void)", 0);
  if ( __Pyx_check_binary_version() < 0) {__pyx_filename = __pyx_f[0]; __pyx_lineno = 1; __pyx_clineno = __LINE__; goto __pyx_L1_error;}
  __pyx_empty_tuple = PyTuple_New(0); if (unlikely(!__pyx_empty_tuple)) {__pyx_filename = __pyx_f[0]; __pyx_lineno = 1; __pyx_clineno = __LINE__; goto __pyx_L1_error;}
  __pyx_empty_bytes = PyBytes_FromStringAndSize("", 0); if (unlikely(!__pyx_empty_bytes)) {__pyx_filename = __pyx_f[0]; __pyx_lineno = 1; __pyx_clineno = __LINE__; goto __pyx_L1_error;}
  #ifdef __Pyx_CyFunction_USED
  if (__Pyx_CyFunction_init() < 0) {__pyx_filename = __pyx_f[0]; __pyx_lineno = 1; __pyx_clineno = __LINE__; goto __pyx_L1_error;}
  #endif
  #ifdef __Pyx_FusedFunction_USED
  if (__pyx_FusedFunction_init() < 0) {__pyx_filename = __pyx_f[0]; __pyx_lineno = 1; __pyx_clineno = __LINE__; goto __pyx_L1_error;}
  #endif
  #ifdef __Pyx_Generator_USED
  if (__pyx_Generator_init() < 0) {__pyx_filename = __pyx_f[0]; __pyx_lineno = 1; __pyx_clineno = __LINE__; goto __pyx_L1_error;}
  #endif
  /*--- Library function declarations ---*/
  /*--- Threads initialization code ---*/
  #if defined(__PYX_FORCE_INIT_THREADS) && __PYX_FORCE_INIT_THREADS
  #ifdef WITH_THREAD /* Python build with threading support? */
  PyEval_InitThreads();
  #endif
  #endif
  /*--- Module creation code ---*/
  #if PY_MAJOR_VERSION < 3
  __pyx_m = Py_InitModule4("bubble", __pyx_methods, __pyx_k_mod_bubble_Module_image_images, 0, PYTHON_API_VERSION); Py_XINCREF(__pyx_m);
  #else
  __pyx_m = PyModule_Create(&__pyx_moduledef);
  #endif
  if (unlikely(!__pyx_m)) {__pyx_filename = __pyx_f[0]; __pyx_lineno = 1; __pyx_clineno = __LINE__; goto __pyx_L1_error;}
  __pyx_d = PyModule_GetDict(__pyx_m); if (unlikely(!__pyx_d)) {__pyx_filename = __pyx_f[0]; __pyx_lineno = 1; __pyx_clineno = __LINE__; goto __pyx_L1_error;}
  Py_INCREF(__pyx_d);
  __pyx_b = PyImport_AddModule(__Pyx_BUILTIN_MODULE_NAME); if (unlikely(!__pyx_b)) {__pyx_filename = __pyx_f[0]; __pyx_lineno = 1; __pyx_clineno = __LINE__; goto __pyx_L1_error;}
  #if CYTHON_COMPILING_IN_PYPY
  Py_INCREF(__pyx_b);
  #endif
  if (PyObject_SetAttrString(__pyx_m, "__builtins__", __pyx_b) < 0) {__pyx_filename = __pyx_f[0]; __pyx_lineno = 1; __pyx_clineno = __LINE__; goto __pyx_L1_error;};
  /*--- Initialize various global constants etc. ---*/
  if (unlikely(__Pyx_InitGlobals() < 0)) {__pyx_filename = __pyx_f[0]; __pyx_lineno = 1; __pyx_clineno = __LINE__; goto __pyx_L1_error;}
  #if PY_MAJOR_VERSION < 3 && (__PYX_DEFAULT_STRING_ENCODING_IS_ASCII || __PYX_DEFAULT_STRING_ENCODING_IS_DEFAULT)
  if (__Pyx_init_sys_getdefaultencoding_params() < 0) {__pyx_filename = __pyx_f[0]; __pyx_lineno = 1; __pyx_clineno = __LINE__; goto __pyx_L1_error;}
  #endif
  if (__pyx_module_is_main_efl__elementary__bubble) {
    if (PyObject_SetAttrString(__pyx_m, "__name__", __pyx_n_s_main) < 0) {__pyx_filename = __pyx_f[0]; __pyx_lineno = 1; __pyx_clineno = __LINE__; goto __pyx_L1_error;};
  }
  #if PY_MAJOR_VERSION >= 3
  {
    PyObject *modules = PyImport_GetModuleDict(); if (unlikely(!modules)) {__pyx_filename = __pyx_f[0]; __pyx_lineno = 1; __pyx_clineno = __LINE__; goto __pyx_L1_error;}
    if (!PyDict_GetItemString(modules, "efl.elementary.bubble")) {
      if (unlikely(PyDict_SetItemString(modules, "efl.elementary.bubble", __pyx_m) < 0)) {__pyx_filename = __pyx_f[0]; __pyx_lineno = 1; __pyx_clineno = __LINE__; goto __pyx_L1_error;}
    }
  }
  #endif
  /*--- Builtin init code ---*/
  if (unlikely(__Pyx_InitCachedBuiltins() < 0)) {__pyx_filename = __pyx_f[0]; __pyx_lineno = 1; __pyx_clineno = __LINE__; goto __pyx_L1_error;}
  /*--- Constants init code ---*/
  if (unlikely(__Pyx_InitCachedConstants() < 0)) {__pyx_filename = __pyx_f[0]; __pyx_lineno = 1; __pyx_clineno = __LINE__; goto __pyx_L1_error;}
  /*--- Global init code ---*/
  /*--- Variable export code ---*/
  /*--- Function export code ---*/
  /*--- Type init code ---*/
  __pyx_ptype_3efl_10elementary_12layout_class_LayoutClass = __Pyx_ImportType("efl.elementary.layout_class", "LayoutClass", sizeof(struct __pyx_obj_3efl_10elementary_12layout_class_LayoutClass), 1); if (unlikely(!__pyx_ptype_3efl_10elementary_12layout_class_LayoutClass)) {__pyx_filename = __pyx_f[0]; __pyx_lineno = 1; __pyx_clineno = __LINE__; goto __pyx_L1_error;}
  __pyx_vtabptr_3efl_10elementary_12layout_class_LayoutClass = (struct __pyx_vtabstruct_3efl_10elementary_12layout_class_LayoutClass*)__Pyx_GetVtable(__pyx_ptype_3efl_10elementary_12layout_class_LayoutClass->tp_dict); if (unlikely(!__pyx_vtabptr_3efl_10elementary_12layout_class_LayoutClass)) {__pyx_filename = __pyx_f[0]; __pyx_lineno = 1; __pyx_clineno = __LINE__; goto __pyx_L1_error;}
  __pyx_vtabptr_3efl_10elementary_6bubble_Bubble = &__pyx_vtable_3efl_10elementary_6bubble_Bubble;
  __pyx_vtable_3efl_10elementary_6bubble_Bubble.__pyx_base = *__pyx_vtabptr_3efl_10elementary_12layout_class_LayoutClass;
  __pyx_type_3efl_10elementary_6bubble_Bubble.tp_base = __pyx_ptype_3efl_10elementary_12layout_class_LayoutClass;
  if (PyType_Ready(&__pyx_type_3efl_10elementary_6bubble_Bubble) < 0) {__pyx_filename = __pyx_f[0]; __pyx_lineno = 113; __pyx_clineno = __LINE__; goto __pyx_L1_error;}
  __pyx_type_3efl_10elementary_6bubble_Bubble.tp_print = 0;
  #if CYTHON_COMPILING_IN_CPYTHON
  {
    PyObject *wrapper = PyObject_GetAttrString((PyObject *)&__pyx_type_3efl_10elementary_6bubble_Bubble, "__init__"); if (unlikely(!wrapper)) {__pyx_filename = __pyx_f[0]; __pyx_lineno = 113; __pyx_clineno = __LINE__; goto __pyx_L1_error;}
    if (Py_TYPE(wrapper) == &PyWrapperDescr_Type) {
      __pyx_wrapperbase_3efl_10elementary_6bubble_6Bubble___init__ = *((PyWrapperDescrObject *)wrapper)->d_base;
      __pyx_wrapperbase_3efl_10elementary_6bubble_6Bubble___init__.doc = __pyx_doc_3efl_10elementary_6bubble_6Bubble___init__;
      ((PyWrapperDescrObject *)wrapper)->d_base = &__pyx_wrapperbase_3efl_10elementary_6bubble_6Bubble___init__;
    }
  }
  #endif
  if (__Pyx_SetVtable(__pyx_type_3efl_10elementary_6bubble_Bubble.tp_dict, __pyx_vtabptr_3efl_10elementary_6bubble_Bubble) < 0) {__pyx_filename = __pyx_f[0]; __pyx_lineno = 113; __pyx_clineno = __LINE__; goto __pyx_L1_error;}
  if (PyObject_SetAttrString(__pyx_m, "Bubble", (PyObject *)&__pyx_type_3efl_10elementary_6bubble_Bubble) < 0) {__pyx_filename = __pyx_f[0]; __pyx_lineno = 113; __pyx_clineno = __LINE__; goto __pyx_L1_error;}
  __pyx_ptype_3efl_10elementary_6bubble_Bubble = &__pyx_type_3efl_10elementary_6bubble_Bubble;
  /*--- Type import code ---*/
  __pyx_ptype_7cpython_4type_type = __Pyx_ImportType(__Pyx_BUILTIN_MODULE_NAME, "type", 
  #if CYTHON_COMPILING_IN_PYPY
  sizeof(PyTypeObject),
  #else
  sizeof(PyHeapTypeObject),
  #endif
  0); if (unlikely(!__pyx_ptype_7cpython_4type_type)) {__pyx_filename = __pyx_f[1]; __pyx_lineno = 9; __pyx_clineno = __LINE__; goto __pyx_L1_error;}
  __pyx_ptype_7cpython_4bool_bool = __Pyx_ImportType(__Pyx_BUILTIN_MODULE_NAME, "bool", sizeof(PyBoolObject), 0); if (unlikely(!__pyx_ptype_7cpython_4bool_bool)) {__pyx_filename = __pyx_f[2]; __pyx_lineno = 8; __pyx_clineno = __LINE__; goto __pyx_L1_error;}
  __pyx_ptype_7cpython_7complex_complex = __Pyx_ImportType(__Pyx_BUILTIN_MODULE_NAME, "complex", sizeof(PyComplexObject), 0); if (unlikely(!__pyx_ptype_7cpython_7complex_complex)) {__pyx_filename = __pyx_f[3]; __pyx_lineno = 15; __pyx_clineno = __LINE__; goto __pyx_L1_error;}
  __pyx_ptype_3efl_2eo_Eo = __Pyx_ImportType("efl.eo", "Eo", sizeof(struct __pyx_obj_3efl_2eo_Eo), 1); if (unlikely(!__pyx_ptype_3efl_2eo_Eo)) {__pyx_filename = __pyx_f[4]; __pyx_lineno = 21; __pyx_clineno = __LINE__; goto __pyx_L1_error;}
  __pyx_vtabptr_3efl_2eo_Eo = (struct __pyx_vtabstruct_3efl_2eo_Eo*)__Pyx_GetVtable(__pyx_ptype_3efl_2eo_Eo->tp_dict); if (unlikely(!__pyx_vtabptr_3efl_2eo_Eo)) {__pyx_filename = __pyx_f[4]; __pyx_lineno = 21; __pyx_clineno = __LINE__; goto __pyx_L1_error;}
  __pyx_ptype_3efl_4evas_Rect = __Pyx_ImportType("efl.evas", "Rect", sizeof(struct __pyx_obj_3efl_4evas_Rect), 1); if (unlikely(!__pyx_ptype_3efl_4evas_Rect)) {__pyx_filename = __pyx_f[5]; __pyx_lineno = 1161; __pyx_clineno = __LINE__; goto __pyx_L1_error;}
  __pyx_ptype_3efl_4evas_Canvas = __Pyx_ImportType("efl.evas", "Canvas", sizeof(struct __pyx_obj_3efl_4evas_Canvas), 1); if (unlikely(!__pyx_ptype_3efl_4evas_Canvas)) {__pyx_filename = __pyx_f[5]; __pyx_lineno = 1165; __pyx_clineno = __LINE__; goto __pyx_L1_error;}
  __pyx_vtabptr_3efl_4evas_Canvas = (struct __pyx_vtabstruct_3efl_4evas_Canvas*)__Pyx_GetVtable(__pyx_ptype_3efl_4evas_Canvas->tp_dict); if (unlikely(!__pyx_vtabptr_3efl_4evas_Canvas)) {__pyx_filename = __pyx_f[5]; __pyx_lineno = 1165; __pyx_clineno = __LINE__; goto __pyx_L1_error;}
  __pyx_ptype_3efl_4evas_Map = __Pyx_ImportType("efl.evas", "Map", sizeof(struct __pyx_obj_3efl_4evas_Map), 1); if (unlikely(!__pyx_ptype_3efl_4evas_Map)) {__pyx_filename = __pyx_f[5]; __pyx_lineno = 1169; __pyx_clineno = __LINE__; goto __pyx_L1_error;}
  __pyx_ptype_3efl_4evas_Object = __Pyx_ImportType("efl.evas", "Object", sizeof(struct __pyx_obj_3efl_4evas_Object), 1); if (unlikely(!__pyx_ptype_3efl_4evas_Object)) {__pyx_filename = __pyx_f[5]; __pyx_lineno = 1173; __pyx_clineno = __LINE__; goto __pyx_L1_error;}
  __pyx_vtabptr_3efl_4evas_Object = (struct __pyx_vtabstruct_3efl_4evas_Object*)__Pyx_GetVtable(__pyx_ptype_3efl_4evas_Object->tp_dict); if (unlikely(!__pyx_vtabptr_3efl_4evas_Object)) {__pyx_filename = __pyx_f[5]; __pyx_lineno = 1173; __pyx_clineno = __LINE__; goto __pyx_L1_error;}
  __pyx_ptype_3efl_4evas_Rectangle = __Pyx_ImportType("efl.evas", "Rectangle", sizeof(struct __pyx_obj_3efl_4evas_Rectangle), 1); if (unlikely(!__pyx_ptype_3efl_4evas_Rectangle)) {__pyx_filename = __pyx_f[5]; __pyx_lineno = 1177; __pyx_clineno = __LINE__; goto __pyx_L1_error;}
  __pyx_vtabptr_3efl_4evas_Rectangle = (struct __pyx_vtabstruct_3efl_4evas_Rectangle*)__Pyx_GetVtable(__pyx_ptype_3efl_4evas_Rectangle->tp_dict); if (unlikely(!__pyx_vtabptr_3efl_4evas_Rectangle)) {__pyx_filename = __pyx_f[5]; __pyx_lineno = 1177; __pyx_clineno = __LINE__; goto __pyx_L1_error;}
  __pyx_ptype_3efl_4evas_Line = __Pyx_ImportType("efl.evas", "Line", sizeof(struct __pyx_obj_3efl_4evas_Line), 1); if (unlikely(!__pyx_ptype_3efl_4evas_Line)) {__pyx_filename = __pyx_f[5]; __pyx_lineno = 1181; __pyx_clineno = __LINE__; goto __pyx_L1_error;}
  __pyx_vtabptr_3efl_4evas_Line = (struct __pyx_vtabstruct_3efl_4evas_Line*)__Pyx_GetVtable(__pyx_ptype_3efl_4evas_Line->tp_dict); if (unlikely(!__pyx_vtabptr_3efl_4evas_Line)) {__pyx_filename = __pyx_f[5]; __pyx_lineno = 1181; __pyx_clineno = __LINE__; goto __pyx_L1_error;}
  __pyx_ptype_3efl_4evas_Image = __Pyx_ImportType("efl.evas", "Image", sizeof(struct __pyx_obj_3efl_4evas_Image), 1); if (unlikely(!__pyx_ptype_3efl_4evas_Image)) {__pyx_filename = __pyx_f[5]; __pyx_lineno = 1185; __pyx_clineno = __LINE__; goto __pyx_L1_error;}
  __pyx_vtabptr_3efl_4evas_Image = (struct __pyx_vtabstruct_3efl_4evas_Image*)__Pyx_GetVtable(__pyx_ptype_3efl_4evas_Image->tp_dict); if (unlikely(!__pyx_vtabptr_3efl_4evas_Image)) {__pyx_filename = __pyx_f[5]; __pyx_lineno = 1185; __pyx_clineno = __LINE__; goto __pyx_L1_error;}
  __pyx_ptype_3efl_4evas_FilledImage = __Pyx_ImportType("efl.evas", "FilledImage", sizeof(struct __pyx_obj_3efl_4evas_FilledImage), 1); if (unlikely(!__pyx_ptype_3efl_4evas_FilledImage)) {__pyx_filename = __pyx_f[5]; __pyx_lineno = 1189; __pyx_clineno = __LINE__; goto __pyx_L1_error;}
  __pyx_vtabptr_3efl_4evas_FilledImage = (struct __pyx_vtabstruct_3efl_4evas_FilledImage*)__Pyx_GetVtable(__pyx_ptype_3efl_4evas_FilledImage->tp_dict); if (unlikely(!__pyx_vtabptr_3efl_4evas_FilledImage)) {__pyx_filename = __pyx_f[5]; __pyx_lineno = 1189; __pyx_clineno = __LINE__; goto __pyx_L1_error;}
  __pyx_ptype_3efl_4evas_Polygon = __Pyx_ImportType("efl.evas", "Polygon", sizeof(struct __pyx_obj_3efl_4evas_Polygon), 1); if (unlikely(!__pyx_ptype_3efl_4evas_Polygon)) {__pyx_filename = __pyx_f[5]; __pyx_lineno = 1193; __pyx_clineno = __LINE__; goto __pyx_L1_error;}
  __pyx_vtabptr_3efl_4evas_Polygon = (struct __pyx_vtabstruct_3efl_4evas_Polygon*)__Pyx_GetVtable(__pyx_ptype_3efl_4evas_Polygon->tp_dict); if (unlikely(!__pyx_vtabptr_3efl_4evas_Polygon)) {__pyx_filename = __pyx_f[5]; __pyx_lineno = 1193; __pyx_clineno = __LINE__; goto __pyx_L1_error;}
  __pyx_ptype_3efl_4evas_Text = __Pyx_ImportType("efl.evas", "Text", sizeof(struct __pyx_obj_3efl_4evas_Text), 1); if (unlikely(!__pyx_ptype_3efl_4evas_Text)) {__pyx_filename = __pyx_f[5]; __pyx_lineno = 1197; __pyx_clineno = __LINE__; goto __pyx_L1_error;}
  __pyx_vtabptr_3efl_4evas_Text = (struct __pyx_vtabstruct_3efl_4evas_Text*)__Pyx_GetVtable(__pyx_ptype_3efl_4evas_Text->tp_dict); if (unlikely(!__pyx_vtabptr_3efl_4evas_Text)) {__pyx_filename = __pyx_f[5]; __pyx_lineno = 1197; __pyx_clineno = __LINE__; goto __pyx_L1_error;}
  __pyx_ptype_3efl_4evas_Textblock = __Pyx_ImportType("efl.evas", "Textblock", sizeof(struct __pyx_obj_3efl_4evas_Textblock), 1); if (unlikely(!__pyx_ptype_3efl_4evas_Textblock)) {__pyx_filename = __pyx_f[5]; __pyx_lineno = 1201; __pyx_clineno = __LINE__; goto __pyx_L1_error;}
  __pyx_vtabptr_3efl_4evas_Textblock = (struct __pyx_vtabstruct_3efl_4evas_Textblock*)__Pyx_GetVtable(__pyx_ptype_3efl_4evas_Textblock->tp_dict); if (unlikely(!__pyx_vtabptr_3efl_4evas_Textblock)) {__pyx_filename = __pyx_f[5]; __pyx_lineno = 1201; __pyx_clineno = __LINE__; goto __pyx_L1_error;}
  __pyx_ptype_3efl_4evas_EventPoint = __Pyx_ImportType("efl.evas", "EventPoint", sizeof(struct __pyx_obj_3efl_4evas_EventPoint), 1); if (unlikely(!__pyx_ptype_3efl_4evas_EventPoint)) {__pyx_filename = __pyx_f[5]; __pyx_lineno = 1223; __pyx_clineno = __LINE__; goto __pyx_L1_error;}
  __pyx_vtabptr_3efl_4evas_EventPoint = (struct __pyx_vtabstruct_3efl_4evas_EventPoint*)__Pyx_GetVtable(__pyx_ptype_3efl_4evas_EventPoint->tp_dict); if (unlikely(!__pyx_vtabptr_3efl_4evas_EventPoint)) {__pyx_filename = __pyx_f[5]; __pyx_lineno = 1223; __pyx_clineno = __LINE__; goto __pyx_L1_error;}
  __pyx_ptype_3efl_4evas_EventCoordPoint = __Pyx_ImportType("efl.evas", "EventCoordPoint", sizeof(struct __pyx_obj_3efl_4evas_EventCoordPoint), 1); if (unlikely(!__pyx_ptype_3efl_4evas_EventCoordPoint)) {__pyx_filename = __pyx_f[5]; __pyx_lineno = 1231; __pyx_clineno = __LINE__; goto __pyx_L1_error;}
  __pyx_vtabptr_3efl_4evas_EventCoordPoint = (struct __pyx_vtabstruct_3efl_4evas_EventCoordPoint*)__Pyx_GetVtable(__pyx_ptype_3efl_4evas_EventCoordPoint->tp_dict); if (unlikely(!__pyx_vtabptr_3efl_4evas_EventCoordPoint)) {__pyx_filename = __pyx_f[5]; __pyx_lineno = 1231; __pyx_clineno = __LINE__; goto __pyx_L1_error;}
  __pyx_ptype_3efl_4evas_EventPrecisionPoint = __Pyx_ImportType("efl.evas", "EventPrecisionPoint", sizeof(struct __pyx_obj_3efl_4evas_EventPrecisionPoint), 1); if (unlikely(!__pyx_ptype_3efl_4evas_EventPrecisionPoint)) {__pyx_filename = __pyx_f[5]; __pyx_lineno = 1239; __pyx_clineno = __LINE__; goto __pyx_L1_error;}
  __pyx_vtabptr_3efl_4evas_EventPrecisionPoint = (struct __pyx_vtabstruct_3efl_4evas_EventPrecisionPoint*)__Pyx_GetVtable(__pyx_ptype_3efl_4evas_EventPrecisionPoint->tp_dict); if (unlikely(!__pyx_vtabptr_3efl_4evas_EventPrecisionPoint)) {__pyx_filename = __pyx_f[5]; __pyx_lineno = 1239; __pyx_clineno = __LINE__; goto __pyx_L1_error;}
  __pyx_ptype_3efl_4evas_EventPosition = __Pyx_ImportType("efl.evas", "EventPosition", sizeof(struct __pyx_obj_3efl_4evas_EventPosition), 1); if (unlikely(!__pyx_ptype_3efl_4evas_EventPosition)) {__pyx_filename = __pyx_f[5]; __pyx_lineno = 1247; __pyx_clineno = __LINE__; goto __pyx_L1_error;}
  __pyx_vtabptr_3efl_4evas_EventPosition = (struct __pyx_vtabstruct_3efl_4evas_EventPosition*)__Pyx_GetVtable(__pyx_ptype_3efl_4evas_EventPosition->tp_dict); if (unlikely(!__pyx_vtabptr_3efl_4evas_EventPosition)) {__pyx_filename = __pyx_f[5]; __pyx_lineno = 1247; __pyx_clineno = __LINE__; goto __pyx_L1_error;}
  __pyx_ptype_3efl_4evas_EventPrecisionPosition = __Pyx_ImportType("efl.evas", "EventPrecisionPosition", sizeof(struct __pyx_obj_3efl_4evas_EventPrecisionPosition), 1); if (unlikely(!__pyx_ptype_3efl_4evas_EventPrecisionPosition)) {__pyx_filename = __pyx_f[5]; __pyx_lineno = 1255; __pyx_clineno = __LINE__; goto __pyx_L1_error;}
  __pyx_vtabptr_3efl_4evas_EventPrecisionPosition = (struct __pyx_vtabstruct_3efl_4evas_EventPrecisionPosition*)__Pyx_GetVtable(__pyx_ptype_3efl_4evas_EventPrecisionPosition->tp_dict); if (unlikely(!__pyx_vtabptr_3efl_4evas_EventPrecisionPosition)) {__pyx_filename = __pyx_f[5]; __pyx_lineno = 1255; __pyx_clineno = __LINE__; goto __pyx_L1_error;}
  __pyx_ptype_3efl_4evas_EventMouseIn = __Pyx_ImportType("efl.evas", "EventMouseIn", sizeof(struct __pyx_obj_3efl_4evas_EventMouseIn), 1); if (unlikely(!__pyx_ptype_3efl_4evas_EventMouseIn)) {__pyx_filename = __pyx_f[5]; __pyx_lineno = 1263; __pyx_clineno = __LINE__; goto __pyx_L1_error;}
  __pyx_vtabptr_3efl_4evas_EventMouseIn = (struct __pyx_vtabstruct_3efl_4evas_EventMouseIn*)__Pyx_GetVtable(__pyx_ptype_3efl_4evas_EventMouseIn->tp_dict); if (unlikely(!__pyx_vtabptr_3efl_4evas_EventMouseIn)) {__pyx_filename = __pyx_f[5]; __pyx_lineno = 1263; __pyx_clineno = __LINE__; goto __pyx_L1_error;}
  __pyx_ptype_3efl_4evas_EventMouseOut = __Pyx_ImportType("efl.evas", "EventMouseOut", sizeof(struct __pyx_obj_3efl_4evas_EventMouseOut), 1); if (unlikely(!__pyx_ptype_3efl_4evas_EventMouseOut)) {__pyx_filename = __pyx_f[5]; __pyx_lineno = 1272; __pyx_clineno = __LINE__; goto __pyx_L1_error;}
  __pyx_vtabptr_3efl_4evas_EventMouseOut = (struct __pyx_vtabstruct_3efl_4evas_EventMouseOut*)__Pyx_GetVtable(__pyx_ptype_3efl_4evas_EventMouseOut->tp_dict); if (unlikely(!__pyx_vtabptr_3efl_4evas_EventMouseOut)) {__pyx_filename = __pyx_f[5]; __pyx_lineno = 1272; __pyx_clineno = __LINE__; goto __pyx_L1_error;}
  __pyx_ptype_3efl_4evas_EventMouseDown = __Pyx_ImportType("efl.evas", "EventMouseDown", sizeof(struct __pyx_obj_3efl_4evas_EventMouseDown), 1); if (unlikely(!__pyx_ptype_3efl_4evas_EventMouseDown)) {__pyx_filename = __pyx_f[5]; __pyx_lineno = 1281; __pyx_clineno = __LINE__; goto __pyx_L1_error;}
  __pyx_vtabptr_3efl_4evas_EventMouseDown = (struct __pyx_vtabstruct_3efl_4evas_EventMouseDown*)__Pyx_GetVtable(__pyx_ptype_3efl_4evas_EventMouseDown->tp_dict); if (unlikely(!__pyx_vtabptr_3efl_4evas_EventMouseDown)) {__pyx_filename = __pyx_f[5]; __pyx_lineno = 1281; __pyx_clineno = __LINE__; goto __pyx_L1_error;}
  __pyx_ptype_3efl_4evas_EventMouseUp = __Pyx_ImportType("efl.evas", "EventMouseUp", sizeof(struct __pyx_obj_3efl_4evas_EventMouseUp), 1); if (unlikely(!__pyx_ptype_3efl_4evas_EventMouseUp)) {__pyx_filename = __pyx_f[5]; __pyx_lineno = 1290; __pyx_clineno = __LINE__; goto __pyx_L1_error;}
  __pyx_vtabptr_3efl_4evas_EventMouseUp = (struct __pyx_vtabstruct_3efl_4evas_EventMouseUp*)__Pyx_GetVtable(__pyx_ptype_3efl_4evas_EventMouseUp->tp_dict); if (unlikely(!__pyx_vtabptr_3efl_4evas_EventMouseUp)) {__pyx_filename = __pyx_f[5]; __pyx_lineno = 1290; __pyx_clineno = __LINE__; goto __pyx_L1_error;}
  __pyx_ptype_3efl_4evas_EventMouseMove = __Pyx_ImportType("efl.evas", "EventMouseMove", sizeof(struct __pyx_obj_3efl_4evas_EventMouseMove), 1); if (unlikely(!__pyx_ptype_3efl_4evas_EventMouseMove)) {__pyx_filename = __pyx_f[5]; __pyx_lineno = 1299; __pyx_clineno = __LINE__; goto __pyx_L1_error;}
  __pyx_vtabptr_3efl_4evas_EventMouseMove = (struct __pyx_vtabstruct_3efl_4evas_EventMouseMove*)__Pyx_GetVtable(__pyx_ptype_3efl_4evas_EventMouseMove->tp_dict); if (unlikely(!__pyx_vtabptr_3efl_4evas_EventMouseMove)) {__pyx_filename = __pyx_f[5]; __pyx_lineno = 1299; __pyx_clineno = __LINE__; goto __pyx_L1_error;}
  __pyx_ptype_3efl_4evas_EventMultiDown = __Pyx_ImportType("efl.evas", "EventMultiDown", sizeof(struct __pyx_obj_3efl_4evas_EventMultiDown), 1); if (unlikely(!__pyx_ptype_3efl_4evas_EventMultiDown)) {__pyx_filename = __pyx_f[5]; __pyx_lineno = 1309; __pyx_clineno = __LINE__; goto __pyx_L1_error;}
  __pyx_vtabptr_3efl_4evas_EventMultiDown = (struct __pyx_vtabstruct_3efl_4evas_EventMultiDown*)__Pyx_GetVtable(__pyx_ptype_3efl_4evas_EventMultiDown->tp_dict); if (unlikely(!__pyx_vtabptr_3efl_4evas_EventMultiDown)) {__pyx_filename = __pyx_f[5]; __pyx_lineno = 1309; __pyx_clineno = __LINE__; goto __pyx_L1_error;}
  __pyx_ptype_3efl_4evas_EventMultiUp = __Pyx_ImportType("efl.evas", "EventMultiUp", sizeof(struct __pyx_obj_3efl_4evas_EventMultiUp), 1); if (unlikely(!__pyx_ptype_3efl_4evas_EventMultiUp)) {__pyx_filename = __pyx_f[5]; __pyx_lineno = 1318; __pyx_clineno = __LINE__; goto __pyx_L1_error;}
  __pyx_vtabptr_3efl_4evas_EventMultiUp = (struct __pyx_vtabstruct_3efl_4evas_EventMultiUp*)__Pyx_GetVtable(__pyx_ptype_3efl_4evas_EventMultiUp->tp_dict); if (unlikely(!__pyx_vtabptr_3efl_4evas_EventMultiUp)) {__pyx_filename = __pyx_f[5]; __pyx_lineno = 1318; __pyx_clineno = __LINE__; goto __pyx_L1_error;}
  __pyx_ptype_3efl_4evas_EventMultiMove = __Pyx_ImportType("efl.evas", "EventMultiMove", sizeof(struct __pyx_obj_3efl_4evas_EventMultiMove), 1); if (unlikely(!__pyx_ptype_3efl_4evas_EventMultiMove)) {__pyx_filename = __pyx_f[5]; __pyx_lineno = 1327; __pyx_clineno = __LINE__; goto __pyx_L1_error;}
  __pyx_vtabptr_3efl_4evas_EventMultiMove = (struct __pyx_vtabstruct_3efl_4evas_EventMultiMove*)__Pyx_GetVtable(__pyx_ptype_3efl_4evas_EventMultiMove->tp_dict); if (unlikely(!__pyx_vtabptr_3efl_4evas_EventMultiMove)) {__pyx_filename = __pyx_f[5]; __pyx_lineno = 1327; __pyx_clineno = __LINE__; goto __pyx_L1_error;}
  __pyx_ptype_3efl_4evas_EventMouseWheel = __Pyx_ImportType("efl.evas", "EventMouseWheel", sizeof(struct __pyx_obj_3efl_4evas_EventMouseWheel), 1); if (unlikely(!__pyx_ptype_3efl_4evas_EventMouseWheel)) {__pyx_filename = __pyx_f[5]; __pyx_lineno = 1336; __pyx_clineno = __LINE__; goto __pyx_L1_error;}
  __pyx_vtabptr_3efl_4evas_EventMouseWheel = (struct __pyx_vtabstruct_3efl_4evas_EventMouseWheel*)__Pyx_GetVtable(__pyx_ptype_3efl_4evas_EventMouseWheel->tp_dict); if (unlikely(!__pyx_vtabptr_3efl_4evas_EventMouseWheel)) {__pyx_filename = __pyx_f[5]; __pyx_lineno = 1336; __pyx_clineno = __LINE__; goto __pyx_L1_error;}
  __pyx_ptype_3efl_4evas_EventKeyDown = __Pyx_ImportType("efl.evas", "EventKeyDown", sizeof(struct __pyx_obj_3efl_4evas_EventKeyDown), 1); if (unlikely(!__pyx_ptype_3efl_4evas_EventKeyDown)) {__pyx_filename = __pyx_f[5]; __pyx_lineno = 1345; __pyx_clineno = __LINE__; goto __pyx_L1_error;}
  __pyx_vtabptr_3efl_4evas_EventKeyDown = (struct __pyx_vtabstruct_3efl_4evas_EventKeyDown*)__Pyx_GetVtable(__pyx_ptype_3efl_4evas_EventKeyDown->tp_dict); if (unlikely(!__pyx_vtabptr_3efl_4evas_EventKeyDown)) {__pyx_filename = __pyx_f[5]; __pyx_lineno = 1345; __pyx_clineno = __LINE__; goto __pyx_L1_error;}
  __pyx_ptype_3efl_4evas_EventKeyUp = __Pyx_ImportType("efl.evas", "EventKeyUp", sizeof(struct __pyx_obj_3efl_4evas_EventKeyUp), 1); if (unlikely(!__pyx_ptype_3efl_4evas_EventKeyUp)) {__pyx_filename = __pyx_f[5]; __pyx_lineno = 1353; __pyx_clineno = __LINE__; goto __pyx_L1_error;}
  __pyx_vtabptr_3efl_4evas_EventKeyUp = (struct __pyx_vtabstruct_3efl_4evas_EventKeyUp*)__Pyx_GetVtable(__pyx_ptype_3efl_4evas_EventKeyUp->tp_dict); if (unlikely(!__pyx_vtabptr_3efl_4evas_EventKeyUp)) {__pyx_filename = __pyx_f[5]; __pyx_lineno = 1353; __pyx_clineno = __LINE__; goto __pyx_L1_error;}
  __pyx_ptype_3efl_4evas_EventHold = __Pyx_ImportType("efl.evas", "EventHold", sizeof(struct __pyx_obj_3efl_4evas_EventHold), 1); if (unlikely(!__pyx_ptype_3efl_4evas_EventHold)) {__pyx_filename = __pyx_f[5]; __pyx_lineno = 1361; __pyx_clineno = __LINE__; goto __pyx_L1_error;}
  __pyx_vtabptr_3efl_4evas_EventHold = (struct __pyx_vtabstruct_3efl_4evas_EventHold*)__Pyx_GetVtable(__pyx_ptype_3efl_4evas_EventHold->tp_dict); if (unlikely(!__pyx_vtabptr_3efl_4evas_EventHold)) {__pyx_filename = __pyx_f[5]; __pyx_lineno = 1361; __pyx_clineno = __LINE__; goto __pyx_L1_error;}
  __pyx_ptype_3efl_10elementary_6object_Canvas = __Pyx_ImportType("efl.elementary.object", "Canvas", sizeof(struct __pyx_obj_3efl_10elementary_6object_Canvas), 1); if (unlikely(!__pyx_ptype_3efl_10elementary_6object_Canvas)) {__pyx_filename = __pyx_f[6]; __pyx_lineno = 224; __pyx_clineno = __LINE__; goto __pyx_L1_error;}
  __pyx_vtabptr_3efl_10elementary_6object_Canvas = (struct __pyx_vtabstruct_3efl_10elementary_6object_Canvas*)__Pyx_GetVtable(__pyx_ptype_3efl_10elementary_6object_Canvas->tp_dict); if (unlikely(!__pyx_vtabptr_3efl_10elementary_6object_Canvas)) {__pyx_filename = __pyx_f[6]; __pyx_lineno = 224; __pyx_clineno = __LINE__; goto __pyx_L1_error;}
  __pyx_ptype_3efl_10elementary_6object_Object = __Pyx_ImportType("efl.elementary.object", "Object", sizeof(struct __pyx_obj_3efl_10elementary_6object_Object), 1); if (unlikely(!__pyx_ptype_3efl_10elementary_6object_Object)) {__pyx_filename = __pyx_f[6]; __pyx_lineno = 227; __pyx_clineno = __LINE__; goto __pyx_L1_error;}
  __pyx_vtabptr_3efl_10elementary_6object_Object = (struct __pyx_vtabstruct_3efl_10elementary_6object_Object*)__Pyx_GetVtable(__pyx_ptype_3efl_10elementary_6object_Object->tp_dict); if (unlikely(!__pyx_vtabptr_3efl_10elementary_6object_Object)) {__pyx_filename = __pyx_f[6]; __pyx_lineno = 227; __pyx_clineno = __LINE__; goto __pyx_L1_error;}
  /*--- Variable import code ---*/
  /*--- Function import code ---*/
  __pyx_t_1 = __Pyx_ImportModule("efl.eo"); if (!__pyx_t_1) {__pyx_filename = __pyx_f[0]; __pyx_lineno = 1; __pyx_clineno = __LINE__; goto __pyx_L1_error;}
  if (__Pyx_ImportFunction(__pyx_t_1, "_object_mapping_register", (void (**)(void))&__pyx_f_3efl_2eo__object_mapping_register, "void (char *, PyObject *)") < 0) {__pyx_filename = __pyx_f[0]; __pyx_lineno = 1; __pyx_clineno = __LINE__; goto __pyx_L1_error;}
  Py_DECREF(__pyx_t_1); __pyx_t_1 = 0;
  /*--- Execution code ---*/

  /* "efl/elementary/bubble.pyx":182
 *         self._callback_del("unfocused", func)
 * 
 * _object_mapping_register("Elm_Bubble", Bubble)             # <<<<<<<<<<<<<<
 */
  __pyx_f_3efl_2eo__object_mapping_register(__pyx_k_Elm_Bubble, ((PyObject *)((PyObject*)__pyx_ptype_3efl_10elementary_6bubble_Bubble))); if (unlikely(PyErr_Occurred())) {__pyx_filename = __pyx_f[0]; __pyx_lineno = 182; __pyx_clineno = __LINE__; goto __pyx_L1_error;}

  /* "efl/elementary/bubble.pyx":1
 * # Copyright (C) 2007-2015 various contributors (see AUTHORS)             # <<<<<<<<<<<<<<
 * #
 * # This file is part of Python-EFL.
 */
  __pyx_t_2 = PyDict_New(); if (unlikely(!__pyx_t_2)) {__pyx_filename = __pyx_f[0]; __pyx_lineno = 1; __pyx_clineno = __LINE__; goto __pyx_L1_error;}
  __Pyx_GOTREF(__pyx_t_2);
  if (PyDict_SetItem(__pyx_d, __pyx_n_s_test, __pyx_t_2) < 0) {__pyx_filename = __pyx_f[0]; __pyx_lineno = 1; __pyx_clineno = __LINE__; goto __pyx_L1_error;}
  __Pyx_DECREF(__pyx_t_2); __pyx_t_2 = 0;

  /*--- Wrapped vars code ---*/
  {
    PyObject* wrapped = PyInt_FromLong(ELM_BUBBLE_POS_TOP_RIGHT);
    if (unlikely(!wrapped)) {__pyx_filename = __pyx_f[7]; __pyx_lineno = 8; __pyx_clineno = __LINE__; goto __pyx_L1_error;}
    if (PyObject_SetAttrString(__pyx_m, "ELM_BUBBLE_POS_TOP_RIGHT", wrapped) < 0) {__pyx_filename = __pyx_f[7]; __pyx_lineno = 8; __pyx_clineno = __LINE__; goto __pyx_L1_error;};
  }
  {
    PyObject* wrapped = PyInt_FromLong(ELM_BUBBLE_POS_TOP_LEFT);
    if (unlikely(!wrapped)) {__pyx_filename = __pyx_f[7]; __pyx_lineno = 7; __pyx_clineno = __LINE__; goto __pyx_L1_error;}
    if (PyObject_SetAttrString(__pyx_m, "ELM_BUBBLE_POS_TOP_LEFT", wrapped) < 0) {__pyx_filename = __pyx_f[7]; __pyx_lineno = 7; __pyx_clineno = __LINE__; goto __pyx_L1_error;};
  }
  {
    PyObject* wrapped = PyInt_FromLong(ELM_BUBBLE_POS_BOTTOM_LEFT);
    if (unlikely(!wrapped)) {__pyx_filename = __pyx_f[7]; __pyx_lineno = 9; __pyx_clineno = __LINE__; goto __pyx_L1_error;}
    if (PyObject_SetAttrString(__pyx_m, "ELM_BUBBLE_POS_BOTTOM_LEFT", wrapped) < 0) {__pyx_filename = __pyx_f[7]; __pyx_lineno = 9; __pyx_clineno = __LINE__; goto __pyx_L1_error;};
  }
  {
    PyObject* wrapped = PyInt_FromLong(ELM_BUBBLE_POS_BOTTOM_RIGHT);
    if (unlikely(!wrapped)) {__pyx_filename = __pyx_f[7]; __pyx_lineno = 10; __pyx_clineno = __LINE__; goto __pyx_L1_error;}
    if (PyObject_SetAttrString(__pyx_m, "ELM_BUBBLE_POS_BOTTOM_RIGHT", wrapped) < 0) {__pyx_filename = __pyx_f[7]; __pyx_lineno = 10; __pyx_clineno = __LINE__; goto __pyx_L1_error;};
  }

  goto __pyx_L0;
  __pyx_L1_error:;
  __Pyx_XDECREF(__pyx_t_1);
  __Pyx_XDECREF(__pyx_t_2);
  if (__pyx_m) {
    if (__pyx_d) {
      __Pyx_AddTraceback("init efl.elementary.bubble", __pyx_clineno, __pyx_lineno, __pyx_filename);
      Py_DECREF(__pyx_d); __pyx_d = 0;
    }
    Py_DECREF(__pyx_m); __pyx_m = 0;
  } else if (!PyErr_Occurred()) {
    PyErr_SetString(PyExc_ImportError, "init efl.elementary.bubble");
  }
  __pyx_L0:;
  __Pyx_RefNannyFinishContext();
  #if PY_MAJOR_VERSION < 3
  return;
  #else
  return __pyx_m;
  #endif
}

/* Runtime support code */
#if CYTHON_REFNANNY
static __Pyx_RefNannyAPIStruct *__Pyx_RefNannyImportAPI(const char *modname) {
    PyObject *m = NULL, *p = NULL;
    void *r = NULL;
    m = PyImport_ImportModule((char *)modname);
    if (!m) goto end;
    p = PyObject_GetAttrString(m, (char *)"RefNannyAPI");
    if (!p) goto end;
    r = PyLong_AsVoidPtr(p);
end:
    Py_XDECREF(p);
    Py_XDECREF(m);
    return (__Pyx_RefNannyAPIStruct *)r;
}
#endif

static void __Pyx_RaiseDoubleKeywordsError(
    const char* func_name,
    PyObject* kw_name)
{
    PyErr_Format(PyExc_TypeError,
        #if PY_MAJOR_VERSION >= 3
        "%s() got multiple values for keyword argument '%U'", func_name, kw_name);
        #else
        "%s() got multiple values for keyword argument '%s'", func_name,
        PyString_AsString(kw_name));
        #endif
}

static int __Pyx_ParseOptionalKeywords(
    PyObject *kwds,
    PyObject **argnames[],
    PyObject *kwds2,
    PyObject *values[],
    Py_ssize_t num_pos_args,
    const char* function_name)
{
    PyObject *key = 0, *value = 0;
    Py_ssize_t pos = 0;
    PyObject*** name;
    PyObject*** first_kw_arg = argnames + num_pos_args;
    while (PyDict_Next(kwds, &pos, &key, &value)) {
        name = first_kw_arg;
        while (*name && (**name != key)) name++;
        if (*name) {
            values[name-argnames] = value;
            continue;
        }
        name = first_kw_arg;
        #if PY_MAJOR_VERSION < 3
        if (likely(PyString_CheckExact(key)) || likely(PyString_Check(key))) {
            while (*name) {
                if ((CYTHON_COMPILING_IN_PYPY || PyString_GET_SIZE(**name) == PyString_GET_SIZE(key))
                        && _PyString_Eq(**name, key)) {
                    values[name-argnames] = value;
                    break;
                }
                name++;
            }
            if (*name) continue;
            else {
                PyObject*** argname = argnames;
                while (argname != first_kw_arg) {
                    if ((**argname == key) || (
                            (CYTHON_COMPILING_IN_PYPY || PyString_GET_SIZE(**argname) == PyString_GET_SIZE(key))
                             && _PyString_Eq(**argname, key))) {
                        goto arg_passed_twice;
                    }
                    argname++;
                }
            }
        } else
        #endif
        if (likely(PyUnicode_Check(key))) {
            while (*name) {
                int cmp = (**name == key) ? 0 :
                #if !CYTHON_COMPILING_IN_PYPY && PY_MAJOR_VERSION >= 3
                    (PyUnicode_GET_SIZE(**name) != PyUnicode_GET_SIZE(key)) ? 1 :
                #endif
                    PyUnicode_Compare(**name, key);
                if (cmp < 0 && unlikely(PyErr_Occurred())) goto bad;
                if (cmp == 0) {
                    values[name-argnames] = value;
                    break;
                }
                name++;
            }
            if (*name) continue;
            else {
                PyObject*** argname = argnames;
                while (argname != first_kw_arg) {
                    int cmp = (**argname == key) ? 0 :
                    #if !CYTHON_COMPILING_IN_PYPY && PY_MAJOR_VERSION >= 3
                        (PyUnicode_GET_SIZE(**argname) != PyUnicode_GET_SIZE(key)) ? 1 :
                    #endif
                        PyUnicode_Compare(**argname, key);
                    if (cmp < 0 && unlikely(PyErr_Occurred())) goto bad;
                    if (cmp == 0) goto arg_passed_twice;
                    argname++;
                }
            }
        } else
            goto invalid_keyword_type;
        if (kwds2) {
            if (unlikely(PyDict_SetItem(kwds2, key, value))) goto bad;
        } else {
            goto invalid_keyword;
        }
    }
    return 0;
arg_passed_twice:
    __Pyx_RaiseDoubleKeywordsError(function_name, key);
    goto bad;
invalid_keyword_type:
    PyErr_Format(PyExc_TypeError,
        "%.200s() keywords must be strings", function_name);
    goto bad;
invalid_keyword:
    PyErr_Format(PyExc_TypeError,
    #if PY_MAJOR_VERSION < 3
        "%.200s() got an unexpected keyword argument '%.200s'",
        function_name, PyString_AsString(key));
    #else
        "%s() got an unexpected keyword argument '%U'",
        function_name, key);
    #endif
bad:
    return -1;
}

static void __Pyx_RaiseArgtupleInvalid(
    const char* func_name,
    int exact,
    Py_ssize_t num_min,
    Py_ssize_t num_max,
    Py_ssize_t num_found)
{
    Py_ssize_t num_expected;
    const char *more_or_less;
    if (num_found < num_min) {
        num_expected = num_min;
        more_or_less = "at least";
    } else {
        num_expected = num_max;
        more_or_less = "at most";
    }
    if (exact) {
        more_or_less = "exactly";
    }
    PyErr_Format(PyExc_TypeError,
                 "%.200s() takes %.8s %" CYTHON_FORMAT_SSIZE_T "d positional argument%.1s (%" CYTHON_FORMAT_SSIZE_T "d given)",
                 func_name, more_or_less, num_expected,
                 (num_expected == 1) ? "" : "s", num_found);
}

static void __Pyx_RaiseArgumentTypeInvalid(const char* name, PyObject *obj, PyTypeObject *type) {
    PyErr_Format(PyExc_TypeError,
        "Argument '%.200s' has incorrect type (expected %.200s, got %.200s)",
        name, type->tp_name, Py_TYPE(obj)->tp_name);
}
static CYTHON_INLINE int __Pyx_ArgTypeTest(PyObject *obj, PyTypeObject *type, int none_allowed,
    const char *name, int exact)
{
    if (unlikely(!type)) {
        PyErr_SetString(PyExc_SystemError, "Missing type object");
        return 0;
    }
    if (none_allowed && obj == Py_None) return 1;
    else if (exact) {
        if (likely(Py_TYPE(obj) == type)) return 1;
        #if PY_MAJOR_VERSION == 2
        else if ((type == &PyBaseString_Type) && likely(__Pyx_PyBaseString_CheckExact(obj))) return 1;
        #endif
    }
    else {
        if (likely(PyObject_TypeCheck(obj, type))) return 1;
    }
    __Pyx_RaiseArgumentTypeInvalid(name, obj, type);
    return 0;
}

#if CYTHON_COMPILING_IN_CPYTHON
static CYTHON_INLINE PyObject* __Pyx_PyObject_Call(PyObject *func, PyObject *arg, PyObject *kw) {
    PyObject *result;
    ternaryfunc call = func->ob_type->tp_call;
    if (unlikely(!call))
        return PyObject_Call(func, arg, kw);
    if (unlikely(Py_EnterRecursiveCall((char*)" while calling a Python object")))
        return NULL;
    result = (*call)(func, arg, kw);
    Py_LeaveRecursiveCall();
    if (unlikely(!result) && unlikely(!PyErr_Occurred())) {
        PyErr_SetString(
            PyExc_SystemError,
            "NULL result without error in PyObject_Call");
    }
    return result;
}
#endif

static void __Pyx_call_next_tp_dealloc(PyObject* obj, destructor current_tp_dealloc) {
    PyTypeObject* type = Py_TYPE(obj);
    while (type && type->tp_dealloc != current_tp_dealloc)
        type = type->tp_base;
    while (type && type->tp_dealloc == current_tp_dealloc)
        type = type->tp_base;
    if (type)
        type->tp_dealloc(obj);
}

static int __Pyx_call_next_tp_traverse(PyObject* obj, visitproc v, void *a, traverseproc current_tp_traverse) {
    PyTypeObject* type = Py_TYPE(obj);
    while (type && type->tp_traverse != current_tp_traverse)
        type = type->tp_base;
    while (type && type->tp_traverse == current_tp_traverse)
        type = type->tp_base;
    if (type && type->tp_traverse)
        return type->tp_traverse(obj, v, a);
    return 0;
}

static void __Pyx_call_next_tp_clear(PyObject* obj, inquiry current_tp_clear) {
    PyTypeObject* type = Py_TYPE(obj);
    while (type && type->tp_clear != current_tp_clear)
        type = type->tp_base;
    while (type && type->tp_clear == current_tp_clear)
        type = type->tp_base;
    if (type && type->tp_clear)
        type->tp_clear(obj);
}

static void* __Pyx_GetVtable(PyObject *dict) {
    void* ptr;
    PyObject *ob = PyObject_GetItem(dict, __pyx_n_s_pyx_vtable);
    if (!ob)
        goto bad;
#if PY_VERSION_HEX >= 0x02070000
    ptr = PyCapsule_GetPointer(ob, 0);
#else
    ptr = PyCObject_AsVoidPtr(ob);
#endif
    if (!ptr && !PyErr_Occurred())
        PyErr_SetString(PyExc_RuntimeError, "invalid vtable found for imported type");
    Py_DECREF(ob);
    return ptr;
bad:
    Py_XDECREF(ob);
    return NULL;
}

static int __Pyx_SetVtable(PyObject *dict, void *vtable) {
#if PY_VERSION_HEX >= 0x02070000
    PyObject *ob = PyCapsule_New(vtable, 0, 0);
#else
    PyObject *ob = PyCObject_FromVoidPtr(vtable, 0);
#endif
    if (!ob)
        goto bad;
    if (PyDict_SetItem(dict, __pyx_n_s_pyx_vtable, ob) < 0)
        goto bad;
    Py_DECREF(ob);
    return 0;
bad:
    Py_XDECREF(ob);
    return -1;
}

static int __pyx_bisect_code_objects(__Pyx_CodeObjectCacheEntry* entries, int count, int code_line) {
    int start = 0, mid = 0, end = count - 1;
    if (end >= 0 && code_line > entries[end].code_line) {
        return count;
    }
    while (start < end) {
        mid = (start + end) / 2;
        if (code_line < entries[mid].code_line) {
            end = mid;
        } else if (code_line > entries[mid].code_line) {
             start = mid + 1;
        } else {
            return mid;
        }
    }
    if (code_line <= entries[mid].code_line) {
        return mid;
    } else {
        return mid + 1;
    }
}
static PyCodeObject *__pyx_find_code_object(int code_line) {
    PyCodeObject* code_object;
    int pos;
    if (unlikely(!code_line) || unlikely(!__pyx_code_cache.entries)) {
        return NULL;
    }
    pos = __pyx_bisect_code_objects(__pyx_code_cache.entries, __pyx_code_cache.count, code_line);
    if (unlikely(pos >= __pyx_code_cache.count) || unlikely(__pyx_code_cache.entries[pos].code_line != code_line)) {
        return NULL;
    }
    code_object = __pyx_code_cache.entries[pos].code_object;
    Py_INCREF(code_object);
    return code_object;
}
static void __pyx_insert_code_object(int code_line, PyCodeObject* code_object) {
    int pos, i;
    __Pyx_CodeObjectCacheEntry* entries = __pyx_code_cache.entries;
    if (unlikely(!code_line)) {
        return;
    }
    if (unlikely(!entries)) {
        entries = (__Pyx_CodeObjectCacheEntry*)PyMem_Malloc(64*sizeof(__Pyx_CodeObjectCacheEntry));
        if (likely(entries)) {
            __pyx_code_cache.entries = entries;
            __pyx_code_cache.max_count = 64;
            __pyx_code_cache.count = 1;
            entries[0].code_line = code_line;
            entries[0].code_object = code_object;
            Py_INCREF(code_object);
        }
        return;
    }
    pos = __pyx_bisect_code_objects(__pyx_code_cache.entries, __pyx_code_cache.count, code_line);
    if ((pos < __pyx_code_cache.count) && unlikely(__pyx_code_cache.entries[pos].code_line == code_line)) {
        PyCodeObject* tmp = entries[pos].code_object;
        entries[pos].code_object = code_object;
        Py_DECREF(tmp);
        return;
    }
    if (__pyx_code_cache.count == __pyx_code_cache.max_count) {
        int new_max = __pyx_code_cache.max_count + 64;
        entries = (__Pyx_CodeObjectCacheEntry*)PyMem_Realloc(
            __pyx_code_cache.entries, (size_t)new_max*sizeof(__Pyx_CodeObjectCacheEntry));
        if (unlikely(!entries)) {
            return;
        }
        __pyx_code_cache.entries = entries;
        __pyx_code_cache.max_count = new_max;
    }
    for (i=__pyx_code_cache.count; i>pos; i--) {
        entries[i] = entries[i-1];
    }
    entries[pos].code_line = code_line;
    entries[pos].code_object = code_object;
    __pyx_code_cache.count++;
    Py_INCREF(code_object);
}

#include "compile.h"
#include "frameobject.h"
#include "traceback.h"
static PyCodeObject* __Pyx_CreateCodeObjectForTraceback(
            const char *funcname, int c_line,
            int py_line, const char *filename) {
    PyCodeObject *py_code = 0;
    PyObject *py_srcfile = 0;
    PyObject *py_funcname = 0;
    #if PY_MAJOR_VERSION < 3
    py_srcfile = PyString_FromString(filename);
    #else
    py_srcfile = PyUnicode_FromString(filename);
    #endif
    if (!py_srcfile) goto bad;
    if (c_line) {
        #if PY_MAJOR_VERSION < 3
        py_funcname = PyString_FromFormat( "%s (%s:%d)", funcname, __pyx_cfilenm, c_line);
        #else
        py_funcname = PyUnicode_FromFormat( "%s (%s:%d)", funcname, __pyx_cfilenm, c_line);
        #endif
    }
    else {
        #if PY_MAJOR_VERSION < 3
        py_funcname = PyString_FromString(funcname);
        #else
        py_funcname = PyUnicode_FromString(funcname);
        #endif
    }
    if (!py_funcname) goto bad;
    py_code = __Pyx_PyCode_New(
        0,
        0,
        0,
        0,
        0,
        __pyx_empty_bytes, /*PyObject *code,*/
        __pyx_empty_tuple, /*PyObject *consts,*/
        __pyx_empty_tuple, /*PyObject *names,*/
        __pyx_empty_tuple, /*PyObject *varnames,*/
        __pyx_empty_tuple, /*PyObject *freevars,*/
        __pyx_empty_tuple, /*PyObject *cellvars,*/
        py_srcfile,   /*PyObject *filename,*/
        py_funcname,  /*PyObject *name,*/
        py_line,
        __pyx_empty_bytes  /*PyObject *lnotab*/
    );
    Py_DECREF(py_srcfile);
    Py_DECREF(py_funcname);
    return py_code;
bad:
    Py_XDECREF(py_srcfile);
    Py_XDECREF(py_funcname);
    return NULL;
}
static void __Pyx_AddTraceback(const char *funcname, int c_line,
                               int py_line, const char *filename) {
    PyCodeObject *py_code = 0;
    PyFrameObject *py_frame = 0;
    py_code = __pyx_find_code_object(c_line ? c_line : py_line);
    if (!py_code) {
        py_code = __Pyx_CreateCodeObjectForTraceback(
            funcname, c_line, py_line, filename);
        if (!py_code) goto bad;
        __pyx_insert_code_object(c_line ? c_line : py_line, py_code);
    }
    py_frame = PyFrame_New(
        PyThreadState_GET(), /*PyThreadState *tstate,*/
        py_code,             /*PyCodeObject *code,*/
        __pyx_d,      /*PyObject *globals,*/
        0                    /*PyObject *locals*/
    );
    if (!py_frame) goto bad;
    py_frame->f_lineno = py_line;
    PyTraceBack_Here(py_frame);
bad:
    Py_XDECREF(py_code);
    Py_XDECREF(py_frame);
}

static CYTHON_INLINE PyObject* __Pyx_PyInt_From_long(long value) {
    const long neg_one = (long) -1, const_zero = 0;
    const int is_unsigned = neg_one > const_zero;
    if (is_unsigned) {
        if (sizeof(long) < sizeof(long)) {
            return PyInt_FromLong((long) value);
        } else if (sizeof(long) <= sizeof(unsigned long)) {
            return PyLong_FromUnsignedLong((unsigned long) value);
        } else if (sizeof(long) <= sizeof(unsigned long long)) {
            return PyLong_FromUnsignedLongLong((unsigned long long) value);
        }
    } else {
        if (sizeof(long) <= sizeof(long)) {
            return PyInt_FromLong((long) value);
        } else if (sizeof(long) <= sizeof(long long)) {
            return PyLong_FromLongLong((long long) value);
        }
    }
    {
        int one = 1; int little = (int)*(unsigned char *)&one;
        unsigned char *bytes = (unsigned char *)&value;
        return _PyLong_FromByteArray(bytes, sizeof(long),
                                     little, !is_unsigned);
    }
}

#define __PYX_VERIFY_RETURN_INT(target_type, func_type, func_value)       \
    {                                                                     \
        func_type value = func_value;                                     \
        if (sizeof(target_type) < sizeof(func_type)) {                    \
            if (unlikely(value != (func_type) (target_type) value)) {     \
                func_type zero = 0;                                       \
                if (is_unsigned && unlikely(value < zero))                \
                    goto raise_neg_overflow;                              \
                else                                                      \
                    goto raise_overflow;                                  \
            }                                                             \
        }                                                                 \
        return (target_type) value;                                       \
    }

#if CYTHON_COMPILING_IN_CPYTHON && PY_MAJOR_VERSION >= 3
 #if CYTHON_USE_PYLONG_INTERNALS
  #include "longintrepr.h"
 #endif
#endif

static CYTHON_INLINE long __Pyx_PyInt_As_long(PyObject *x) {
    const long neg_one = (long) -1, const_zero = 0;
    const int is_unsigned = neg_one > const_zero;
#if PY_MAJOR_VERSION < 3
    if (likely(PyInt_Check(x))) {
        if (sizeof(long) < sizeof(long)) {
            __PYX_VERIFY_RETURN_INT(long, long, PyInt_AS_LONG(x))
        } else {
            long val = PyInt_AS_LONG(x);
            if (is_unsigned && unlikely(val < 0)) {
                goto raise_neg_overflow;
            }
            return (long) val;
        }
    } else
#endif
    if (likely(PyLong_Check(x))) {
        if (is_unsigned) {
#if CYTHON_COMPILING_IN_CPYTHON && PY_MAJOR_VERSION >= 3
 #if CYTHON_USE_PYLONG_INTERNALS
            switch (Py_SIZE(x)) {
                case  0: return 0;
                case  1: __PYX_VERIFY_RETURN_INT(long, digit, ((PyLongObject*)x)->ob_digit[0]);
            }
 #endif
#endif
            if (unlikely(Py_SIZE(x) < 0)) {
                goto raise_neg_overflow;
            }
            if (sizeof(long) <= sizeof(unsigned long)) {
                __PYX_VERIFY_RETURN_INT(long, unsigned long, PyLong_AsUnsignedLong(x))
            } else if (sizeof(long) <= sizeof(unsigned long long)) {
                __PYX_VERIFY_RETURN_INT(long, unsigned long long, PyLong_AsUnsignedLongLong(x))
            }
        } else {
#if CYTHON_COMPILING_IN_CPYTHON && PY_MAJOR_VERSION >= 3
 #if CYTHON_USE_PYLONG_INTERNALS
            switch (Py_SIZE(x)) {
                case  0: return 0;
                case  1: __PYX_VERIFY_RETURN_INT(long,  digit, +(((PyLongObject*)x)->ob_digit[0]));
                case -1: __PYX_VERIFY_RETURN_INT(long, sdigit, -(sdigit) ((PyLongObject*)x)->ob_digit[0]);
            }
 #endif
#endif
            if (sizeof(long) <= sizeof(long)) {
                __PYX_VERIFY_RETURN_INT(long, long, PyLong_AsLong(x))
            } else if (sizeof(long) <= sizeof(long long)) {
                __PYX_VERIFY_RETURN_INT(long, long long, PyLong_AsLongLong(x))
            }
        }
        {
#if CYTHON_COMPILING_IN_PYPY && !defined(_PyLong_AsByteArray)
            PyErr_SetString(PyExc_RuntimeError,
                            "_PyLong_AsByteArray() not available in PyPy, cannot convert large numbers");
#else
            long val;
            PyObject *v = __Pyx_PyNumber_Int(x);
 #if PY_MAJOR_VERSION < 3
            if (likely(v) && !PyLong_Check(v)) {
                PyObject *tmp = v;
                v = PyNumber_Long(tmp);
                Py_DECREF(tmp);
            }
 #endif
            if (likely(v)) {
                int one = 1; int is_little = (int)*(unsigned char *)&one;
                unsigned char *bytes = (unsigned char *)&val;
                int ret = _PyLong_AsByteArray((PyLongObject *)v,
                                              bytes, sizeof(val),
                                              is_little, !is_unsigned);
                Py_DECREF(v);
                if (likely(!ret))
                    return val;
            }
#endif
            return (long) -1;
        }
    } else {
        long val;
        PyObject *tmp = __Pyx_PyNumber_Int(x);
        if (!tmp) return (long) -1;
        val = __Pyx_PyInt_As_long(tmp);
        Py_DECREF(tmp);
        return val;
    }
raise_overflow:
    PyErr_SetString(PyExc_OverflowError,
        "value too large to convert to long");
    return (long) -1;
raise_neg_overflow:
    PyErr_SetString(PyExc_OverflowError,
        "can't convert negative value to long");
    return (long) -1;
}

static CYTHON_INLINE int __Pyx_PyInt_As_int(PyObject *x) {
    const int neg_one = (int) -1, const_zero = 0;
    const int is_unsigned = neg_one > const_zero;
#if PY_MAJOR_VERSION < 3
    if (likely(PyInt_Check(x))) {
        if (sizeof(int) < sizeof(long)) {
            __PYX_VERIFY_RETURN_INT(int, long, PyInt_AS_LONG(x))
        } else {
            long val = PyInt_AS_LONG(x);
            if (is_unsigned && unlikely(val < 0)) {
                goto raise_neg_overflow;
            }
            return (int) val;
        }
    } else
#endif
    if (likely(PyLong_Check(x))) {
        if (is_unsigned) {
#if CYTHON_COMPILING_IN_CPYTHON && PY_MAJOR_VERSION >= 3
 #if CYTHON_USE_PYLONG_INTERNALS
            switch (Py_SIZE(x)) {
                case  0: return 0;
                case  1: __PYX_VERIFY_RETURN_INT(int, digit, ((PyLongObject*)x)->ob_digit[0]);
            }
 #endif
#endif
            if (unlikely(Py_SIZE(x) < 0)) {
                goto raise_neg_overflow;
            }
            if (sizeof(int) <= sizeof(unsigned long)) {
                __PYX_VERIFY_RETURN_INT(int, unsigned long, PyLong_AsUnsignedLong(x))
            } else if (sizeof(int) <= sizeof(unsigned long long)) {
                __PYX_VERIFY_RETURN_INT(int, unsigned long long, PyLong_AsUnsignedLongLong(x))
            }
        } else {
#if CYTHON_COMPILING_IN_CPYTHON && PY_MAJOR_VERSION >= 3
 #if CYTHON_USE_PYLONG_INTERNALS
            switch (Py_SIZE(x)) {
                case  0: return 0;
                case  1: __PYX_VERIFY_RETURN_INT(int,  digit, +(((PyLongObject*)x)->ob_digit[0]));
                case -1: __PYX_VERIFY_RETURN_INT(int, sdigit, -(sdigit) ((PyLongObject*)x)->ob_digit[0]);
            }
 #endif
#endif
            if (sizeof(int) <= sizeof(long)) {
                __PYX_VERIFY_RETURN_INT(int, long, PyLong_AsLong(x))
            } else if (sizeof(int) <= sizeof(long long)) {
                __PYX_VERIFY_RETURN_INT(int, long long, PyLong_AsLongLong(x))
            }
        }
        {
#if CYTHON_COMPILING_IN_PYPY && !defined(_PyLong_AsByteArray)
            PyErr_SetString(PyExc_RuntimeError,
                            "_PyLong_AsByteArray() not available in PyPy, cannot convert large numbers");
#else
            int val;
            PyObject *v = __Pyx_PyNumber_Int(x);
 #if PY_MAJOR_VERSION < 3
            if (likely(v) && !PyLong_Check(v)) {
                PyObject *tmp = v;
                v = PyNumber_Long(tmp);
                Py_DECREF(tmp);
            }
 #endif
            if (likely(v)) {
                int one = 1; int is_little = (int)*(unsigned char *)&one;
                unsigned char *bytes = (unsigned char *)&val;
                int ret = _PyLong_AsByteArray((PyLongObject *)v,
                                              bytes, sizeof(val),
                                              is_little, !is_unsigned);
                Py_DECREF(v);
                if (likely(!ret))
                    return val;
            }
#endif
            return (int) -1;
        }
    } else {
        int val;
        PyObject *tmp = __Pyx_PyNumber_Int(x);
        if (!tmp) return (int) -1;
        val = __Pyx_PyInt_As_int(tmp);
        Py_DECREF(tmp);
        return val;
    }
raise_overflow:
    PyErr_SetString(PyExc_OverflowError,
        "value too large to convert to int");
    return (int) -1;
raise_neg_overflow:
    PyErr_SetString(PyExc_OverflowError,
        "can't convert negative value to int");
    return (int) -1;
}

static int __Pyx_check_binary_version(void) {
    char ctversion[4], rtversion[4];
    PyOS_snprintf(ctversion, 4, "%d.%d", PY_MAJOR_VERSION, PY_MINOR_VERSION);
    PyOS_snprintf(rtversion, 4, "%s", Py_GetVersion());
    if (ctversion[0] != rtversion[0] || ctversion[2] != rtversion[2]) {
        char message[200];
        PyOS_snprintf(message, sizeof(message),
                      "compiletime version %s of module '%.100s' "
                      "does not match runtime version %s",
                      ctversion, __Pyx_MODULE_NAME, rtversion);
        return PyErr_WarnEx(NULL, message, 1);
    }
    return 0;
}

#ifndef __PYX_HAVE_RT_ImportModule
#define __PYX_HAVE_RT_ImportModule
static PyObject *__Pyx_ImportModule(const char *name) {
    PyObject *py_name = 0;
    PyObject *py_module = 0;
    py_name = __Pyx_PyIdentifier_FromString(name);
    if (!py_name)
        goto bad;
    py_module = PyImport_Import(py_name);
    Py_DECREF(py_name);
    return py_module;
bad:
    Py_XDECREF(py_name);
    return 0;
}
#endif

#ifndef __PYX_HAVE_RT_ImportType
#define __PYX_HAVE_RT_ImportType
static PyTypeObject *__Pyx_ImportType(const char *module_name, const char *class_name,
    size_t size, int strict)
{
    PyObject *py_module = 0;
    PyObject *result = 0;
    PyObject *py_name = 0;
    char warning[200];
    Py_ssize_t basicsize;
#ifdef Py_LIMITED_API
    PyObject *py_basicsize;
#endif
    py_module = __Pyx_ImportModule(module_name);
    if (!py_module)
        goto bad;
    py_name = __Pyx_PyIdentifier_FromString(class_name);
    if (!py_name)
        goto bad;
    result = PyObject_GetAttr(py_module, py_name);
    Py_DECREF(py_name);
    py_name = 0;
    Py_DECREF(py_module);
    py_module = 0;
    if (!result)
        goto bad;
    if (!PyType_Check(result)) {
        PyErr_Format(PyExc_TypeError,
            "%.200s.%.200s is not a type object",
            module_name, class_name);
        goto bad;
    }
#ifndef Py_LIMITED_API
    basicsize = ((PyTypeObject *)result)->tp_basicsize;
#else
    py_basicsize = PyObject_GetAttrString(result, "__basicsize__");
    if (!py_basicsize)
        goto bad;
    basicsize = PyLong_AsSsize_t(py_basicsize);
    Py_DECREF(py_basicsize);
    py_basicsize = 0;
    if (basicsize == (Py_ssize_t)-1 && PyErr_Occurred())
        goto bad;
#endif
    if (!strict && (size_t)basicsize > size) {
        PyOS_snprintf(warning, sizeof(warning),
            "%s.%s size changed, may indicate binary incompatibility",
            module_name, class_name);
        if (PyErr_WarnEx(NULL, warning, 0) < 0) goto bad;
    }
    else if ((size_t)basicsize != size) {
        PyErr_Format(PyExc_ValueError,
            "%.200s.%.200s has the wrong size, try recompiling",
            module_name, class_name);
        goto bad;
    }
    return (PyTypeObject *)result;
bad:
    Py_XDECREF(py_module);
    Py_XDECREF(result);
    return NULL;
}
#endif

#ifndef __PYX_HAVE_RT_ImportFunction
#define __PYX_HAVE_RT_ImportFunction
static int __Pyx_ImportFunction(PyObject *module, const char *funcname, void (**f)(void), const char *sig) {
    PyObject *d = 0;
    PyObject *cobj = 0;
    union {
        void (*fp)(void);
        void *p;
    } tmp;
    d = PyObject_GetAttrString(module, (char *)"__pyx_capi__");
    if (!d)
        goto bad;
    cobj = PyDict_GetItemString(d, funcname);
    if (!cobj) {
        PyErr_Format(PyExc_ImportError,
            "%.200s does not export expected C function %.200s",
                PyModule_GetName(module), funcname);
        goto bad;
    }
#if PY_VERSION_HEX >= 0x02070000
    if (!PyCapsule_IsValid(cobj, sig)) {
        PyErr_Format(PyExc_TypeError,
            "C function %.200s.%.200s has wrong signature (expected %.500s, got %.500s)",
             PyModule_GetName(module), funcname, sig, PyCapsule_GetName(cobj));
        goto bad;
    }
    tmp.p = PyCapsule_GetPointer(cobj, sig);
#else
    {const char *desc, *s1, *s2;
    desc = (const char *)PyCObject_GetDesc(cobj);
    if (!desc)
        goto bad;
    s1 = desc; s2 = sig;
    while (*s1 != '\0' && *s1 == *s2) { s1++; s2++; }
    if (*s1 != *s2) {
        PyErr_Format(PyExc_TypeError,
            "C function %.200s.%.200s has wrong signature (expected %.500s, got %.500s)",
             PyModule_GetName(module), funcname, sig, desc);
        goto bad;
    }
    tmp.p = PyCObject_AsVoidPtr(cobj);}
#endif
    *f = tmp.fp;
    if (!(*f))
        goto bad;
    Py_DECREF(d);
    return 0;
bad:
    Py_XDECREF(d);
    return -1;
}
#endif

static int __Pyx_InitStrings(__Pyx_StringTabEntry *t) {
    while (t->p) {
        #if PY_MAJOR_VERSION < 3
        if (t->is_unicode) {
            *t->p = PyUnicode_DecodeUTF8(t->s, t->n - 1, NULL);
        } else if (t->intern) {
            *t->p = PyString_InternFromString(t->s);
        } else {
            *t->p = PyString_FromStringAndSize(t->s, t->n - 1);
        }
        #else
        if (t->is_unicode | t->is_str) {
            if (t->intern) {
                *t->p = PyUnicode_InternFromString(t->s);
            } else if (t->encoding) {
                *t->p = PyUnicode_Decode(t->s, t->n - 1, t->encoding, NULL);
            } else {
                *t->p = PyUnicode_FromStringAndSize(t->s, t->n - 1);
            }
        } else {
            *t->p = PyBytes_FromStringAndSize(t->s, t->n - 1);
        }
        #endif
        if (!*t->p)
            return -1;
        ++t;
    }
    return 0;
}

static CYTHON_INLINE PyObject* __Pyx_PyUnicode_FromString(const char* c_str) {
    return __Pyx_PyUnicode_FromStringAndSize(c_str, (Py_ssize_t)strlen(c_str));
}
static CYTHON_INLINE char* __Pyx_PyObject_AsString(PyObject* o) {
    Py_ssize_t ignore;
    return __Pyx_PyObject_AsStringAndSize(o, &ignore);
}
static CYTHON_INLINE char* __Pyx_PyObject_AsStringAndSize(PyObject* o, Py_ssize_t *length) {
#if __PYX_DEFAULT_STRING_ENCODING_IS_ASCII || __PYX_DEFAULT_STRING_ENCODING_IS_DEFAULT
    if (
#if PY_MAJOR_VERSION < 3 && __PYX_DEFAULT_STRING_ENCODING_IS_ASCII
            __Pyx_sys_getdefaultencoding_not_ascii &&
#endif
            PyUnicode_Check(o)) {
#if PY_VERSION_HEX < 0x03030000
        char* defenc_c;
        PyObject* defenc = _PyUnicode_AsDefaultEncodedString(o, NULL);
        if (!defenc) return NULL;
        defenc_c = PyBytes_AS_STRING(defenc);
#if __PYX_DEFAULT_STRING_ENCODING_IS_ASCII
        {
            char* end = defenc_c + PyBytes_GET_SIZE(defenc);
            char* c;
            for (c = defenc_c; c < end; c++) {
                if ((unsigned char) (*c) >= 128) {
                    PyUnicode_AsASCIIString(o);
                    return NULL;
                }
            }
        }
#endif
        *length = PyBytes_GET_SIZE(defenc);
        return defenc_c;
#else
        if (__Pyx_PyUnicode_READY(o) == -1) return NULL;
#if __PYX_DEFAULT_STRING_ENCODING_IS_ASCII
        if (PyUnicode_IS_ASCII(o)) {
            *length = PyUnicode_GET_LENGTH(o);
            return PyUnicode_AsUTF8(o);
        } else {
            PyUnicode_AsASCIIString(o);
            return NULL;
        }
#else
        return PyUnicode_AsUTF8AndSize(o, length);
#endif
#endif
    } else
#endif
#if !CYTHON_COMPILING_IN_PYPY
    if (PyByteArray_Check(o)) {
        *length = PyByteArray_GET_SIZE(o);
        return PyByteArray_AS_STRING(o);
    } else
#endif
    {
        char* result;
        int r = PyBytes_AsStringAndSize(o, &result, length);
        if (unlikely(r < 0)) {
            return NULL;
        } else {
            return result;
        }
    }
}
static CYTHON_INLINE int __Pyx_PyObject_IsTrue(PyObject* x) {
   int is_true = x == Py_True;
   if (is_true | (x == Py_False) | (x == Py_None)) return is_true;
   else return PyObject_IsTrue(x);
}
static CYTHON_INLINE PyObject* __Pyx_PyNumber_Int(PyObject* x) {
  PyNumberMethods *m;
  const char *name = NULL;
  PyObject *res = NULL;
#if PY_MAJOR_VERSION < 3
  if (PyInt_Check(x) || PyLong_Check(x))
#else
  if (PyLong_Check(x))
#endif
    return Py_INCREF(x), x;
  m = Py_TYPE(x)->tp_as_number;
#if PY_MAJOR_VERSION < 3
  if (m && m->nb_int) {
    name = "int";
    res = PyNumber_Int(x);
  }
  else if (m && m->nb_long) {
    name = "long";
    res = PyNumber_Long(x);
  }
#else
  if (m && m->nb_int) {
    name = "int";
    res = PyNumber_Long(x);
  }
#endif
  if (res) {
#if PY_MAJOR_VERSION < 3
    if (!PyInt_Check(res) && !PyLong_Check(res)) {
#else
    if (!PyLong_Check(res)) {
#endif
      PyErr_Format(PyExc_TypeError,
                   "__%.4s__ returned non-%.4s (type %.200s)",
                   name, name, Py_TYPE(res)->tp_name);
      Py_DECREF(res);
      return NULL;
    }
  }
  else if (!PyErr_Occurred()) {
    PyErr_SetString(PyExc_TypeError,
                    "an integer is required");
  }
  return res;
}
static CYTHON_INLINE Py_ssize_t __Pyx_PyIndex_AsSsize_t(PyObject* b) {
  Py_ssize_t ival;
  PyObject *x;
#if PY_MAJOR_VERSION < 3
  if (likely(PyInt_CheckExact(b)))
      return PyInt_AS_LONG(b);
#endif
  if (likely(PyLong_CheckExact(b))) {
    #if CYTHON_COMPILING_IN_CPYTHON && PY_MAJOR_VERSION >= 3
     #if CYTHON_USE_PYLONG_INTERNALS
       switch (Py_SIZE(b)) {
       case -1: return -(sdigit)((PyLongObject*)b)->ob_digit[0];
       case  0: return 0;
       case  1: return ((PyLongObject*)b)->ob_digit[0];
       }
     #endif
    #endif
    return PyLong_AsSsize_t(b);
  }
  x = PyNumber_Index(b);
  if (!x) return -1;
  ival = PyInt_AsSsize_t(x);
  Py_DECREF(x);
  return ival;
}
static CYTHON_INLINE PyObject * __Pyx_PyInt_FromSize_t(size_t ival) {
    return PyInt_FromSize_t(ival);
}


#endif /* Py_PYTHON_H */
