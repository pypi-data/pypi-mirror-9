/* Generated by Cython 0.21 */

#define PY_SSIZE_T_CLEAN
#ifndef CYTHON_USE_PYLONG_INTERNALS
#ifdef PYLONG_BITS_IN_DIGIT
#define CYTHON_USE_PYLONG_INTERNALS 0
#else
#include "pyconfig.h"
#ifdef PYLONG_BITS_IN_DIGIT
#define CYTHON_USE_PYLONG_INTERNALS 1
#else
#define CYTHON_USE_PYLONG_INTERNALS 0
#endif
#endif
#endif
#include "Python.h"
#ifndef Py_PYTHON_H
    #error Python headers needed to compile C extensions, please install development version of Python.
#elif PY_VERSION_HEX < 0x02060000 || (0x03000000 <= PY_VERSION_HEX && PY_VERSION_HEX < 0x03020000)
    #error Cython requires Python 2.6+ or Python 3.2+.
#else
#define CYTHON_ABI "0_21"
#include <stddef.h>
#ifndef offsetof
#define offsetof(type, member) ( (size_t) & ((type*)0) -> member )
#endif
#if !defined(WIN32) && !defined(MS_WINDOWS)
  #ifndef __stdcall
    #define __stdcall
  #endif
  #ifndef __cdecl
    #define __cdecl
  #endif
  #ifndef __fastcall
    #define __fastcall
  #endif
#endif
#ifndef DL_IMPORT
  #define DL_IMPORT(t) t
#endif
#ifndef DL_EXPORT
  #define DL_EXPORT(t) t
#endif
#ifndef PY_LONG_LONG
  #define PY_LONG_LONG LONG_LONG
#endif
#ifndef Py_HUGE_VAL
  #define Py_HUGE_VAL HUGE_VAL
#endif
#ifdef PYPY_VERSION
#define CYTHON_COMPILING_IN_PYPY 1
#define CYTHON_COMPILING_IN_CPYTHON 0
#else
#define CYTHON_COMPILING_IN_PYPY 0
#define CYTHON_COMPILING_IN_CPYTHON 1
#endif
#if CYTHON_COMPILING_IN_PYPY && PY_VERSION_HEX < 0x02070600
#define Py_OptimizeFlag 0
#endif
#define __PYX_BUILD_PY_SSIZE_T "n"
#define CYTHON_FORMAT_SSIZE_T "z"
#if PY_MAJOR_VERSION < 3
  #define __Pyx_BUILTIN_MODULE_NAME "__builtin__"
  #define __Pyx_PyCode_New(a, k, l, s, f, code, c, n, v, fv, cell, fn, name, fline, lnos) \
          PyCode_New(a+k, l, s, f, code, c, n, v, fv, cell, fn, name, fline, lnos)
  #define __Pyx_DefaultClassType PyClass_Type
#else
  #define __Pyx_BUILTIN_MODULE_NAME "builtins"
  #define __Pyx_PyCode_New(a, k, l, s, f, code, c, n, v, fv, cell, fn, name, fline, lnos) \
          PyCode_New(a, k, l, s, f, code, c, n, v, fv, cell, fn, name, fline, lnos)
  #define __Pyx_DefaultClassType PyType_Type
#endif
#if PY_MAJOR_VERSION >= 3
  #define Py_TPFLAGS_CHECKTYPES 0
  #define Py_TPFLAGS_HAVE_INDEX 0
#endif
#if PY_MAJOR_VERSION >= 3
  #define Py_TPFLAGS_HAVE_NEWBUFFER 0
#endif
#if PY_VERSION_HEX < 0x030400a1 && !defined(Py_TPFLAGS_HAVE_FINALIZE)
  #define Py_TPFLAGS_HAVE_FINALIZE 0
#endif
#if PY_VERSION_HEX > 0x03030000 && defined(PyUnicode_KIND)
  #define CYTHON_PEP393_ENABLED 1
  #define __Pyx_PyUnicode_READY(op)       (likely(PyUnicode_IS_READY(op)) ? \
                                              0 : _PyUnicode_Ready((PyObject *)(op)))
  #define __Pyx_PyUnicode_GET_LENGTH(u)   PyUnicode_GET_LENGTH(u)
  #define __Pyx_PyUnicode_READ_CHAR(u, i) PyUnicode_READ_CHAR(u, i)
  #define __Pyx_PyUnicode_KIND(u)         PyUnicode_KIND(u)
  #define __Pyx_PyUnicode_DATA(u)         PyUnicode_DATA(u)
  #define __Pyx_PyUnicode_READ(k, d, i)   PyUnicode_READ(k, d, i)
#else
  #define CYTHON_PEP393_ENABLED 0
  #define __Pyx_PyUnicode_READY(op)       (0)
  #define __Pyx_PyUnicode_GET_LENGTH(u)   PyUnicode_GET_SIZE(u)
  #define __Pyx_PyUnicode_READ_CHAR(u, i) ((Py_UCS4)(PyUnicode_AS_UNICODE(u)[i]))
  #define __Pyx_PyUnicode_KIND(u)         (sizeof(Py_UNICODE))
  #define __Pyx_PyUnicode_DATA(u)         ((void*)PyUnicode_AS_UNICODE(u))
  #define __Pyx_PyUnicode_READ(k, d, i)   ((void)(k), (Py_UCS4)(((Py_UNICODE*)d)[i]))
#endif
#if CYTHON_COMPILING_IN_PYPY
  #define __Pyx_PyUnicode_Concat(a, b)      PyNumber_Add(a, b)
  #define __Pyx_PyUnicode_ConcatSafe(a, b)  PyNumber_Add(a, b)
#else
  #define __Pyx_PyUnicode_Concat(a, b)      PyUnicode_Concat(a, b)
  #define __Pyx_PyUnicode_ConcatSafe(a, b)  ((unlikely((a) == Py_None) || unlikely((b) == Py_None)) ? \
      PyNumber_Add(a, b) : __Pyx_PyUnicode_Concat(a, b))
#endif
#define __Pyx_PyString_FormatSafe(a, b)   ((unlikely((a) == Py_None)) ? PyNumber_Remainder(a, b) : __Pyx_PyString_Format(a, b))
#define __Pyx_PyUnicode_FormatSafe(a, b)  ((unlikely((a) == Py_None)) ? PyNumber_Remainder(a, b) : PyUnicode_Format(a, b))
#if PY_MAJOR_VERSION >= 3
  #define __Pyx_PyString_Format(a, b)  PyUnicode_Format(a, b)
#else
  #define __Pyx_PyString_Format(a, b)  PyString_Format(a, b)
#endif
#if PY_MAJOR_VERSION >= 3
  #define PyBaseString_Type            PyUnicode_Type
  #define PyStringObject               PyUnicodeObject
  #define PyString_Type                PyUnicode_Type
  #define PyString_Check               PyUnicode_Check
  #define PyString_CheckExact          PyUnicode_CheckExact
#endif
#if PY_MAJOR_VERSION >= 3
  #define __Pyx_PyBaseString_Check(obj) PyUnicode_Check(obj)
  #define __Pyx_PyBaseString_CheckExact(obj) PyUnicode_CheckExact(obj)
#else
  #define __Pyx_PyBaseString_Check(obj) (PyString_Check(obj) || PyUnicode_Check(obj))
  #define __Pyx_PyBaseString_CheckExact(obj) (PyString_CheckExact(obj) || PyUnicode_CheckExact(obj))
#endif
#ifndef PySet_CheckExact
  #define PySet_CheckExact(obj)        (Py_TYPE(obj) == &PySet_Type)
#endif
#define __Pyx_TypeCheck(obj, type) PyObject_TypeCheck(obj, (PyTypeObject *)type)
#if PY_MAJOR_VERSION >= 3
  #define PyIntObject                  PyLongObject
  #define PyInt_Type                   PyLong_Type
  #define PyInt_Check(op)              PyLong_Check(op)
  #define PyInt_CheckExact(op)         PyLong_CheckExact(op)
  #define PyInt_FromString             PyLong_FromString
  #define PyInt_FromUnicode            PyLong_FromUnicode
  #define PyInt_FromLong               PyLong_FromLong
  #define PyInt_FromSize_t             PyLong_FromSize_t
  #define PyInt_FromSsize_t            PyLong_FromSsize_t
  #define PyInt_AsLong                 PyLong_AsLong
  #define PyInt_AS_LONG                PyLong_AS_LONG
  #define PyInt_AsSsize_t              PyLong_AsSsize_t
  #define PyInt_AsUnsignedLongMask     PyLong_AsUnsignedLongMask
  #define PyInt_AsUnsignedLongLongMask PyLong_AsUnsignedLongLongMask
  #define PyNumber_Int                 PyNumber_Long
#endif
#if PY_MAJOR_VERSION >= 3
  #define PyBoolObject                 PyLongObject
#endif
#if PY_VERSION_HEX < 0x030200A4
  typedef long Py_hash_t;
  #define __Pyx_PyInt_FromHash_t PyInt_FromLong
  #define __Pyx_PyInt_AsHash_t   PyInt_AsLong
#else
  #define __Pyx_PyInt_FromHash_t PyInt_FromSsize_t
  #define __Pyx_PyInt_AsHash_t   PyInt_AsSsize_t
#endif
#if PY_MAJOR_VERSION >= 3
  #define PyMethod_New(func, self, klass) ((self) ? PyMethod_New(func, self) : PyInstanceMethod_New(func))
#endif
#ifndef CYTHON_INLINE
  #if defined(__GNUC__)
    #define CYTHON_INLINE __inline__
  #elif defined(_MSC_VER)
    #define CYTHON_INLINE __inline
  #elif defined (__STDC_VERSION__) && __STDC_VERSION__ >= 199901L
    #define CYTHON_INLINE inline
  #else
    #define CYTHON_INLINE
  #endif
#endif
#ifndef CYTHON_RESTRICT
  #if defined(__GNUC__)
    #define CYTHON_RESTRICT __restrict__
  #elif defined(_MSC_VER) && _MSC_VER >= 1400
    #define CYTHON_RESTRICT __restrict
  #elif defined (__STDC_VERSION__) && __STDC_VERSION__ >= 199901L
    #define CYTHON_RESTRICT restrict
  #else
    #define CYTHON_RESTRICT
  #endif
#endif
#ifdef NAN
#define __PYX_NAN() ((float) NAN)
#else
static CYTHON_INLINE float __PYX_NAN() {
  /* Initialize NaN. The sign is irrelevant, an exponent with all bits 1 and
   a nonzero mantissa means NaN. If the first bit in the mantissa is 1, it is
   a quiet NaN. */
  float value;
  memset(&value, 0xFF, sizeof(value));
  return value;
}
#endif
#ifdef __cplusplus
template<typename T>
void __Pyx_call_destructor(T* x) {
    x->~T();
}
#endif


#if PY_MAJOR_VERSION >= 3
  #define __Pyx_PyNumber_Divide(x,y)         PyNumber_TrueDivide(x,y)
  #define __Pyx_PyNumber_InPlaceDivide(x,y)  PyNumber_InPlaceTrueDivide(x,y)
#else
  #define __Pyx_PyNumber_Divide(x,y)         PyNumber_Divide(x,y)
  #define __Pyx_PyNumber_InPlaceDivide(x,y)  PyNumber_InPlaceDivide(x,y)
#endif

#ifndef __PYX_EXTERN_C
  #ifdef __cplusplus
    #define __PYX_EXTERN_C extern "C"
  #else
    #define __PYX_EXTERN_C extern
  #endif
#endif

#if defined(WIN32) || defined(MS_WINDOWS)
#define _USE_MATH_DEFINES
#endif
#include <math.h>
#define __PYX_HAVE__gssapi__raw__ext_rfc6680
#define __PYX_HAVE_API__gssapi__raw__ext_rfc6680
#include "stdint.h"
#include "python_gssapi.h"
#include "gssapi/gssapi_ext.h"
#ifdef _OPENMP
#include <omp.h>
#endif /* _OPENMP */

#ifdef PYREX_WITHOUT_ASSERTIONS
#define CYTHON_WITHOUT_ASSERTIONS
#endif

#ifndef CYTHON_UNUSED
# if defined(__GNUC__)
#   if !(defined(__cplusplus)) || (__GNUC__ > 3 || (__GNUC__ == 3 && __GNUC_MINOR__ >= 4))
#     define CYTHON_UNUSED __attribute__ ((__unused__))
#   else
#     define CYTHON_UNUSED
#   endif
# elif defined(__ICC) || (defined(__INTEL_COMPILER) && !defined(_MSC_VER))
#   define CYTHON_UNUSED __attribute__ ((__unused__))
# else
#   define CYTHON_UNUSED
# endif
#endif
typedef struct {PyObject **p; char *s; const Py_ssize_t n; const char* encoding;
                const char is_unicode; const char is_str; const char intern; } __Pyx_StringTabEntry;

#define __PYX_DEFAULT_STRING_ENCODING_IS_ASCII 0
#define __PYX_DEFAULT_STRING_ENCODING_IS_DEFAULT 0
#define __PYX_DEFAULT_STRING_ENCODING ""
#define __Pyx_PyObject_FromString __Pyx_PyBytes_FromString
#define __Pyx_PyObject_FromStringAndSize __Pyx_PyBytes_FromStringAndSize
#define __Pyx_fits_Py_ssize_t(v, type, is_signed)  (    \
    (sizeof(type) < sizeof(Py_ssize_t))  ||             \
    (sizeof(type) > sizeof(Py_ssize_t) &&               \
          likely(v < (type)PY_SSIZE_T_MAX ||            \
                 v == (type)PY_SSIZE_T_MAX)  &&         \
          (!is_signed || likely(v > (type)PY_SSIZE_T_MIN ||       \
                                v == (type)PY_SSIZE_T_MIN)))  ||  \
    (sizeof(type) == sizeof(Py_ssize_t) &&              \
          (is_signed || likely(v < (type)PY_SSIZE_T_MAX ||        \
                               v == (type)PY_SSIZE_T_MAX)))  )
static CYTHON_INLINE char* __Pyx_PyObject_AsString(PyObject*);
static CYTHON_INLINE char* __Pyx_PyObject_AsStringAndSize(PyObject*, Py_ssize_t* length);
#define __Pyx_PyByteArray_FromString(s) PyByteArray_FromStringAndSize((const char*)s, strlen((const char*)s))
#define __Pyx_PyByteArray_FromStringAndSize(s, l) PyByteArray_FromStringAndSize((const char*)s, l)
#define __Pyx_PyBytes_FromString        PyBytes_FromString
#define __Pyx_PyBytes_FromStringAndSize PyBytes_FromStringAndSize
static CYTHON_INLINE PyObject* __Pyx_PyUnicode_FromString(const char*);
#if PY_MAJOR_VERSION < 3
    #define __Pyx_PyStr_FromString        __Pyx_PyBytes_FromString
    #define __Pyx_PyStr_FromStringAndSize __Pyx_PyBytes_FromStringAndSize
#else
    #define __Pyx_PyStr_FromString        __Pyx_PyUnicode_FromString
    #define __Pyx_PyStr_FromStringAndSize __Pyx_PyUnicode_FromStringAndSize
#endif
#define __Pyx_PyObject_AsSString(s)    ((signed char*) __Pyx_PyObject_AsString(s))
#define __Pyx_PyObject_AsUString(s)    ((unsigned char*) __Pyx_PyObject_AsString(s))
#define __Pyx_PyObject_FromUString(s)  __Pyx_PyObject_FromString((const char*)s)
#define __Pyx_PyBytes_FromUString(s)   __Pyx_PyBytes_FromString((const char*)s)
#define __Pyx_PyByteArray_FromUString(s)   __Pyx_PyByteArray_FromString((const char*)s)
#define __Pyx_PyStr_FromUString(s)     __Pyx_PyStr_FromString((const char*)s)
#define __Pyx_PyUnicode_FromUString(s) __Pyx_PyUnicode_FromString((const char*)s)
#if PY_MAJOR_VERSION < 3
static CYTHON_INLINE size_t __Pyx_Py_UNICODE_strlen(const Py_UNICODE *u)
{
    const Py_UNICODE *u_end = u;
    while (*u_end++) ;
    return (size_t)(u_end - u - 1);
}
#else
#define __Pyx_Py_UNICODE_strlen Py_UNICODE_strlen
#endif
#define __Pyx_PyUnicode_FromUnicode(u)       PyUnicode_FromUnicode(u, __Pyx_Py_UNICODE_strlen(u))
#define __Pyx_PyUnicode_FromUnicodeAndLength PyUnicode_FromUnicode
#define __Pyx_PyUnicode_AsUnicode            PyUnicode_AsUnicode
#define __Pyx_Owned_Py_None(b) (Py_INCREF(Py_None), Py_None)
#define __Pyx_PyBool_FromLong(b) ((b) ? (Py_INCREF(Py_True), Py_True) : (Py_INCREF(Py_False), Py_False))
static CYTHON_INLINE int __Pyx_PyObject_IsTrue(PyObject*);
static CYTHON_INLINE PyObject* __Pyx_PyNumber_Int(PyObject* x);
static CYTHON_INLINE Py_ssize_t __Pyx_PyIndex_AsSsize_t(PyObject*);
static CYTHON_INLINE PyObject * __Pyx_PyInt_FromSize_t(size_t);
#if CYTHON_COMPILING_IN_CPYTHON
#define __pyx_PyFloat_AsDouble(x) (PyFloat_CheckExact(x) ? PyFloat_AS_DOUBLE(x) : PyFloat_AsDouble(x))
#else
#define __pyx_PyFloat_AsDouble(x) PyFloat_AsDouble(x)
#endif
#define __pyx_PyFloat_AsFloat(x) ((float) __pyx_PyFloat_AsDouble(x))
#if PY_MAJOR_VERSION < 3 && __PYX_DEFAULT_STRING_ENCODING_IS_ASCII
static int __Pyx_sys_getdefaultencoding_not_ascii;
static int __Pyx_init_sys_getdefaultencoding_params(void) {
    PyObject* sys;
    PyObject* default_encoding = NULL;
    PyObject* ascii_chars_u = NULL;
    PyObject* ascii_chars_b = NULL;
    const char* default_encoding_c;
    sys = PyImport_ImportModule("sys");
    if (!sys) goto bad;
    default_encoding = PyObject_CallMethod(sys, (char*) (const char*) "getdefaultencoding", NULL);
    Py_DECREF(sys);
    if (!default_encoding) goto bad;
    default_encoding_c = PyBytes_AsString(default_encoding);
    if (!default_encoding_c) goto bad;
    if (strcmp(default_encoding_c, "ascii") == 0) {
        __Pyx_sys_getdefaultencoding_not_ascii = 0;
    } else {
        char ascii_chars[128];
        int c;
        for (c = 0; c < 128; c++) {
            ascii_chars[c] = c;
        }
        __Pyx_sys_getdefaultencoding_not_ascii = 1;
        ascii_chars_u = PyUnicode_DecodeASCII(ascii_chars, 128, NULL);
        if (!ascii_chars_u) goto bad;
        ascii_chars_b = PyUnicode_AsEncodedString(ascii_chars_u, default_encoding_c, NULL);
        if (!ascii_chars_b || !PyBytes_Check(ascii_chars_b) || memcmp(ascii_chars, PyBytes_AS_STRING(ascii_chars_b), 128) != 0) {
            PyErr_Format(
                PyExc_ValueError,
                "This module compiled with c_string_encoding=ascii, but default encoding '%.200s' is not a superset of ascii.",
                default_encoding_c);
            goto bad;
        }
        Py_DECREF(ascii_chars_u);
        Py_DECREF(ascii_chars_b);
    }
    Py_DECREF(default_encoding);
    return 0;
bad:
    Py_XDECREF(default_encoding);
    Py_XDECREF(ascii_chars_u);
    Py_XDECREF(ascii_chars_b);
    return -1;
}
#endif
#if __PYX_DEFAULT_STRING_ENCODING_IS_DEFAULT && PY_MAJOR_VERSION >= 3
#define __Pyx_PyUnicode_FromStringAndSize(c_str, size) PyUnicode_DecodeUTF8(c_str, size, NULL)
#else
#define __Pyx_PyUnicode_FromStringAndSize(c_str, size) PyUnicode_Decode(c_str, size, __PYX_DEFAULT_STRING_ENCODING, NULL)
#if __PYX_DEFAULT_STRING_ENCODING_IS_DEFAULT
static char* __PYX_DEFAULT_STRING_ENCODING;
static int __Pyx_init_sys_getdefaultencoding_params(void) {
    PyObject* sys;
    PyObject* default_encoding = NULL;
    char* default_encoding_c;
    sys = PyImport_ImportModule("sys");
    if (!sys) goto bad;
    default_encoding = PyObject_CallMethod(sys, (char*) (const char*) "getdefaultencoding", NULL);
    Py_DECREF(sys);
    if (!default_encoding) goto bad;
    default_encoding_c = PyBytes_AsString(default_encoding);
    if (!default_encoding_c) goto bad;
    __PYX_DEFAULT_STRING_ENCODING = (char*) malloc(strlen(default_encoding_c));
    if (!__PYX_DEFAULT_STRING_ENCODING) goto bad;
    strcpy(__PYX_DEFAULT_STRING_ENCODING, default_encoding_c);
    Py_DECREF(default_encoding);
    return 0;
bad:
    Py_XDECREF(default_encoding);
    return -1;
}
#endif
#endif


/* Test for GCC > 2.95 */
#if defined(__GNUC__)     && (__GNUC__ > 2 || (__GNUC__ == 2 && (__GNUC_MINOR__ > 95)))
  #define likely(x)   __builtin_expect(!!(x), 1)
  #define unlikely(x) __builtin_expect(!!(x), 0)
#else /* !__GNUC__ or GCC < 2.95 */
  #define likely(x)   (x)
  #define unlikely(x) (x)
#endif /* __GNUC__ */

static PyObject *__pyx_m;
static PyObject *__pyx_d;
static PyObject *__pyx_b;
static PyObject *__pyx_empty_tuple;
static PyObject *__pyx_empty_bytes;
static int __pyx_lineno;
static int __pyx_clineno = 0;
static const char * __pyx_cfilenm= __FILE__;
static const char *__pyx_filename;


static const char *__pyx_f[] = {
  "gssapi/raw/ext_rfc6680.pyx",
  "gssapi/raw/names.pxd",
  "gssapi/raw/oids.pxd",
};

/*--- Type declarations ---*/
struct __pyx_obj_6gssapi_3raw_5names_Name;
struct __pyx_obj_6gssapi_3raw_4oids_OID;

/* "gssapi/raw/names.pxd":3
 * from gssapi.raw.cython_types cimport gss_name_t
 * 
 * cdef class Name:             # <<<<<<<<<<<<<<
 *     cdef gss_name_t raw_name
 *     cdef bint _free_on_dealloc
 */
struct __pyx_obj_6gssapi_3raw_5names_Name {
  PyObject_HEAD
  gss_name_t raw_name;
  int _free_on_dealloc;
};


/* "gssapi/raw/oids.pxd":4
 * 
 * 
 * cdef class OID:             # <<<<<<<<<<<<<<
 *     # NB(directxman12): this is a pointer, not a gss_OID_desc
 *     cdef gss_OID_desc raw_oid
 */
struct __pyx_obj_6gssapi_3raw_4oids_OID {
  PyObject_HEAD
  struct __pyx_vtabstruct_6gssapi_3raw_4oids_OID *__pyx_vtab;
  gss_OID_desc raw_oid;
  int _free_on_dealloc;
};



struct __pyx_vtabstruct_6gssapi_3raw_4oids_OID {
  int (*_copy_from)(struct __pyx_obj_6gssapi_3raw_4oids_OID *, gss_OID_desc);
  int (*_from_bytes)(struct __pyx_obj_6gssapi_3raw_4oids_OID *, PyObject *);
};
static struct __pyx_vtabstruct_6gssapi_3raw_4oids_OID *__pyx_vtabptr_6gssapi_3raw_4oids_OID;
#ifndef CYTHON_REFNANNY
  #define CYTHON_REFNANNY 0
#endif
#if CYTHON_REFNANNY
  typedef struct {
    void (*INCREF)(void*, PyObject*, int);
    void (*DECREF)(void*, PyObject*, int);
    void (*GOTREF)(void*, PyObject*, int);
    void (*GIVEREF)(void*, PyObject*, int);
    void* (*SetupContext)(const char*, int, const char*);
    void (*FinishContext)(void**);
  } __Pyx_RefNannyAPIStruct;
  static __Pyx_RefNannyAPIStruct *__Pyx_RefNanny = NULL;
  static __Pyx_RefNannyAPIStruct *__Pyx_RefNannyImportAPI(const char *modname);
  #define __Pyx_RefNannyDeclarations void *__pyx_refnanny = NULL;
#ifdef WITH_THREAD
  #define __Pyx_RefNannySetupContext(name, acquire_gil) \
          if (acquire_gil) { \
              PyGILState_STATE __pyx_gilstate_save = PyGILState_Ensure(); \
              __pyx_refnanny = __Pyx_RefNanny->SetupContext((name), __LINE__, __FILE__); \
              PyGILState_Release(__pyx_gilstate_save); \
          } else { \
              __pyx_refnanny = __Pyx_RefNanny->SetupContext((name), __LINE__, __FILE__); \
          }
#else
  #define __Pyx_RefNannySetupContext(name, acquire_gil) \
          __pyx_refnanny = __Pyx_RefNanny->SetupContext((name), __LINE__, __FILE__)
#endif
  #define __Pyx_RefNannyFinishContext() \
          __Pyx_RefNanny->FinishContext(&__pyx_refnanny)
  #define __Pyx_INCREF(r)  __Pyx_RefNanny->INCREF(__pyx_refnanny, (PyObject *)(r), __LINE__)
  #define __Pyx_DECREF(r)  __Pyx_RefNanny->DECREF(__pyx_refnanny, (PyObject *)(r), __LINE__)
  #define __Pyx_GOTREF(r)  __Pyx_RefNanny->GOTREF(__pyx_refnanny, (PyObject *)(r), __LINE__)
  #define __Pyx_GIVEREF(r) __Pyx_RefNanny->GIVEREF(__pyx_refnanny, (PyObject *)(r), __LINE__)
  #define __Pyx_XINCREF(r)  do { if((r) != NULL) {__Pyx_INCREF(r); }} while(0)
  #define __Pyx_XDECREF(r)  do { if((r) != NULL) {__Pyx_DECREF(r); }} while(0)
  #define __Pyx_XGOTREF(r)  do { if((r) != NULL) {__Pyx_GOTREF(r); }} while(0)
  #define __Pyx_XGIVEREF(r) do { if((r) != NULL) {__Pyx_GIVEREF(r);}} while(0)
#else
  #define __Pyx_RefNannyDeclarations
  #define __Pyx_RefNannySetupContext(name, acquire_gil)
  #define __Pyx_RefNannyFinishContext()
  #define __Pyx_INCREF(r) Py_INCREF(r)
  #define __Pyx_DECREF(r) Py_DECREF(r)
  #define __Pyx_GOTREF(r)
  #define __Pyx_GIVEREF(r)
  #define __Pyx_XINCREF(r) Py_XINCREF(r)
  #define __Pyx_XDECREF(r) Py_XDECREF(r)
  #define __Pyx_XGOTREF(r)
  #define __Pyx_XGIVEREF(r)
#endif
#define __Pyx_XDECREF_SET(r, v) do {                            \
        PyObject *tmp = (PyObject *) r;                         \
        r = v; __Pyx_XDECREF(tmp);                              \
    } while (0)
#define __Pyx_DECREF_SET(r, v) do {                             \
        PyObject *tmp = (PyObject *) r;                         \
        r = v; __Pyx_DECREF(tmp);                               \
    } while (0)
#define __Pyx_CLEAR(r)    do { PyObject* tmp = ((PyObject*)(r)); r = NULL; __Pyx_DECREF(tmp);} while(0)
#define __Pyx_XCLEAR(r)   do { if((r) != NULL) {PyObject* tmp = ((PyObject*)(r)); r = NULL; __Pyx_DECREF(tmp);}} while(0)

#if CYTHON_COMPILING_IN_CPYTHON
static CYTHON_INLINE PyObject* __Pyx_PyObject_GetAttrStr(PyObject* obj, PyObject* attr_name) {
    PyTypeObject* tp = Py_TYPE(obj);
    if (likely(tp->tp_getattro))
        return tp->tp_getattro(obj, attr_name);
#if PY_MAJOR_VERSION < 3
    if (likely(tp->tp_getattr))
        return tp->tp_getattr(obj, PyString_AS_STRING(attr_name));
#endif
    return PyObject_GetAttr(obj, attr_name);
}
#else
#define __Pyx_PyObject_GetAttrStr(o,n) PyObject_GetAttr(o,n)
#endif

static PyObject *__Pyx_GetBuiltinName(PyObject *name);

static void __Pyx_RaiseArgtupleInvalid(const char* func_name, int exact,
    Py_ssize_t num_min, Py_ssize_t num_max, Py_ssize_t num_found);

static void __Pyx_RaiseDoubleKeywordsError(const char* func_name, PyObject* kw_name);

static int __Pyx_ParseOptionalKeywords(PyObject *kwds, PyObject **argnames[], \
    PyObject *kwds2, PyObject *values[], Py_ssize_t num_pos_args, \
    const char* function_name);

static CYTHON_INLINE int __Pyx_ArgTypeTest(PyObject *obj, PyTypeObject *type, int none_allowed,
    const char *name, int exact);

static CYTHON_INLINE PyObject *__Pyx_GetModuleGlobalName(PyObject *name);

#if CYTHON_COMPILING_IN_CPYTHON
static CYTHON_INLINE PyObject* __Pyx_PyObject_Call(PyObject *func, PyObject *arg, PyObject *kw);
#else
#define __Pyx_PyObject_Call(func, arg, kw) PyObject_Call(func, arg, kw)
#endif

static CYTHON_INLINE void __Pyx_ErrRestore(PyObject *type, PyObject *value, PyObject *tb);
static CYTHON_INLINE void __Pyx_ErrFetch(PyObject **type, PyObject **value, PyObject **tb);

static void __Pyx_Raise(PyObject *type, PyObject *value, PyObject *tb, PyObject *cause);

#if CYTHON_COMPILING_IN_CPYTHON
static CYTHON_INLINE int __Pyx_PyList_Append(PyObject* list, PyObject* x) {
    PyListObject* L = (PyListObject*) list;
    Py_ssize_t len = Py_SIZE(list);
    if (likely(L->allocated > len) & likely(len > (L->allocated >> 1))) {
        Py_INCREF(x);
        PyList_SET_ITEM(list, len, x);
        Py_SIZE(list) = len+1;
        return 0;
    }
    return PyList_Append(list, x);
}
#else
#define __Pyx_PyList_Append(L,x) PyList_Append(L,x)
#endif

static void* __Pyx_GetVtable(PyObject *dict);

static PyObject* __Pyx_ImportFrom(PyObject* module, PyObject* name);

typedef struct {
    int code_line;
    PyCodeObject* code_object;
} __Pyx_CodeObjectCacheEntry;
struct __Pyx_CodeObjectCache {
    int count;
    int max_count;
    __Pyx_CodeObjectCacheEntry* entries;
};
static struct __Pyx_CodeObjectCache __pyx_code_cache = {0,0,NULL};
static int __pyx_bisect_code_objects(__Pyx_CodeObjectCacheEntry* entries, int count, int code_line);
static PyCodeObject *__pyx_find_code_object(int code_line);
static void __pyx_insert_code_object(int code_line, PyCodeObject* code_object);

static void __Pyx_AddTraceback(const char *funcname, int c_line,
                               int py_line, const char *filename);

static PyObject *__Pyx_Import(PyObject *name, PyObject *from_list, int level);

static CYTHON_INLINE PyObject* __Pyx_PyInt_From_uint32_t(uint32_t value);

static CYTHON_INLINE int __Pyx_PyInt_As_int(PyObject *);

static CYTHON_INLINE PyObject* __Pyx_PyInt_From_long(long value);

static CYTHON_INLINE long __Pyx_PyInt_As_long(PyObject *);

static int __Pyx_check_binary_version(void);

#if !defined(__Pyx_PyIdentifier_FromString)
#if PY_MAJOR_VERSION < 3
  #define __Pyx_PyIdentifier_FromString(s) PyString_FromString(s)
#else
  #define __Pyx_PyIdentifier_FromString(s) PyUnicode_FromString(s)
#endif
#endif

static PyObject *__Pyx_ImportModule(const char *name);

static PyTypeObject *__Pyx_ImportType(const char *module_name, const char *class_name, size_t size, int strict);

static int __Pyx_InitStrings(__Pyx_StringTabEntry *t);


/* Module declarations from 'libc.stdint' */

/* Module declarations from 'gssapi.raw.cython_types' */

/* Module declarations from 'gssapi.raw.ext_buffer_sets' */

/* Module declarations from 'gssapi.raw.names' */
static PyTypeObject *__pyx_ptype_6gssapi_3raw_5names_Name = 0;

/* Module declarations from 'gssapi.raw.oids' */
static PyTypeObject *__pyx_ptype_6gssapi_3raw_4oids_OID = 0;

/* Module declarations from 'gssapi.raw.ext_rfc6680' */
#define __Pyx_MODULE_NAME "gssapi.raw.ext_rfc6680"
int __pyx_module_is_main_gssapi__raw__ext_rfc6680 = 0;

/* Implementation of 'gssapi.raw.ext_rfc6680' */
static PyObject *__pyx_builtin_range;
static PyObject *__pyx_pf_6gssapi_3raw_11ext_rfc6680_display_name_ext(CYTHON_UNUSED PyObject *__pyx_self, struct __pyx_obj_6gssapi_3raw_5names_Name *__pyx_v_name, struct __pyx_obj_6gssapi_3raw_4oids_OID *__pyx_v_name_type); /* proto */
static PyObject *__pyx_pf_6gssapi_3raw_11ext_rfc6680_2inquire_name(CYTHON_UNUSED PyObject *__pyx_self, struct __pyx_obj_6gssapi_3raw_5names_Name *__pyx_v_name, PyObject *__pyx_v_mech_name, PyObject *__pyx_v_attrs); /* proto */
static PyObject *__pyx_pf_6gssapi_3raw_11ext_rfc6680_4set_name_attribute(CYTHON_UNUSED PyObject *__pyx_self, struct __pyx_obj_6gssapi_3raw_5names_Name *__pyx_v_name, PyObject *__pyx_v_attr, PyObject *__pyx_v_value, int __pyx_v_complete); /* proto */
static PyObject *__pyx_pf_6gssapi_3raw_11ext_rfc6680_6get_name_attribute(CYTHON_UNUSED PyObject *__pyx_self, struct __pyx_obj_6gssapi_3raw_5names_Name *__pyx_v_name, PyObject *__pyx_v_attr, CYTHON_UNUSED PyObject *__pyx_v_more); /* proto */
static PyObject *__pyx_pf_6gssapi_3raw_11ext_rfc6680_8delete_name_attribute(CYTHON_UNUSED PyObject *__pyx_self, struct __pyx_obj_6gssapi_3raw_5names_Name *__pyx_v_name, PyObject *__pyx_v_attr); /* proto */
static PyObject *__pyx_pf_6gssapi_3raw_11ext_rfc6680_10export_name_composite(CYTHON_UNUSED PyObject *__pyx_self, struct __pyx_obj_6gssapi_3raw_5names_Name *__pyx_v_name); /* proto */
static char __pyx_k_i[] = "i";
static char __pyx_k_res[] = "res";
static char __pyx_k_val[] = "val";
static char __pyx_k_BASE[] = "BASE";
static char __pyx_k_attr[] = "attr";
static char __pyx_k_main[] = "__main__";
static char __pyx_k_more[] = "more";
static char __pyx_k_name[] = "name";
static char __pyx_k_test[] = "__test__";
static char __pyx_k_attrs[] = "attrs";
static char __pyx_k_range[] = "range";
static char __pyx_k_value[] = "value";
static char __pyx_k_GSSAPI[] = "GSSAPI";
static char __pyx_k_import[] = "__import__";
static char __pyx_k_length[] = "length";
static char __pyx_k_py_res[] = "py_res";
static char __pyx_k_mn_mech[] = "mn_mech";
static char __pyx_k_py_mech[] = "py_mech";
static char __pyx_k_py_vals[] = "py_vals";
static char __pyx_k_GSSError[] = "GSSError";
static char __pyx_k_complete[] = "complete";
static char __pyx_k_maj_stat[] = "maj_stat";
static char __pyx_k_min_stat[] = "min_stat";
static char __pyx_k_more_val[] = "more_val";
static char __pyx_k_val_buff[] = "val_buff";
static char __pyx_k_attr_buff[] = "attr_buff";
static char __pyx_k_attr_name[] = "attr_name";
static char __pyx_k_mech_name[] = "mech_name";
static char __pyx_k_name_text[] = "name_text";
static char __pyx_k_name_type[] = "name_type";
static char __pyx_k_value_len[] = "value_len";
static char __pyx_k_attr_names[] = "attr_names";
static char __pyx_k_name_is_mn[] = "name_is_mn";
static char __pyx_k_pyx_vtable[] = "__pyx_vtable__";
static char __pyx_k_mn_mech_ptr[] = "mn_mech_ptr";
static char __pyx_k_output_name[] = "output_name";
static char __pyx_k_inquire_name[] = "inquire_name";
static char __pyx_k_authenticated[] = "authenticated";
static char __pyx_k_py_attr_names[] = "py_attr_names";
static char __pyx_k_py_displ_vals[] = "py_displ_vals";
static char __pyx_k_attr_names_ptr[] = "attr_names_ptr";
static char __pyx_k_displ_val_buff[] = "displ_val_buff";
static char __pyx_k_name_is_mn_ptr[] = "name_is_mn_ptr";
static char __pyx_k_gssapi_raw_misc[] = "gssapi.raw.misc";
static char __pyx_k_display_name_ext[] = "display_name_ext";
static char __pyx_k_InquireNameResult[] = "InquireNameResult";
static char __pyx_k_get_name_attribute[] = "get_name_attribute";
static char __pyx_k_set_name_attribute[] = "set_name_attribute";
static char __pyx_k_delete_name_attribute[] = "delete_name_attribute";
static char __pyx_k_export_name_composite[] = "export_name_composite";
static char __pyx_k_GetNameAttributeResult[] = "GetNameAttributeResult";
static char __pyx_k_gssapi_raw_ext_rfc6680[] = "gssapi.raw.ext_rfc6680";
static char __pyx_k_gssapi_raw_named_tuples[] = "gssapi.raw.named_tuples";
static char __pyx_k_home_directxman12_dev_pythongss[] = "/home/directxman12/dev/pythongssapi/python-gssapi/gssapi/raw/ext_rfc6680.pyx";
static PyObject *__pyx_n_s_BASE;
static PyObject *__pyx_n_s_GSSAPI;
static PyObject *__pyx_n_s_GSSError;
static PyObject *__pyx_n_s_GetNameAttributeResult;
static PyObject *__pyx_n_s_InquireNameResult;
static PyObject *__pyx_n_s_attr;
static PyObject *__pyx_n_s_attr_buff;
static PyObject *__pyx_n_s_attr_name;
static PyObject *__pyx_n_s_attr_names;
static PyObject *__pyx_n_s_attr_names_ptr;
static PyObject *__pyx_n_s_attrs;
static PyObject *__pyx_n_s_authenticated;
static PyObject *__pyx_n_s_complete;
static PyObject *__pyx_n_s_delete_name_attribute;
static PyObject *__pyx_n_s_displ_val_buff;
static PyObject *__pyx_n_s_display_name_ext;
static PyObject *__pyx_n_s_export_name_composite;
static PyObject *__pyx_n_s_get_name_attribute;
static PyObject *__pyx_n_s_gssapi_raw_ext_rfc6680;
static PyObject *__pyx_n_s_gssapi_raw_misc;
static PyObject *__pyx_n_s_gssapi_raw_named_tuples;
static PyObject *__pyx_kp_s_home_directxman12_dev_pythongss;
static PyObject *__pyx_n_s_i;
static PyObject *__pyx_n_s_import;
static PyObject *__pyx_n_s_inquire_name;
static PyObject *__pyx_n_s_length;
static PyObject *__pyx_n_s_main;
static PyObject *__pyx_n_s_maj_stat;
static PyObject *__pyx_n_s_mech_name;
static PyObject *__pyx_n_s_min_stat;
static PyObject *__pyx_n_s_mn_mech;
static PyObject *__pyx_n_s_mn_mech_ptr;
static PyObject *__pyx_n_s_more;
static PyObject *__pyx_n_s_more_val;
static PyObject *__pyx_n_s_name;
static PyObject *__pyx_n_s_name_is_mn;
static PyObject *__pyx_n_s_name_is_mn_ptr;
static PyObject *__pyx_n_s_name_text;
static PyObject *__pyx_n_s_name_type;
static PyObject *__pyx_n_s_output_name;
static PyObject *__pyx_n_s_py_attr_names;
static PyObject *__pyx_n_s_py_displ_vals;
static PyObject *__pyx_n_s_py_mech;
static PyObject *__pyx_n_s_py_res;
static PyObject *__pyx_n_s_py_vals;
static PyObject *__pyx_n_s_pyx_vtable;
static PyObject *__pyx_n_s_range;
static PyObject *__pyx_n_s_res;
static PyObject *__pyx_n_s_set_name_attribute;
static PyObject *__pyx_n_s_test;
static PyObject *__pyx_n_s_val;
static PyObject *__pyx_n_s_val_buff;
static PyObject *__pyx_n_s_value;
static PyObject *__pyx_n_s_value_len;
static PyObject *__pyx_tuple_;
static PyObject *__pyx_tuple__3;
static PyObject *__pyx_tuple__5;
static PyObject *__pyx_tuple__7;
static PyObject *__pyx_tuple__9;
static PyObject *__pyx_tuple__11;
static PyObject *__pyx_codeobj__2;
static PyObject *__pyx_codeobj__4;
static PyObject *__pyx_codeobj__6;
static PyObject *__pyx_codeobj__8;
static PyObject *__pyx_codeobj__10;
static PyObject *__pyx_codeobj__12;

/* "gssapi/raw/ext_rfc6680.pyx":39
 * 
 * 
 * def display_name_ext(Name name not None, OID name_type not None):             # <<<<<<<<<<<<<<
 *     """
 *     Display the given Name using the given name type OID
 */

/* Python wrapper */
static PyObject *__pyx_pw_6gssapi_3raw_11ext_rfc6680_1display_name_ext(PyObject *__pyx_self, PyObject *__pyx_args, PyObject *__pyx_kwds); /*proto*/
static char __pyx_doc_6gssapi_3raw_11ext_rfc6680_display_name_ext[] = "\n    Display the given Name using the given name type OID\n\n    This method attempts to display the given Name using the syntax of\n    the given name type.  If this is not possible, an appropriate error\n    will be raised.\n\n    Args:\n        name (Name): the name to display\n        name_type (OID): the name type (see NameType) to use to\n            display the given name\n\n    Returns:\n        bytes: the displayed name\n\n    Raises:\n        OperationUnavailableError: the given name could not be displayed\n            using the given name type\n    ";
static PyMethodDef __pyx_mdef_6gssapi_3raw_11ext_rfc6680_1display_name_ext = {"display_name_ext", (PyCFunction)__pyx_pw_6gssapi_3raw_11ext_rfc6680_1display_name_ext, METH_VARARGS|METH_KEYWORDS, __pyx_doc_6gssapi_3raw_11ext_rfc6680_display_name_ext};
static PyObject *__pyx_pw_6gssapi_3raw_11ext_rfc6680_1display_name_ext(PyObject *__pyx_self, PyObject *__pyx_args, PyObject *__pyx_kwds) {
  struct __pyx_obj_6gssapi_3raw_5names_Name *__pyx_v_name = 0;
  struct __pyx_obj_6gssapi_3raw_4oids_OID *__pyx_v_name_type = 0;
  int __pyx_lineno = 0;
  const char *__pyx_filename = NULL;
  int __pyx_clineno = 0;
  PyObject *__pyx_r = 0;
  __Pyx_RefNannyDeclarations
  __Pyx_RefNannySetupContext("display_name_ext (wrapper)", 0);
  {
    static PyObject **__pyx_pyargnames[] = {&__pyx_n_s_name,&__pyx_n_s_name_type,0};
    PyObject* values[2] = {0,0};
    if (unlikely(__pyx_kwds)) {
      Py_ssize_t kw_args;
      const Py_ssize_t pos_args = PyTuple_GET_SIZE(__pyx_args);
      switch (pos_args) {
        case  2: values[1] = PyTuple_GET_ITEM(__pyx_args, 1);
        case  1: values[0] = PyTuple_GET_ITEM(__pyx_args, 0);
        case  0: break;
        default: goto __pyx_L5_argtuple_error;
      }
      kw_args = PyDict_Size(__pyx_kwds);
      switch (pos_args) {
        case  0:
        if (likely((values[0] = PyDict_GetItem(__pyx_kwds, __pyx_n_s_name)) != 0)) kw_args--;
        else goto __pyx_L5_argtuple_error;
        case  1:
        if (likely((values[1] = PyDict_GetItem(__pyx_kwds, __pyx_n_s_name_type)) != 0)) kw_args--;
        else {
          __Pyx_RaiseArgtupleInvalid("display_name_ext", 1, 2, 2, 1); {__pyx_filename = __pyx_f[0]; __pyx_lineno = 39; __pyx_clineno = __LINE__; goto __pyx_L3_error;}
        }
      }
      if (unlikely(kw_args > 0)) {
        if (unlikely(__Pyx_ParseOptionalKeywords(__pyx_kwds, __pyx_pyargnames, 0, values, pos_args, "display_name_ext") < 0)) {__pyx_filename = __pyx_f[0]; __pyx_lineno = 39; __pyx_clineno = __LINE__; goto __pyx_L3_error;}
      }
    } else if (PyTuple_GET_SIZE(__pyx_args) != 2) {
      goto __pyx_L5_argtuple_error;
    } else {
      values[0] = PyTuple_GET_ITEM(__pyx_args, 0);
      values[1] = PyTuple_GET_ITEM(__pyx_args, 1);
    }
    __pyx_v_name = ((struct __pyx_obj_6gssapi_3raw_5names_Name *)values[0]);
    __pyx_v_name_type = ((struct __pyx_obj_6gssapi_3raw_4oids_OID *)values[1]);
  }
  goto __pyx_L4_argument_unpacking_done;
  __pyx_L5_argtuple_error:;
  __Pyx_RaiseArgtupleInvalid("display_name_ext", 1, 2, 2, PyTuple_GET_SIZE(__pyx_args)); {__pyx_filename = __pyx_f[0]; __pyx_lineno = 39; __pyx_clineno = __LINE__; goto __pyx_L3_error;}
  __pyx_L3_error:;
  __Pyx_AddTraceback("gssapi.raw.ext_rfc6680.display_name_ext", __pyx_clineno, __pyx_lineno, __pyx_filename);
  __Pyx_RefNannyFinishContext();
  return NULL;
  __pyx_L4_argument_unpacking_done:;
  if (unlikely(!__Pyx_ArgTypeTest(((PyObject *)__pyx_v_name), __pyx_ptype_6gssapi_3raw_5names_Name, 0, "name", 0))) {__pyx_filename = __pyx_f[0]; __pyx_lineno = 39; __pyx_clineno = __LINE__; goto __pyx_L1_error;}
  if (unlikely(!__Pyx_ArgTypeTest(((PyObject *)__pyx_v_name_type), __pyx_ptype_6gssapi_3raw_4oids_OID, 0, "name_type", 0))) {__pyx_filename = __pyx_f[0]; __pyx_lineno = 39; __pyx_clineno = __LINE__; goto __pyx_L1_error;}
  __pyx_r = __pyx_pf_6gssapi_3raw_11ext_rfc6680_display_name_ext(__pyx_self, __pyx_v_name, __pyx_v_name_type);

  /* function exit code */
  goto __pyx_L0;
  __pyx_L1_error:;
  __pyx_r = NULL;
  __pyx_L0:;
  __Pyx_RefNannyFinishContext();
  return __pyx_r;
}

static PyObject *__pyx_pf_6gssapi_3raw_11ext_rfc6680_display_name_ext(CYTHON_UNUSED PyObject *__pyx_self, struct __pyx_obj_6gssapi_3raw_5names_Name *__pyx_v_name, struct __pyx_obj_6gssapi_3raw_4oids_OID *__pyx_v_name_type) {
  gss_buffer_desc __pyx_v_output_name;
  OM_uint32 __pyx_v_maj_stat;
  OM_uint32 __pyx_v_min_stat;
  PyObject *__pyx_v_name_text = NULL;
  PyObject *__pyx_r = NULL;
  __Pyx_RefNannyDeclarations
  gss_buffer_desc __pyx_t_1;
  int __pyx_t_2;
  PyObject *__pyx_t_3 = NULL;
  PyObject *__pyx_t_4 = NULL;
  PyObject *__pyx_t_5 = NULL;
  PyObject *__pyx_t_6 = NULL;
  PyObject *__pyx_t_7 = NULL;
  Py_ssize_t __pyx_t_8;
  PyObject *__pyx_t_9 = NULL;
  int __pyx_lineno = 0;
  const char *__pyx_filename = NULL;
  int __pyx_clineno = 0;
  __Pyx_RefNannySetupContext("display_name_ext", 0);

  /* "gssapi/raw/ext_rfc6680.pyx":61
 * 
 *     # GSS_C_EMPTY_BUFFER
 *     cdef gss_buffer_desc output_name = gss_buffer_desc(0, NULL)             # <<<<<<<<<<<<<<
 * 
 *     cdef OM_uint32 maj_stat, min_stat
 */
  __pyx_t_1.length = 0;
  __pyx_t_1.value = NULL;
  __pyx_v_output_name = __pyx_t_1;

  /* "gssapi/raw/ext_rfc6680.pyx":65
 *     cdef OM_uint32 maj_stat, min_stat
 * 
 *     maj_stat = gss_display_name_ext(&min_stat, name.raw_name,             # <<<<<<<<<<<<<<
 *                                     &name_type.raw_oid, &output_name)
 * 
 */
  __pyx_v_maj_stat = gss_display_name_ext((&__pyx_v_min_stat), __pyx_v_name->raw_name, (&__pyx_v_name_type->raw_oid), (&__pyx_v_output_name));

  /* "gssapi/raw/ext_rfc6680.pyx":68
 *                                     &name_type.raw_oid, &output_name)
 * 
 *     if maj_stat == GSS_S_COMPLETE:             # <<<<<<<<<<<<<<
 *         name_text = output_name.value[:output_name.length]
 *         gss_release_buffer(&min_stat, &output_name)
 */
  __pyx_t_2 = ((__pyx_v_maj_stat == GSS_S_COMPLETE) != 0);
  if (__pyx_t_2) {

    /* "gssapi/raw/ext_rfc6680.pyx":69
 * 
 *     if maj_stat == GSS_S_COMPLETE:
 *         name_text = output_name.value[:output_name.length]             # <<<<<<<<<<<<<<
 *         gss_release_buffer(&min_stat, &output_name)
 *         return name_text
 */
    __pyx_t_3 = __Pyx_PyBytes_FromStringAndSize(__pyx_v_output_name.value + 0, __pyx_v_output_name.length - 0); if (unlikely(!__pyx_t_3)) {__pyx_filename = __pyx_f[0]; __pyx_lineno = 69; __pyx_clineno = __LINE__; goto __pyx_L1_error;}
    __Pyx_GOTREF(__pyx_t_3);
    __pyx_v_name_text = ((PyObject*)__pyx_t_3);
    __pyx_t_3 = 0;

    /* "gssapi/raw/ext_rfc6680.pyx":70
 *     if maj_stat == GSS_S_COMPLETE:
 *         name_text = output_name.value[:output_name.length]
 *         gss_release_buffer(&min_stat, &output_name)             # <<<<<<<<<<<<<<
 *         return name_text
 *     else:
 */
    gss_release_buffer((&__pyx_v_min_stat), (&__pyx_v_output_name));

    /* "gssapi/raw/ext_rfc6680.pyx":71
 *         name_text = output_name.value[:output_name.length]
 *         gss_release_buffer(&min_stat, &output_name)
 *         return name_text             # <<<<<<<<<<<<<<
 *     else:
 *         raise GSSError(maj_stat, min_stat)
 */
    __Pyx_XDECREF(__pyx_r);
    __Pyx_INCREF(__pyx_v_name_text);
    __pyx_r = __pyx_v_name_text;
    goto __pyx_L0;
  }
  /*else*/ {

    /* "gssapi/raw/ext_rfc6680.pyx":73
 *         return name_text
 *     else:
 *         raise GSSError(maj_stat, min_stat)             # <<<<<<<<<<<<<<
 * 
 * 
 */
    __pyx_t_4 = __Pyx_GetModuleGlobalName(__pyx_n_s_GSSError); if (unlikely(!__pyx_t_4)) {__pyx_filename = __pyx_f[0]; __pyx_lineno = 73; __pyx_clineno = __LINE__; goto __pyx_L1_error;}
    __Pyx_GOTREF(__pyx_t_4);
    __pyx_t_5 = __Pyx_PyInt_From_uint32_t(__pyx_v_maj_stat); if (unlikely(!__pyx_t_5)) {__pyx_filename = __pyx_f[0]; __pyx_lineno = 73; __pyx_clineno = __LINE__; goto __pyx_L1_error;}
    __Pyx_GOTREF(__pyx_t_5);
    __pyx_t_6 = __Pyx_PyInt_From_uint32_t(__pyx_v_min_stat); if (unlikely(!__pyx_t_6)) {__pyx_filename = __pyx_f[0]; __pyx_lineno = 73; __pyx_clineno = __LINE__; goto __pyx_L1_error;}
    __Pyx_GOTREF(__pyx_t_6);
    __pyx_t_7 = NULL;
    __pyx_t_8 = 0;
    if (CYTHON_COMPILING_IN_CPYTHON && unlikely(PyMethod_Check(__pyx_t_4))) {
      __pyx_t_7 = PyMethod_GET_SELF(__pyx_t_4);
      if (likely(__pyx_t_7)) {
        PyObject* function = PyMethod_GET_FUNCTION(__pyx_t_4);
        __Pyx_INCREF(__pyx_t_7);
        __Pyx_INCREF(function);
        __Pyx_DECREF_SET(__pyx_t_4, function);
        __pyx_t_8 = 1;
      }
    }
    __pyx_t_9 = PyTuple_New(2+__pyx_t_8); if (unlikely(!__pyx_t_9)) {__pyx_filename = __pyx_f[0]; __pyx_lineno = 73; __pyx_clineno = __LINE__; goto __pyx_L1_error;}
    __Pyx_GOTREF(__pyx_t_9);
    if (__pyx_t_7) {
      PyTuple_SET_ITEM(__pyx_t_9, 0, __pyx_t_7); __Pyx_GIVEREF(__pyx_t_7); __pyx_t_7 = NULL;
    }
    PyTuple_SET_ITEM(__pyx_t_9, 0+__pyx_t_8, __pyx_t_5);
    __Pyx_GIVEREF(__pyx_t_5);
    PyTuple_SET_ITEM(__pyx_t_9, 1+__pyx_t_8, __pyx_t_6);
    __Pyx_GIVEREF(__pyx_t_6);
    __pyx_t_5 = 0;
    __pyx_t_6 = 0;
    __pyx_t_3 = __Pyx_PyObject_Call(__pyx_t_4, __pyx_t_9, NULL); if (unlikely(!__pyx_t_3)) {__pyx_filename = __pyx_f[0]; __pyx_lineno = 73; __pyx_clineno = __LINE__; goto __pyx_L1_error;}
    __Pyx_GOTREF(__pyx_t_3);
    __Pyx_DECREF(__pyx_t_9); __pyx_t_9 = 0;
    __Pyx_DECREF(__pyx_t_4); __pyx_t_4 = 0;
    __Pyx_Raise(__pyx_t_3, 0, 0, 0);
    __Pyx_DECREF(__pyx_t_3); __pyx_t_3 = 0;
    {__pyx_filename = __pyx_f[0]; __pyx_lineno = 73; __pyx_clineno = __LINE__; goto __pyx_L1_error;}
  }

  /* "gssapi/raw/ext_rfc6680.pyx":39
 * 
 * 
 * def display_name_ext(Name name not None, OID name_type not None):             # <<<<<<<<<<<<<<
 *     """
 *     Display the given Name using the given name type OID
 */

  /* function exit code */
  __pyx_L1_error:;
  __Pyx_XDECREF(__pyx_t_3);
  __Pyx_XDECREF(__pyx_t_4);
  __Pyx_XDECREF(__pyx_t_5);
  __Pyx_XDECREF(__pyx_t_6);
  __Pyx_XDECREF(__pyx_t_7);
  __Pyx_XDECREF(__pyx_t_9);
  __Pyx_AddTraceback("gssapi.raw.ext_rfc6680.display_name_ext", __pyx_clineno, __pyx_lineno, __pyx_filename);
  __pyx_r = NULL;
  __pyx_L0:;
  __Pyx_XDECREF(__pyx_v_name_text);
  __Pyx_XGIVEREF(__pyx_r);
  __Pyx_RefNannyFinishContext();
  return __pyx_r;
}

/* "gssapi/raw/ext_rfc6680.pyx":76
 * 
 * 
 * def inquire_name(Name name not None, mech_name=True, attrs=True):             # <<<<<<<<<<<<<<
 *     """
 *     Get information about a Name
 */

/* Python wrapper */
static PyObject *__pyx_pw_6gssapi_3raw_11ext_rfc6680_3inquire_name(PyObject *__pyx_self, PyObject *__pyx_args, PyObject *__pyx_kwds); /*proto*/
static char __pyx_doc_6gssapi_3raw_11ext_rfc6680_2inquire_name[] = "\n    Get information about a Name\n\n    This method retrives information about the given name, including\n    the set of attribute names for the given name, as well as whether or\n    not the name is a Mechanism Name.  Additionally, if the given name is\n    a Mechanism Name, the associated mechansim is returned as well.\n\n    Args:\n        name (Name): the name about which to inquire\n        mech_name (bool): whether or not to retrieve if this name\n            is a mech_name (and the associate mechanism)\n        attrs (bool): whether or not to retrieve the attribute name list\n\n    Returns:\n        InquireNameResult: the set of attribute names for the given name,\n            whether or not the name is a Mechanism Name, and potentially\n            the associated mechanism if it is a Mechanism Name\n\n    Raises:\n        GSSError\n    ";
static PyMethodDef __pyx_mdef_6gssapi_3raw_11ext_rfc6680_3inquire_name = {"inquire_name", (PyCFunction)__pyx_pw_6gssapi_3raw_11ext_rfc6680_3inquire_name, METH_VARARGS|METH_KEYWORDS, __pyx_doc_6gssapi_3raw_11ext_rfc6680_2inquire_name};
static PyObject *__pyx_pw_6gssapi_3raw_11ext_rfc6680_3inquire_name(PyObject *__pyx_self, PyObject *__pyx_args, PyObject *__pyx_kwds) {
  struct __pyx_obj_6gssapi_3raw_5names_Name *__pyx_v_name = 0;
  PyObject *__pyx_v_mech_name = 0;
  PyObject *__pyx_v_attrs = 0;
  int __pyx_lineno = 0;
  const char *__pyx_filename = NULL;
  int __pyx_clineno = 0;
  PyObject *__pyx_r = 0;
  __Pyx_RefNannyDeclarations
  __Pyx_RefNannySetupContext("inquire_name (wrapper)", 0);
  {
    static PyObject **__pyx_pyargnames[] = {&__pyx_n_s_name,&__pyx_n_s_mech_name,&__pyx_n_s_attrs,0};
    PyObject* values[3] = {0,0,0};
    values[1] = ((PyObject *)Py_True);
    values[2] = ((PyObject *)Py_True);
    if (unlikely(__pyx_kwds)) {
      Py_ssize_t kw_args;
      const Py_ssize_t pos_args = PyTuple_GET_SIZE(__pyx_args);
      switch (pos_args) {
        case  3: values[2] = PyTuple_GET_ITEM(__pyx_args, 2);
        case  2: values[1] = PyTuple_GET_ITEM(__pyx_args, 1);
        case  1: values[0] = PyTuple_GET_ITEM(__pyx_args, 0);
        case  0: break;
        default: goto __pyx_L5_argtuple_error;
      }
      kw_args = PyDict_Size(__pyx_kwds);
      switch (pos_args) {
        case  0:
        if (likely((values[0] = PyDict_GetItem(__pyx_kwds, __pyx_n_s_name)) != 0)) kw_args--;
        else goto __pyx_L5_argtuple_error;
        case  1:
        if (kw_args > 0) {
          PyObject* value = PyDict_GetItem(__pyx_kwds, __pyx_n_s_mech_name);
          if (value) { values[1] = value; kw_args--; }
        }
        case  2:
        if (kw_args > 0) {
          PyObject* value = PyDict_GetItem(__pyx_kwds, __pyx_n_s_attrs);
          if (value) { values[2] = value; kw_args--; }
        }
      }
      if (unlikely(kw_args > 0)) {
        if (unlikely(__Pyx_ParseOptionalKeywords(__pyx_kwds, __pyx_pyargnames, 0, values, pos_args, "inquire_name") < 0)) {__pyx_filename = __pyx_f[0]; __pyx_lineno = 76; __pyx_clineno = __LINE__; goto __pyx_L3_error;}
      }
    } else {
      switch (PyTuple_GET_SIZE(__pyx_args)) {
        case  3: values[2] = PyTuple_GET_ITEM(__pyx_args, 2);
        case  2: values[1] = PyTuple_GET_ITEM(__pyx_args, 1);
        case  1: values[0] = PyTuple_GET_ITEM(__pyx_args, 0);
        break;
        default: goto __pyx_L5_argtuple_error;
      }
    }
    __pyx_v_name = ((struct __pyx_obj_6gssapi_3raw_5names_Name *)values[0]);
    __pyx_v_mech_name = values[1];
    __pyx_v_attrs = values[2];
  }
  goto __pyx_L4_argument_unpacking_done;
  __pyx_L5_argtuple_error:;
  __Pyx_RaiseArgtupleInvalid("inquire_name", 0, 1, 3, PyTuple_GET_SIZE(__pyx_args)); {__pyx_filename = __pyx_f[0]; __pyx_lineno = 76; __pyx_clineno = __LINE__; goto __pyx_L3_error;}
  __pyx_L3_error:;
  __Pyx_AddTraceback("gssapi.raw.ext_rfc6680.inquire_name", __pyx_clineno, __pyx_lineno, __pyx_filename);
  __Pyx_RefNannyFinishContext();
  return NULL;
  __pyx_L4_argument_unpacking_done:;
  if (unlikely(!__Pyx_ArgTypeTest(((PyObject *)__pyx_v_name), __pyx_ptype_6gssapi_3raw_5names_Name, 0, "name", 0))) {__pyx_filename = __pyx_f[0]; __pyx_lineno = 76; __pyx_clineno = __LINE__; goto __pyx_L1_error;}
  __pyx_r = __pyx_pf_6gssapi_3raw_11ext_rfc6680_2inquire_name(__pyx_self, __pyx_v_name, __pyx_v_mech_name, __pyx_v_attrs);

  /* function exit code */
  goto __pyx_L0;
  __pyx_L1_error:;
  __pyx_r = NULL;
  __pyx_L0:;
  __Pyx_RefNannyFinishContext();
  return __pyx_r;
}

static PyObject *__pyx_pf_6gssapi_3raw_11ext_rfc6680_2inquire_name(CYTHON_UNUSED PyObject *__pyx_self, struct __pyx_obj_6gssapi_3raw_5names_Name *__pyx_v_name, PyObject *__pyx_v_mech_name, PyObject *__pyx_v_attrs) {
  int *__pyx_v_name_is_mn_ptr;
  gss_OID *__pyx_v_mn_mech_ptr;
  gss_buffer_set_t *__pyx_v_attr_names_ptr;
  gss_buffer_set_t __pyx_v_attr_names;
  int __pyx_v_name_is_mn;
  gss_OID __pyx_v_mn_mech;
  OM_uint32 __pyx_v_maj_stat;
  OM_uint32 __pyx_v_min_stat;
  int __pyx_v_i;
  struct __pyx_obj_6gssapi_3raw_4oids_OID *__pyx_v_py_mech = 0;
  PyObject *__pyx_v_py_attr_names = NULL;
  gss_buffer_desc __pyx_v_attr_name;
  PyObject *__pyx_r = NULL;
  __Pyx_RefNannyDeclarations
  int __pyx_t_1;
  PyObject *__pyx_t_2 = NULL;
  size_t __pyx_t_3;
  int __pyx_t_4;
  int __pyx_t_5;
  PyObject *__pyx_t_6 = NULL;
  PyObject *__pyx_t_7 = NULL;
  PyObject *__pyx_t_8 = NULL;
  Py_ssize_t __pyx_t_9;
  PyObject *__pyx_t_10 = NULL;
  PyObject *__pyx_t_11 = NULL;
  int __pyx_lineno = 0;
  const char *__pyx_filename = NULL;
  int __pyx_clineno = 0;
  __Pyx_RefNannySetupContext("inquire_name", 0);

  /* "gssapi/raw/ext_rfc6680.pyx":100
 *     """
 * 
 *     cdef int *name_is_mn_ptr = NULL             # <<<<<<<<<<<<<<
 *     cdef gss_OID *mn_mech_ptr = NULL
 *     cdef gss_buffer_set_t *attr_names_ptr = NULL
 */
  __pyx_v_name_is_mn_ptr = NULL;

  /* "gssapi/raw/ext_rfc6680.pyx":101
 * 
 *     cdef int *name_is_mn_ptr = NULL
 *     cdef gss_OID *mn_mech_ptr = NULL             # <<<<<<<<<<<<<<
 *     cdef gss_buffer_set_t *attr_names_ptr = NULL
 * 
 */
  __pyx_v_mn_mech_ptr = NULL;

  /* "gssapi/raw/ext_rfc6680.pyx":102
 *     cdef int *name_is_mn_ptr = NULL
 *     cdef gss_OID *mn_mech_ptr = NULL
 *     cdef gss_buffer_set_t *attr_names_ptr = NULL             # <<<<<<<<<<<<<<
 * 
 *     cdef gss_buffer_set_t attr_names = GSS_C_NO_BUFFER_SET
 */
  __pyx_v_attr_names_ptr = NULL;

  /* "gssapi/raw/ext_rfc6680.pyx":104
 *     cdef gss_buffer_set_t *attr_names_ptr = NULL
 * 
 *     cdef gss_buffer_set_t attr_names = GSS_C_NO_BUFFER_SET             # <<<<<<<<<<<<<<
 *     if attrs:
 *         attr_names_ptr = &attr_names
 */
  __pyx_v_attr_names = GSS_C_NO_BUFFER_SET;

  /* "gssapi/raw/ext_rfc6680.pyx":105
 * 
 *     cdef gss_buffer_set_t attr_names = GSS_C_NO_BUFFER_SET
 *     if attrs:             # <<<<<<<<<<<<<<
 *         attr_names_ptr = &attr_names
 * 
 */
  __pyx_t_1 = __Pyx_PyObject_IsTrue(__pyx_v_attrs); if (unlikely(__pyx_t_1 < 0)) {__pyx_filename = __pyx_f[0]; __pyx_lineno = 105; __pyx_clineno = __LINE__; goto __pyx_L1_error;}
  if (__pyx_t_1) {

    /* "gssapi/raw/ext_rfc6680.pyx":106
 *     cdef gss_buffer_set_t attr_names = GSS_C_NO_BUFFER_SET
 *     if attrs:
 *         attr_names_ptr = &attr_names             # <<<<<<<<<<<<<<
 * 
 *     cdef int name_is_mn = 0
 */
    __pyx_v_attr_names_ptr = (&__pyx_v_attr_names);
    goto __pyx_L3;
  }
  __pyx_L3:;

  /* "gssapi/raw/ext_rfc6680.pyx":108
 *         attr_names_ptr = &attr_names
 * 
 *     cdef int name_is_mn = 0             # <<<<<<<<<<<<<<
 *     cdef gss_OID mn_mech
 *     if mech_name:
 */
  __pyx_v_name_is_mn = 0;

  /* "gssapi/raw/ext_rfc6680.pyx":110
 *     cdef int name_is_mn = 0
 *     cdef gss_OID mn_mech
 *     if mech_name:             # <<<<<<<<<<<<<<
 *         name_is_mn_ptr = &name_is_mn
 *         mn_mech_ptr = &mn_mech
 */
  __pyx_t_1 = __Pyx_PyObject_IsTrue(__pyx_v_mech_name); if (unlikely(__pyx_t_1 < 0)) {__pyx_filename = __pyx_f[0]; __pyx_lineno = 110; __pyx_clineno = __LINE__; goto __pyx_L1_error;}
  if (__pyx_t_1) {

    /* "gssapi/raw/ext_rfc6680.pyx":111
 *     cdef gss_OID mn_mech
 *     if mech_name:
 *         name_is_mn_ptr = &name_is_mn             # <<<<<<<<<<<<<<
 *         mn_mech_ptr = &mn_mech
 * 
 */
    __pyx_v_name_is_mn_ptr = (&__pyx_v_name_is_mn);

    /* "gssapi/raw/ext_rfc6680.pyx":112
 *     if mech_name:
 *         name_is_mn_ptr = &name_is_mn
 *         mn_mech_ptr = &mn_mech             # <<<<<<<<<<<<<<
 * 
 *     cdef OM_uint32 maj_stat, min_stat
 */
    __pyx_v_mn_mech_ptr = (&__pyx_v_mn_mech);
    goto __pyx_L4;
  }
  __pyx_L4:;

  /* "gssapi/raw/ext_rfc6680.pyx":116
 *     cdef OM_uint32 maj_stat, min_stat
 * 
 *     maj_stat = gss_inquire_name(&min_stat, name.raw_name, name_is_mn_ptr,             # <<<<<<<<<<<<<<
 *                                 mn_mech_ptr, attr_names_ptr)
 * 
 */
  __pyx_v_maj_stat = gss_inquire_name((&__pyx_v_min_stat), __pyx_v_name->raw_name, __pyx_v_name_is_mn_ptr, __pyx_v_mn_mech_ptr, __pyx_v_attr_names_ptr);

  /* "gssapi/raw/ext_rfc6680.pyx":120
 * 
 *     cdef int i
 *     cdef OID py_mech = None             # <<<<<<<<<<<<<<
 *     if maj_stat == GSS_S_COMPLETE:
 *         py_attr_names = []
 */
  __Pyx_INCREF(Py_None);
  __pyx_v_py_mech = ((struct __pyx_obj_6gssapi_3raw_4oids_OID *)Py_None);

  /* "gssapi/raw/ext_rfc6680.pyx":121
 *     cdef int i
 *     cdef OID py_mech = None
 *     if maj_stat == GSS_S_COMPLETE:             # <<<<<<<<<<<<<<
 *         py_attr_names = []
 * 
 */
  __pyx_t_1 = ((__pyx_v_maj_stat == GSS_S_COMPLETE) != 0);
  if (__pyx_t_1) {

    /* "gssapi/raw/ext_rfc6680.pyx":122
 *     cdef OID py_mech = None
 *     if maj_stat == GSS_S_COMPLETE:
 *         py_attr_names = []             # <<<<<<<<<<<<<<
 * 
 *         if attr_names != GSS_C_NO_BUFFER_SET:
 */
    __pyx_t_2 = PyList_New(0); if (unlikely(!__pyx_t_2)) {__pyx_filename = __pyx_f[0]; __pyx_lineno = 122; __pyx_clineno = __LINE__; goto __pyx_L1_error;}
    __Pyx_GOTREF(__pyx_t_2);
    __pyx_v_py_attr_names = ((PyObject*)__pyx_t_2);
    __pyx_t_2 = 0;

    /* "gssapi/raw/ext_rfc6680.pyx":124
 *         py_attr_names = []
 * 
 *         if attr_names != GSS_C_NO_BUFFER_SET:             # <<<<<<<<<<<<<<
 *             for i in range(attr_names.count):
 *                 attr_name = attr_names.elements[i]
 */
    __pyx_t_1 = ((__pyx_v_attr_names != GSS_C_NO_BUFFER_SET) != 0);
    if (__pyx_t_1) {

      /* "gssapi/raw/ext_rfc6680.pyx":125
 * 
 *         if attr_names != GSS_C_NO_BUFFER_SET:
 *             for i in range(attr_names.count):             # <<<<<<<<<<<<<<
 *                 attr_name = attr_names.elements[i]
 *                 py_attr_names.append(attr_name.value[:attr_name.length])
 */
      __pyx_t_3 = __pyx_v_attr_names->count;
      for (__pyx_t_4 = 0; __pyx_t_4 < __pyx_t_3; __pyx_t_4+=1) {
        __pyx_v_i = __pyx_t_4;

        /* "gssapi/raw/ext_rfc6680.pyx":126
 *         if attr_names != GSS_C_NO_BUFFER_SET:
 *             for i in range(attr_names.count):
 *                 attr_name = attr_names.elements[i]             # <<<<<<<<<<<<<<
 *                 py_attr_names.append(attr_name.value[:attr_name.length])
 * 
 */
        __pyx_v_attr_name = (__pyx_v_attr_names->elements[__pyx_v_i]);

        /* "gssapi/raw/ext_rfc6680.pyx":127
 *             for i in range(attr_names.count):
 *                 attr_name = attr_names.elements[i]
 *                 py_attr_names.append(attr_name.value[:attr_name.length])             # <<<<<<<<<<<<<<
 * 
 *             gss_release_buffer_set(&min_stat, &attr_names)
 */
        __pyx_t_2 = __Pyx_PyBytes_FromStringAndSize(__pyx_v_attr_name.value + 0, __pyx_v_attr_name.length - 0); if (unlikely(!__pyx_t_2)) {__pyx_filename = __pyx_f[0]; __pyx_lineno = 127; __pyx_clineno = __LINE__; goto __pyx_L1_error;}
        __Pyx_GOTREF(__pyx_t_2);
        __pyx_t_5 = __Pyx_PyList_Append(__pyx_v_py_attr_names, __pyx_t_2); if (unlikely(__pyx_t_5 == -1)) {__pyx_filename = __pyx_f[0]; __pyx_lineno = 127; __pyx_clineno = __LINE__; goto __pyx_L1_error;}
        __Pyx_DECREF(__pyx_t_2); __pyx_t_2 = 0;
      }

      /* "gssapi/raw/ext_rfc6680.pyx":129
 *                 py_attr_names.append(attr_name.value[:attr_name.length])
 * 
 *             gss_release_buffer_set(&min_stat, &attr_names)             # <<<<<<<<<<<<<<
 * 
 *         if name_is_mn:
 */
      gss_release_buffer_set((&__pyx_v_min_stat), (&__pyx_v_attr_names));
      goto __pyx_L6;
    }
    __pyx_L6:;

    /* "gssapi/raw/ext_rfc6680.pyx":131
 *             gss_release_buffer_set(&min_stat, &attr_names)
 * 
 *         if name_is_mn:             # <<<<<<<<<<<<<<
 *             py_mech = OID()
 *             py_mech.raw_oid = mn_mech[0]
 */
    __pyx_t_1 = (__pyx_v_name_is_mn != 0);
    if (__pyx_t_1) {

      /* "gssapi/raw/ext_rfc6680.pyx":132
 * 
 *         if name_is_mn:
 *             py_mech = OID()             # <<<<<<<<<<<<<<
 *             py_mech.raw_oid = mn_mech[0]
 * 
 */
      __pyx_t_2 = __Pyx_PyObject_Call(((PyObject *)((PyObject*)__pyx_ptype_6gssapi_3raw_4oids_OID)), __pyx_empty_tuple, NULL); if (unlikely(!__pyx_t_2)) {__pyx_filename = __pyx_f[0]; __pyx_lineno = 132; __pyx_clineno = __LINE__; goto __pyx_L1_error;}
      __Pyx_GOTREF(__pyx_t_2);
      __Pyx_DECREF_SET(__pyx_v_py_mech, ((struct __pyx_obj_6gssapi_3raw_4oids_OID *)__pyx_t_2));
      __pyx_t_2 = 0;

      /* "gssapi/raw/ext_rfc6680.pyx":133
 *         if name_is_mn:
 *             py_mech = OID()
 *             py_mech.raw_oid = mn_mech[0]             # <<<<<<<<<<<<<<
 * 
 *         return InquireNameResult(py_attr_names, <bint>name_is_mn, py_mech)
 */
      __pyx_v_py_mech->raw_oid = (__pyx_v_mn_mech[0]);
      goto __pyx_L9;
    }
    __pyx_L9:;

    /* "gssapi/raw/ext_rfc6680.pyx":135
 *             py_mech.raw_oid = mn_mech[0]
 * 
 *         return InquireNameResult(py_attr_names, <bint>name_is_mn, py_mech)             # <<<<<<<<<<<<<<
 *     else:
 *         raise GSSError(maj_stat, min_stat)
 */
    __Pyx_XDECREF(__pyx_r);
    __pyx_t_6 = __Pyx_GetModuleGlobalName(__pyx_n_s_InquireNameResult); if (unlikely(!__pyx_t_6)) {__pyx_filename = __pyx_f[0]; __pyx_lineno = 135; __pyx_clineno = __LINE__; goto __pyx_L1_error;}
    __Pyx_GOTREF(__pyx_t_6);
    __pyx_t_7 = __Pyx_PyBool_FromLong((__pyx_v_name_is_mn != 0)); if (unlikely(!__pyx_t_7)) {__pyx_filename = __pyx_f[0]; __pyx_lineno = 135; __pyx_clineno = __LINE__; goto __pyx_L1_error;}
    __Pyx_GOTREF(__pyx_t_7);
    __pyx_t_8 = NULL;
    __pyx_t_9 = 0;
    if (CYTHON_COMPILING_IN_CPYTHON && unlikely(PyMethod_Check(__pyx_t_6))) {
      __pyx_t_8 = PyMethod_GET_SELF(__pyx_t_6);
      if (likely(__pyx_t_8)) {
        PyObject* function = PyMethod_GET_FUNCTION(__pyx_t_6);
        __Pyx_INCREF(__pyx_t_8);
        __Pyx_INCREF(function);
        __Pyx_DECREF_SET(__pyx_t_6, function);
        __pyx_t_9 = 1;
      }
    }
    __pyx_t_10 = PyTuple_New(3+__pyx_t_9); if (unlikely(!__pyx_t_10)) {__pyx_filename = __pyx_f[0]; __pyx_lineno = 135; __pyx_clineno = __LINE__; goto __pyx_L1_error;}
    __Pyx_GOTREF(__pyx_t_10);
    if (__pyx_t_8) {
      PyTuple_SET_ITEM(__pyx_t_10, 0, __pyx_t_8); __Pyx_GIVEREF(__pyx_t_8); __pyx_t_8 = NULL;
    }
    __Pyx_INCREF(__pyx_v_py_attr_names);
    PyTuple_SET_ITEM(__pyx_t_10, 0+__pyx_t_9, __pyx_v_py_attr_names);
    __Pyx_GIVEREF(__pyx_v_py_attr_names);
    PyTuple_SET_ITEM(__pyx_t_10, 1+__pyx_t_9, __pyx_t_7);
    __Pyx_GIVEREF(__pyx_t_7);
    __Pyx_INCREF(((PyObject *)__pyx_v_py_mech));
    PyTuple_SET_ITEM(__pyx_t_10, 2+__pyx_t_9, ((PyObject *)__pyx_v_py_mech));
    __Pyx_GIVEREF(((PyObject *)__pyx_v_py_mech));
    __pyx_t_7 = 0;
    __pyx_t_2 = __Pyx_PyObject_Call(__pyx_t_6, __pyx_t_10, NULL); if (unlikely(!__pyx_t_2)) {__pyx_filename = __pyx_f[0]; __pyx_lineno = 135; __pyx_clineno = __LINE__; goto __pyx_L1_error;}
    __Pyx_GOTREF(__pyx_t_2);
    __Pyx_DECREF(__pyx_t_10); __pyx_t_10 = 0;
    __Pyx_DECREF(__pyx_t_6); __pyx_t_6 = 0;
    __pyx_r = __pyx_t_2;
    __pyx_t_2 = 0;
    goto __pyx_L0;
  }
  /*else*/ {

    /* "gssapi/raw/ext_rfc6680.pyx":137
 *         return InquireNameResult(py_attr_names, <bint>name_is_mn, py_mech)
 *     else:
 *         raise GSSError(maj_stat, min_stat)             # <<<<<<<<<<<<<<
 * 
 * 
 */
    __pyx_t_6 = __Pyx_GetModuleGlobalName(__pyx_n_s_GSSError); if (unlikely(!__pyx_t_6)) {__pyx_filename = __pyx_f[0]; __pyx_lineno = 137; __pyx_clineno = __LINE__; goto __pyx_L1_error;}
    __Pyx_GOTREF(__pyx_t_6);
    __pyx_t_10 = __Pyx_PyInt_From_uint32_t(__pyx_v_maj_stat); if (unlikely(!__pyx_t_10)) {__pyx_filename = __pyx_f[0]; __pyx_lineno = 137; __pyx_clineno = __LINE__; goto __pyx_L1_error;}
    __Pyx_GOTREF(__pyx_t_10);
    __pyx_t_7 = __Pyx_PyInt_From_uint32_t(__pyx_v_min_stat); if (unlikely(!__pyx_t_7)) {__pyx_filename = __pyx_f[0]; __pyx_lineno = 137; __pyx_clineno = __LINE__; goto __pyx_L1_error;}
    __Pyx_GOTREF(__pyx_t_7);
    __pyx_t_8 = NULL;
    __pyx_t_9 = 0;
    if (CYTHON_COMPILING_IN_CPYTHON && unlikely(PyMethod_Check(__pyx_t_6))) {
      __pyx_t_8 = PyMethod_GET_SELF(__pyx_t_6);
      if (likely(__pyx_t_8)) {
        PyObject* function = PyMethod_GET_FUNCTION(__pyx_t_6);
        __Pyx_INCREF(__pyx_t_8);
        __Pyx_INCREF(function);
        __Pyx_DECREF_SET(__pyx_t_6, function);
        __pyx_t_9 = 1;
      }
    }
    __pyx_t_11 = PyTuple_New(2+__pyx_t_9); if (unlikely(!__pyx_t_11)) {__pyx_filename = __pyx_f[0]; __pyx_lineno = 137; __pyx_clineno = __LINE__; goto __pyx_L1_error;}
    __Pyx_GOTREF(__pyx_t_11);
    if (__pyx_t_8) {
      PyTuple_SET_ITEM(__pyx_t_11, 0, __pyx_t_8); __Pyx_GIVEREF(__pyx_t_8); __pyx_t_8 = NULL;
    }
    PyTuple_SET_ITEM(__pyx_t_11, 0+__pyx_t_9, __pyx_t_10);
    __Pyx_GIVEREF(__pyx_t_10);
    PyTuple_SET_ITEM(__pyx_t_11, 1+__pyx_t_9, __pyx_t_7);
    __Pyx_GIVEREF(__pyx_t_7);
    __pyx_t_10 = 0;
    __pyx_t_7 = 0;
    __pyx_t_2 = __Pyx_PyObject_Call(__pyx_t_6, __pyx_t_11, NULL); if (unlikely(!__pyx_t_2)) {__pyx_filename = __pyx_f[0]; __pyx_lineno = 137; __pyx_clineno = __LINE__; goto __pyx_L1_error;}
    __Pyx_GOTREF(__pyx_t_2);
    __Pyx_DECREF(__pyx_t_11); __pyx_t_11 = 0;
    __Pyx_DECREF(__pyx_t_6); __pyx_t_6 = 0;
    __Pyx_Raise(__pyx_t_2, 0, 0, 0);
    __Pyx_DECREF(__pyx_t_2); __pyx_t_2 = 0;
    {__pyx_filename = __pyx_f[0]; __pyx_lineno = 137; __pyx_clineno = __LINE__; goto __pyx_L1_error;}
  }

  /* "gssapi/raw/ext_rfc6680.pyx":76
 * 
 * 
 * def inquire_name(Name name not None, mech_name=True, attrs=True):             # <<<<<<<<<<<<<<
 *     """
 *     Get information about a Name
 */

  /* function exit code */
  __pyx_L1_error:;
  __Pyx_XDECREF(__pyx_t_2);
  __Pyx_XDECREF(__pyx_t_6);
  __Pyx_XDECREF(__pyx_t_7);
  __Pyx_XDECREF(__pyx_t_8);
  __Pyx_XDECREF(__pyx_t_10);
  __Pyx_XDECREF(__pyx_t_11);
  __Pyx_AddTraceback("gssapi.raw.ext_rfc6680.inquire_name", __pyx_clineno, __pyx_lineno, __pyx_filename);
  __pyx_r = NULL;
  __pyx_L0:;
  __Pyx_XDECREF((PyObject *)__pyx_v_py_mech);
  __Pyx_XDECREF(__pyx_v_py_attr_names);
  __Pyx_XGIVEREF(__pyx_r);
  __Pyx_RefNannyFinishContext();
  return __pyx_r;
}

/* "gssapi/raw/ext_rfc6680.pyx":140
 * 
 * 
 * def set_name_attribute(Name name not None, attr not None, value not None,             # <<<<<<<<<<<<<<
 *                        bint complete=False):
 *     """
 */

/* Python wrapper */
static PyObject *__pyx_pw_6gssapi_3raw_11ext_rfc6680_5set_name_attribute(PyObject *__pyx_self, PyObject *__pyx_args, PyObject *__pyx_kwds); /*proto*/
static char __pyx_doc_6gssapi_3raw_11ext_rfc6680_4set_name_attribute[] = "\n    Set the value(s) of a Name attribute\n\n    This method sets the value(s) of the given attribute on the given name.\n\n    Note that this functionality more closely matches the pseudo-API\n    presented in RFC 6680, not the C API (which uses multiple calls to\n    add multiple values).  However, multiple calls to this method will\n    continue adding values, so :func:`delete_name_attribute` must be\n    used in between calls to \"clear\" the values.\n\n    Args:\n        name (Name): the Name on which to set the attribute\n        attr (bytes): the name of the attribute\n        value (list): a list of bytes objects to use as the value(s)\n        complete (bool): whether or not to mark this attribute's value\n            set as being \"complete\"\n\n    Raises:\n        OperationUnavailableError: the given attribute name is unknown\n            or could not be set\n    ";
static PyMethodDef __pyx_mdef_6gssapi_3raw_11ext_rfc6680_5set_name_attribute = {"set_name_attribute", (PyCFunction)__pyx_pw_6gssapi_3raw_11ext_rfc6680_5set_name_attribute, METH_VARARGS|METH_KEYWORDS, __pyx_doc_6gssapi_3raw_11ext_rfc6680_4set_name_attribute};
static PyObject *__pyx_pw_6gssapi_3raw_11ext_rfc6680_5set_name_attribute(PyObject *__pyx_self, PyObject *__pyx_args, PyObject *__pyx_kwds) {
  struct __pyx_obj_6gssapi_3raw_5names_Name *__pyx_v_name = 0;
  PyObject *__pyx_v_attr = 0;
  PyObject *__pyx_v_value = 0;
  int __pyx_v_complete;
  int __pyx_lineno = 0;
  const char *__pyx_filename = NULL;
  int __pyx_clineno = 0;
  PyObject *__pyx_r = 0;
  __Pyx_RefNannyDeclarations
  __Pyx_RefNannySetupContext("set_name_attribute (wrapper)", 0);
  {
    static PyObject **__pyx_pyargnames[] = {&__pyx_n_s_name,&__pyx_n_s_attr,&__pyx_n_s_value,&__pyx_n_s_complete,0};
    PyObject* values[4] = {0,0,0,0};
    if (unlikely(__pyx_kwds)) {
      Py_ssize_t kw_args;
      const Py_ssize_t pos_args = PyTuple_GET_SIZE(__pyx_args);
      switch (pos_args) {
        case  4: values[3] = PyTuple_GET_ITEM(__pyx_args, 3);
        case  3: values[2] = PyTuple_GET_ITEM(__pyx_args, 2);
        case  2: values[1] = PyTuple_GET_ITEM(__pyx_args, 1);
        case  1: values[0] = PyTuple_GET_ITEM(__pyx_args, 0);
        case  0: break;
        default: goto __pyx_L5_argtuple_error;
      }
      kw_args = PyDict_Size(__pyx_kwds);
      switch (pos_args) {
        case  0:
        if (likely((values[0] = PyDict_GetItem(__pyx_kwds, __pyx_n_s_name)) != 0)) kw_args--;
        else goto __pyx_L5_argtuple_error;
        case  1:
        if (likely((values[1] = PyDict_GetItem(__pyx_kwds, __pyx_n_s_attr)) != 0)) kw_args--;
        else {
          __Pyx_RaiseArgtupleInvalid("set_name_attribute", 0, 3, 4, 1); {__pyx_filename = __pyx_f[0]; __pyx_lineno = 140; __pyx_clineno = __LINE__; goto __pyx_L3_error;}
        }
        case  2:
        if (likely((values[2] = PyDict_GetItem(__pyx_kwds, __pyx_n_s_value)) != 0)) kw_args--;
        else {
          __Pyx_RaiseArgtupleInvalid("set_name_attribute", 0, 3, 4, 2); {__pyx_filename = __pyx_f[0]; __pyx_lineno = 140; __pyx_clineno = __LINE__; goto __pyx_L3_error;}
        }
        case  3:
        if (kw_args > 0) {
          PyObject* value = PyDict_GetItem(__pyx_kwds, __pyx_n_s_complete);
          if (value) { values[3] = value; kw_args--; }
        }
      }
      if (unlikely(kw_args > 0)) {
        if (unlikely(__Pyx_ParseOptionalKeywords(__pyx_kwds, __pyx_pyargnames, 0, values, pos_args, "set_name_attribute") < 0)) {__pyx_filename = __pyx_f[0]; __pyx_lineno = 140; __pyx_clineno = __LINE__; goto __pyx_L3_error;}
      }
    } else {
      switch (PyTuple_GET_SIZE(__pyx_args)) {
        case  4: values[3] = PyTuple_GET_ITEM(__pyx_args, 3);
        case  3: values[2] = PyTuple_GET_ITEM(__pyx_args, 2);
        values[1] = PyTuple_GET_ITEM(__pyx_args, 1);
        values[0] = PyTuple_GET_ITEM(__pyx_args, 0);
        break;
        default: goto __pyx_L5_argtuple_error;
      }
    }
    __pyx_v_name = ((struct __pyx_obj_6gssapi_3raw_5names_Name *)values[0]);
    __pyx_v_attr = values[1];
    __pyx_v_value = values[2];
    if (values[3]) {
      __pyx_v_complete = __Pyx_PyObject_IsTrue(values[3]); if (unlikely((__pyx_v_complete == (int)-1) && PyErr_Occurred())) {__pyx_filename = __pyx_f[0]; __pyx_lineno = 141; __pyx_clineno = __LINE__; goto __pyx_L3_error;}
    } else {

      /* "gssapi/raw/ext_rfc6680.pyx":141
 * 
 * def set_name_attribute(Name name not None, attr not None, value not None,
 *                        bint complete=False):             # <<<<<<<<<<<<<<
 *     """
 *     Set the value(s) of a Name attribute
 */
      __pyx_v_complete = ((int)0);
    }
  }
  goto __pyx_L4_argument_unpacking_done;
  __pyx_L5_argtuple_error:;
  __Pyx_RaiseArgtupleInvalid("set_name_attribute", 0, 3, 4, PyTuple_GET_SIZE(__pyx_args)); {__pyx_filename = __pyx_f[0]; __pyx_lineno = 140; __pyx_clineno = __LINE__; goto __pyx_L3_error;}
  __pyx_L3_error:;
  __Pyx_AddTraceback("gssapi.raw.ext_rfc6680.set_name_attribute", __pyx_clineno, __pyx_lineno, __pyx_filename);
  __Pyx_RefNannyFinishContext();
  return NULL;
  __pyx_L4_argument_unpacking_done:;
  if (unlikely(!__Pyx_ArgTypeTest(((PyObject *)__pyx_v_name), __pyx_ptype_6gssapi_3raw_5names_Name, 0, "name", 0))) {__pyx_filename = __pyx_f[0]; __pyx_lineno = 140; __pyx_clineno = __LINE__; goto __pyx_L1_error;}
  if (unlikely(((PyObject *)__pyx_v_attr) == Py_None)) {
    PyErr_Format(PyExc_TypeError, "Argument '%.200s' must not be None", "attr"); {__pyx_filename = __pyx_f[0]; __pyx_lineno = 140; __pyx_clineno = __LINE__; goto __pyx_L1_error;}
  }
  if (unlikely(((PyObject *)__pyx_v_value) == Py_None)) {
    PyErr_Format(PyExc_TypeError, "Argument '%.200s' must not be None", "value"); {__pyx_filename = __pyx_f[0]; __pyx_lineno = 140; __pyx_clineno = __LINE__; goto __pyx_L1_error;}
  }
  __pyx_r = __pyx_pf_6gssapi_3raw_11ext_rfc6680_4set_name_attribute(__pyx_self, __pyx_v_name, __pyx_v_attr, __pyx_v_value, __pyx_v_complete);

  /* "gssapi/raw/ext_rfc6680.pyx":140
 * 
 * 
 * def set_name_attribute(Name name not None, attr not None, value not None,             # <<<<<<<<<<<<<<
 *                        bint complete=False):
 *     """
 */

  /* function exit code */
  goto __pyx_L0;
  __pyx_L1_error:;
  __pyx_r = NULL;
  __pyx_L0:;
  __Pyx_RefNannyFinishContext();
  return __pyx_r;
}

static PyObject *__pyx_pf_6gssapi_3raw_11ext_rfc6680_4set_name_attribute(CYTHON_UNUSED PyObject *__pyx_self, struct __pyx_obj_6gssapi_3raw_5names_Name *__pyx_v_name, PyObject *__pyx_v_attr, PyObject *__pyx_v_value, int __pyx_v_complete) {
  gss_buffer_desc __pyx_v_attr_buff;
  gss_buffer_desc __pyx_v_val_buff;
  OM_uint32 __pyx_v_maj_stat;
  OM_uint32 __pyx_v_min_stat;
  size_t __pyx_v_value_len;
  size_t __pyx_v_i;
  PyObject *__pyx_v_val = NULL;
  PyObject *__pyx_r = NULL;
  __Pyx_RefNannyDeclarations
  gss_buffer_desc __pyx_t_1;
  Py_ssize_t __pyx_t_2;
  char *__pyx_t_3;
  PyObject *__pyx_t_4 = NULL;
  PyObject *(*__pyx_t_5)(PyObject *);
  PyObject *__pyx_t_6 = NULL;
  Py_ssize_t __pyx_t_7;
  int __pyx_t_8;
  PyObject *__pyx_t_9 = NULL;
  PyObject *__pyx_t_10 = NULL;
  PyObject *__pyx_t_11 = NULL;
  PyObject *__pyx_t_12 = NULL;
  PyObject *__pyx_t_13 = NULL;
  int __pyx_lineno = 0;
  const char *__pyx_filename = NULL;
  int __pyx_clineno = 0;
  __Pyx_RefNannySetupContext("set_name_attribute", 0);

  /* "gssapi/raw/ext_rfc6680.pyx":165
 *     """
 * 
 *     cdef gss_buffer_desc attr_buff = gss_buffer_desc(len(attr), attr)             # <<<<<<<<<<<<<<
 *     cdef gss_buffer_desc val_buff
 * 
 */
  __pyx_t_2 = PyObject_Length(__pyx_v_attr); if (unlikely(__pyx_t_2 == -1)) {__pyx_filename = __pyx_f[0]; __pyx_lineno = 165; __pyx_clineno = __LINE__; goto __pyx_L1_error;}
  __pyx_t_1.length = __pyx_t_2;
  __pyx_t_3 = __Pyx_PyObject_AsString(__pyx_v_attr); if (unlikely((!__pyx_t_3) && PyErr_Occurred())) {__pyx_filename = __pyx_f[0]; __pyx_lineno = 165; __pyx_clineno = __LINE__; goto __pyx_L1_error;}
  __pyx_t_1.value = __pyx_t_3;
  __pyx_v_attr_buff = __pyx_t_1;

  /* "gssapi/raw/ext_rfc6680.pyx":170
 *     cdef OM_uint32 maj_stat, min_stat
 * 
 *     cdef size_t value_len = len(value)             # <<<<<<<<<<<<<<
 *     cdef size_t i
 *     for val in value:
 */
  __pyx_t_2 = PyObject_Length(__pyx_v_value); if (unlikely(__pyx_t_2 == -1)) {__pyx_filename = __pyx_f[0]; __pyx_lineno = 170; __pyx_clineno = __LINE__; goto __pyx_L1_error;}
  __pyx_v_value_len = __pyx_t_2;

  /* "gssapi/raw/ext_rfc6680.pyx":172
 *     cdef size_t value_len = len(value)
 *     cdef size_t i
 *     for val in value:             # <<<<<<<<<<<<<<
 *         val_buff = gss_buffer_desc(len(val), val)
 *         i += 1
 */
  if (likely(PyList_CheckExact(__pyx_v_value)) || PyTuple_CheckExact(__pyx_v_value)) {
    __pyx_t_4 = __pyx_v_value; __Pyx_INCREF(__pyx_t_4); __pyx_t_2 = 0;
    __pyx_t_5 = NULL;
  } else {
    __pyx_t_2 = -1; __pyx_t_4 = PyObject_GetIter(__pyx_v_value); if (unlikely(!__pyx_t_4)) {__pyx_filename = __pyx_f[0]; __pyx_lineno = 172; __pyx_clineno = __LINE__; goto __pyx_L1_error;}
    __Pyx_GOTREF(__pyx_t_4);
    __pyx_t_5 = Py_TYPE(__pyx_t_4)->tp_iternext; if (unlikely(!__pyx_t_5)) {__pyx_filename = __pyx_f[0]; __pyx_lineno = 172; __pyx_clineno = __LINE__; goto __pyx_L1_error;}
  }
  for (;;) {
    if (likely(!__pyx_t_5)) {
      if (likely(PyList_CheckExact(__pyx_t_4))) {
        if (__pyx_t_2 >= PyList_GET_SIZE(__pyx_t_4)) break;
        #if CYTHON_COMPILING_IN_CPYTHON
        __pyx_t_6 = PyList_GET_ITEM(__pyx_t_4, __pyx_t_2); __Pyx_INCREF(__pyx_t_6); __pyx_t_2++; if (unlikely(0 < 0)) {__pyx_filename = __pyx_f[0]; __pyx_lineno = 172; __pyx_clineno = __LINE__; goto __pyx_L1_error;}
        #else
        __pyx_t_6 = PySequence_ITEM(__pyx_t_4, __pyx_t_2); __pyx_t_2++; if (unlikely(!__pyx_t_6)) {__pyx_filename = __pyx_f[0]; __pyx_lineno = 172; __pyx_clineno = __LINE__; goto __pyx_L1_error;}
        #endif
      } else {
        if (__pyx_t_2 >= PyTuple_GET_SIZE(__pyx_t_4)) break;
        #if CYTHON_COMPILING_IN_CPYTHON
        __pyx_t_6 = PyTuple_GET_ITEM(__pyx_t_4, __pyx_t_2); __Pyx_INCREF(__pyx_t_6); __pyx_t_2++; if (unlikely(0 < 0)) {__pyx_filename = __pyx_f[0]; __pyx_lineno = 172; __pyx_clineno = __LINE__; goto __pyx_L1_error;}
        #else
        __pyx_t_6 = PySequence_ITEM(__pyx_t_4, __pyx_t_2); __pyx_t_2++; if (unlikely(!__pyx_t_6)) {__pyx_filename = __pyx_f[0]; __pyx_lineno = 172; __pyx_clineno = __LINE__; goto __pyx_L1_error;}
        #endif
      }
    } else {
      __pyx_t_6 = __pyx_t_5(__pyx_t_4);
      if (unlikely(!__pyx_t_6)) {
        PyObject* exc_type = PyErr_Occurred();
        if (exc_type) {
          if (likely(exc_type == PyExc_StopIteration || PyErr_GivenExceptionMatches(exc_type, PyExc_StopIteration))) PyErr_Clear();
          else {__pyx_filename = __pyx_f[0]; __pyx_lineno = 172; __pyx_clineno = __LINE__; goto __pyx_L1_error;}
        }
        break;
      }
      __Pyx_GOTREF(__pyx_t_6);
    }
    __Pyx_XDECREF_SET(__pyx_v_val, __pyx_t_6);
    __pyx_t_6 = 0;

    /* "gssapi/raw/ext_rfc6680.pyx":173
 *     cdef size_t i
 *     for val in value:
 *         val_buff = gss_buffer_desc(len(val), val)             # <<<<<<<<<<<<<<
 *         i += 1
 *         if i == value_len:
 */
    __pyx_t_7 = PyObject_Length(__pyx_v_val); if (unlikely(__pyx_t_7 == -1)) {__pyx_filename = __pyx_f[0]; __pyx_lineno = 173; __pyx_clineno = __LINE__; goto __pyx_L1_error;}
    __pyx_t_1.length = __pyx_t_7;
    __pyx_t_3 = __Pyx_PyObject_AsString(__pyx_v_val); if (unlikely((!__pyx_t_3) && PyErr_Occurred())) {__pyx_filename = __pyx_f[0]; __pyx_lineno = 173; __pyx_clineno = __LINE__; goto __pyx_L1_error;}
    __pyx_t_1.value = __pyx_t_3;
    __pyx_v_val_buff = __pyx_t_1;

    /* "gssapi/raw/ext_rfc6680.pyx":174
 *     for val in value:
 *         val_buff = gss_buffer_desc(len(val), val)
 *         i += 1             # <<<<<<<<<<<<<<
 *         if i == value_len:
 *             maj_stat = gss_set_name_attribute(&min_stat, name.raw_name,
 */
    __pyx_v_i = (__pyx_v_i + 1);

    /* "gssapi/raw/ext_rfc6680.pyx":175
 *         val_buff = gss_buffer_desc(len(val), val)
 *         i += 1
 *         if i == value_len:             # <<<<<<<<<<<<<<
 *             maj_stat = gss_set_name_attribute(&min_stat, name.raw_name,
 *                                               complete, &attr_buff, &val_buff)
 */
    __pyx_t_8 = ((__pyx_v_i == __pyx_v_value_len) != 0);
    if (__pyx_t_8) {

      /* "gssapi/raw/ext_rfc6680.pyx":176
 *         i += 1
 *         if i == value_len:
 *             maj_stat = gss_set_name_attribute(&min_stat, name.raw_name,             # <<<<<<<<<<<<<<
 *                                               complete, &attr_buff, &val_buff)
 *         else:
 */
      __pyx_v_maj_stat = gss_set_name_attribute((&__pyx_v_min_stat), __pyx_v_name->raw_name, __pyx_v_complete, (&__pyx_v_attr_buff), (&__pyx_v_val_buff));
      goto __pyx_L5;
    }
    /*else*/ {

      /* "gssapi/raw/ext_rfc6680.pyx":179
 *                                               complete, &attr_buff, &val_buff)
 *         else:
 *             maj_stat = gss_set_name_attribute(&min_stat, name.raw_name, 0,             # <<<<<<<<<<<<<<
 *                                               &attr_buff, &val_buff)
 * 
 */
      __pyx_v_maj_stat = gss_set_name_attribute((&__pyx_v_min_stat), __pyx_v_name->raw_name, 0, (&__pyx_v_attr_buff), (&__pyx_v_val_buff));
    }
    __pyx_L5:;

    /* "gssapi/raw/ext_rfc6680.pyx":182
 *                                               &attr_buff, &val_buff)
 * 
 *         if maj_stat != GSS_S_COMPLETE:             # <<<<<<<<<<<<<<
 *             raise GSSError(maj_stat, min_stat)
 * 
 */
    __pyx_t_8 = ((__pyx_v_maj_stat != GSS_S_COMPLETE) != 0);
    if (__pyx_t_8) {

      /* "gssapi/raw/ext_rfc6680.pyx":183
 * 
 *         if maj_stat != GSS_S_COMPLETE:
 *             raise GSSError(maj_stat, min_stat)             # <<<<<<<<<<<<<<
 * 
 * 
 */
      __pyx_t_9 = __Pyx_GetModuleGlobalName(__pyx_n_s_GSSError); if (unlikely(!__pyx_t_9)) {__pyx_filename = __pyx_f[0]; __pyx_lineno = 183; __pyx_clineno = __LINE__; goto __pyx_L1_error;}
      __Pyx_GOTREF(__pyx_t_9);
      __pyx_t_10 = __Pyx_PyInt_From_uint32_t(__pyx_v_maj_stat); if (unlikely(!__pyx_t_10)) {__pyx_filename = __pyx_f[0]; __pyx_lineno = 183; __pyx_clineno = __LINE__; goto __pyx_L1_error;}
      __Pyx_GOTREF(__pyx_t_10);
      __pyx_t_11 = __Pyx_PyInt_From_uint32_t(__pyx_v_min_stat); if (unlikely(!__pyx_t_11)) {__pyx_filename = __pyx_f[0]; __pyx_lineno = 183; __pyx_clineno = __LINE__; goto __pyx_L1_error;}
      __Pyx_GOTREF(__pyx_t_11);
      __pyx_t_12 = NULL;
      __pyx_t_7 = 0;
      if (CYTHON_COMPILING_IN_CPYTHON && unlikely(PyMethod_Check(__pyx_t_9))) {
        __pyx_t_12 = PyMethod_GET_SELF(__pyx_t_9);
        if (likely(__pyx_t_12)) {
          PyObject* function = PyMethod_GET_FUNCTION(__pyx_t_9);
          __Pyx_INCREF(__pyx_t_12);
          __Pyx_INCREF(function);
          __Pyx_DECREF_SET(__pyx_t_9, function);
          __pyx_t_7 = 1;
        }
      }
      __pyx_t_13 = PyTuple_New(2+__pyx_t_7); if (unlikely(!__pyx_t_13)) {__pyx_filename = __pyx_f[0]; __pyx_lineno = 183; __pyx_clineno = __LINE__; goto __pyx_L1_error;}
      __Pyx_GOTREF(__pyx_t_13);
      if (__pyx_t_12) {
        PyTuple_SET_ITEM(__pyx_t_13, 0, __pyx_t_12); __Pyx_GIVEREF(__pyx_t_12); __pyx_t_12 = NULL;
      }
      PyTuple_SET_ITEM(__pyx_t_13, 0+__pyx_t_7, __pyx_t_10);
      __Pyx_GIVEREF(__pyx_t_10);
      PyTuple_SET_ITEM(__pyx_t_13, 1+__pyx_t_7, __pyx_t_11);
      __Pyx_GIVEREF(__pyx_t_11);
      __pyx_t_10 = 0;
      __pyx_t_11 = 0;
      __pyx_t_6 = __Pyx_PyObject_Call(__pyx_t_9, __pyx_t_13, NULL); if (unlikely(!__pyx_t_6)) {__pyx_filename = __pyx_f[0]; __pyx_lineno = 183; __pyx_clineno = __LINE__; goto __pyx_L1_error;}
      __Pyx_GOTREF(__pyx_t_6);
      __Pyx_DECREF(__pyx_t_13); __pyx_t_13 = 0;
      __Pyx_DECREF(__pyx_t_9); __pyx_t_9 = 0;
      __Pyx_Raise(__pyx_t_6, 0, 0, 0);
      __Pyx_DECREF(__pyx_t_6); __pyx_t_6 = 0;
      {__pyx_filename = __pyx_f[0]; __pyx_lineno = 183; __pyx_clineno = __LINE__; goto __pyx_L1_error;}
    }

    /* "gssapi/raw/ext_rfc6680.pyx":172
 *     cdef size_t value_len = len(value)
 *     cdef size_t i
 *     for val in value:             # <<<<<<<<<<<<<<
 *         val_buff = gss_buffer_desc(len(val), val)
 *         i += 1
 */
  }
  __Pyx_DECREF(__pyx_t_4); __pyx_t_4 = 0;

  /* "gssapi/raw/ext_rfc6680.pyx":140
 * 
 * 
 * def set_name_attribute(Name name not None, attr not None, value not None,             # <<<<<<<<<<<<<<
 *                        bint complete=False):
 *     """
 */

  /* function exit code */
  __pyx_r = Py_None; __Pyx_INCREF(Py_None);
  goto __pyx_L0;
  __pyx_L1_error:;
  __Pyx_XDECREF(__pyx_t_4);
  __Pyx_XDECREF(__pyx_t_6);
  __Pyx_XDECREF(__pyx_t_9);
  __Pyx_XDECREF(__pyx_t_10);
  __Pyx_XDECREF(__pyx_t_11);
  __Pyx_XDECREF(__pyx_t_12);
  __Pyx_XDECREF(__pyx_t_13);
  __Pyx_AddTraceback("gssapi.raw.ext_rfc6680.set_name_attribute", __pyx_clineno, __pyx_lineno, __pyx_filename);
  __pyx_r = NULL;
  __pyx_L0:;
  __Pyx_XDECREF(__pyx_v_val);
  __Pyx_XGIVEREF(__pyx_r);
  __Pyx_RefNannyFinishContext();
  return __pyx_r;
}

/* "gssapi/raw/ext_rfc6680.pyx":186
 * 
 * 
 * def get_name_attribute(Name name not None, attr not None, more=None):             # <<<<<<<<<<<<<<
 *     """
 *     Get the value(s) of a Name attribute
 */

/* Python wrapper */
static PyObject *__pyx_pw_6gssapi_3raw_11ext_rfc6680_7get_name_attribute(PyObject *__pyx_self, PyObject *__pyx_args, PyObject *__pyx_kwds); /*proto*/
static char __pyx_doc_6gssapi_3raw_11ext_rfc6680_6get_name_attribute[] = "\n    Get the value(s) of a Name attribute\n\n    This method retrieves the value(s) of the given attribute\n    for the given Name.\n\n    Note that this functionality matches pseudo-API presented\n    in RFC 6680, not the C API (which uses a state variable and\n    multiple calls to retrieve multiple values).\n\n    Args:\n        name (Name): the Name from which to get the attribute\n        attr (bytes): the name of the attribute\n\n    Returns:\n        GetNameAttributeResult: the raw version of the value(s),\n            the human-readable version of the value(s), whether\n            or not the attribute was authenticated, and whether or\n            not the attribute's value set was marked as complete\n\n    Raises:\n        OperationUnavailableError: the given attribute is unknown\n            or unset\n    ";
static PyMethodDef __pyx_mdef_6gssapi_3raw_11ext_rfc6680_7get_name_attribute = {"get_name_attribute", (PyCFunction)__pyx_pw_6gssapi_3raw_11ext_rfc6680_7get_name_attribute, METH_VARARGS|METH_KEYWORDS, __pyx_doc_6gssapi_3raw_11ext_rfc6680_6get_name_attribute};
static PyObject *__pyx_pw_6gssapi_3raw_11ext_rfc6680_7get_name_attribute(PyObject *__pyx_self, PyObject *__pyx_args, PyObject *__pyx_kwds) {
  struct __pyx_obj_6gssapi_3raw_5names_Name *__pyx_v_name = 0;
  PyObject *__pyx_v_attr = 0;
  CYTHON_UNUSED PyObject *__pyx_v_more = 0;
  int __pyx_lineno = 0;
  const char *__pyx_filename = NULL;
  int __pyx_clineno = 0;
  PyObject *__pyx_r = 0;
  __Pyx_RefNannyDeclarations
  __Pyx_RefNannySetupContext("get_name_attribute (wrapper)", 0);
  {
    static PyObject **__pyx_pyargnames[] = {&__pyx_n_s_name,&__pyx_n_s_attr,&__pyx_n_s_more,0};
    PyObject* values[3] = {0,0,0};
    values[2] = ((PyObject *)Py_None);
    if (unlikely(__pyx_kwds)) {
      Py_ssize_t kw_args;
      const Py_ssize_t pos_args = PyTuple_GET_SIZE(__pyx_args);
      switch (pos_args) {
        case  3: values[2] = PyTuple_GET_ITEM(__pyx_args, 2);
        case  2: values[1] = PyTuple_GET_ITEM(__pyx_args, 1);
        case  1: values[0] = PyTuple_GET_ITEM(__pyx_args, 0);
        case  0: break;
        default: goto __pyx_L5_argtuple_error;
      }
      kw_args = PyDict_Size(__pyx_kwds);
      switch (pos_args) {
        case  0:
        if (likely((values[0] = PyDict_GetItem(__pyx_kwds, __pyx_n_s_name)) != 0)) kw_args--;
        else goto __pyx_L5_argtuple_error;
        case  1:
        if (likely((values[1] = PyDict_GetItem(__pyx_kwds, __pyx_n_s_attr)) != 0)) kw_args--;
        else {
          __Pyx_RaiseArgtupleInvalid("get_name_attribute", 0, 2, 3, 1); {__pyx_filename = __pyx_f[0]; __pyx_lineno = 186; __pyx_clineno = __LINE__; goto __pyx_L3_error;}
        }
        case  2:
        if (kw_args > 0) {
          PyObject* value = PyDict_GetItem(__pyx_kwds, __pyx_n_s_more);
          if (value) { values[2] = value; kw_args--; }
        }
      }
      if (unlikely(kw_args > 0)) {
        if (unlikely(__Pyx_ParseOptionalKeywords(__pyx_kwds, __pyx_pyargnames, 0, values, pos_args, "get_name_attribute") < 0)) {__pyx_filename = __pyx_f[0]; __pyx_lineno = 186; __pyx_clineno = __LINE__; goto __pyx_L3_error;}
      }
    } else {
      switch (PyTuple_GET_SIZE(__pyx_args)) {
        case  3: values[2] = PyTuple_GET_ITEM(__pyx_args, 2);
        case  2: values[1] = PyTuple_GET_ITEM(__pyx_args, 1);
        values[0] = PyTuple_GET_ITEM(__pyx_args, 0);
        break;
        default: goto __pyx_L5_argtuple_error;
      }
    }
    __pyx_v_name = ((struct __pyx_obj_6gssapi_3raw_5names_Name *)values[0]);
    __pyx_v_attr = values[1];
    __pyx_v_more = values[2];
  }
  goto __pyx_L4_argument_unpacking_done;
  __pyx_L5_argtuple_error:;
  __Pyx_RaiseArgtupleInvalid("get_name_attribute", 0, 2, 3, PyTuple_GET_SIZE(__pyx_args)); {__pyx_filename = __pyx_f[0]; __pyx_lineno = 186; __pyx_clineno = __LINE__; goto __pyx_L3_error;}
  __pyx_L3_error:;
  __Pyx_AddTraceback("gssapi.raw.ext_rfc6680.get_name_attribute", __pyx_clineno, __pyx_lineno, __pyx_filename);
  __Pyx_RefNannyFinishContext();
  return NULL;
  __pyx_L4_argument_unpacking_done:;
  if (unlikely(!__Pyx_ArgTypeTest(((PyObject *)__pyx_v_name), __pyx_ptype_6gssapi_3raw_5names_Name, 0, "name", 0))) {__pyx_filename = __pyx_f[0]; __pyx_lineno = 186; __pyx_clineno = __LINE__; goto __pyx_L1_error;}
  if (unlikely(((PyObject *)__pyx_v_attr) == Py_None)) {
    PyErr_Format(PyExc_TypeError, "Argument '%.200s' must not be None", "attr"); {__pyx_filename = __pyx_f[0]; __pyx_lineno = 186; __pyx_clineno = __LINE__; goto __pyx_L1_error;}
  }
  __pyx_r = __pyx_pf_6gssapi_3raw_11ext_rfc6680_6get_name_attribute(__pyx_self, __pyx_v_name, __pyx_v_attr, __pyx_v_more);

  /* function exit code */
  goto __pyx_L0;
  __pyx_L1_error:;
  __pyx_r = NULL;
  __pyx_L0:;
  __Pyx_RefNannyFinishContext();
  return __pyx_r;
}

static PyObject *__pyx_pf_6gssapi_3raw_11ext_rfc6680_6get_name_attribute(CYTHON_UNUSED PyObject *__pyx_self, struct __pyx_obj_6gssapi_3raw_5names_Name *__pyx_v_name, PyObject *__pyx_v_attr, CYTHON_UNUSED PyObject *__pyx_v_more) {
  gss_buffer_desc __pyx_v_attr_buff;
  gss_buffer_desc __pyx_v_val_buff;
  gss_buffer_desc __pyx_v_displ_val_buff;
  int __pyx_v_complete;
  int __pyx_v_authenticated;
  int __pyx_v_more_val;
  PyObject *__pyx_v_py_vals = NULL;
  PyObject *__pyx_v_py_displ_vals = NULL;
  OM_uint32 __pyx_v_maj_stat;
  OM_uint32 __pyx_v_min_stat;
  PyObject *__pyx_r = NULL;
  __Pyx_RefNannyDeclarations
  gss_buffer_desc __pyx_t_1;
  Py_ssize_t __pyx_t_2;
  char *__pyx_t_3;
  PyObject *__pyx_t_4 = NULL;
  int __pyx_t_5;
  int __pyx_t_6;
  PyObject *__pyx_t_7 = NULL;
  PyObject *__pyx_t_8 = NULL;
  PyObject *__pyx_t_9 = NULL;
  PyObject *__pyx_t_10 = NULL;
  PyObject *__pyx_t_11 = NULL;
  int __pyx_lineno = 0;
  const char *__pyx_filename = NULL;
  int __pyx_clineno = 0;
  __Pyx_RefNannySetupContext("get_name_attribute", 0);

  /* "gssapi/raw/ext_rfc6680.pyx":211
 *             or unset
 *     """
 *     cdef gss_buffer_desc attr_buff = gss_buffer_desc(len(attr), attr)             # <<<<<<<<<<<<<<
 * 
 *     cdef gss_buffer_desc val_buff = gss_buffer_desc(0, NULL)
 */
  __pyx_t_2 = PyObject_Length(__pyx_v_attr); if (unlikely(__pyx_t_2 == -1)) {__pyx_filename = __pyx_f[0]; __pyx_lineno = 211; __pyx_clineno = __LINE__; goto __pyx_L1_error;}
  __pyx_t_1.length = __pyx_t_2;
  __pyx_t_3 = __Pyx_PyObject_AsString(__pyx_v_attr); if (unlikely((!__pyx_t_3) && PyErr_Occurred())) {__pyx_filename = __pyx_f[0]; __pyx_lineno = 211; __pyx_clineno = __LINE__; goto __pyx_L1_error;}
  __pyx_t_1.value = __pyx_t_3;
  __pyx_v_attr_buff = __pyx_t_1;

  /* "gssapi/raw/ext_rfc6680.pyx":213
 *     cdef gss_buffer_desc attr_buff = gss_buffer_desc(len(attr), attr)
 * 
 *     cdef gss_buffer_desc val_buff = gss_buffer_desc(0, NULL)             # <<<<<<<<<<<<<<
 *     cdef gss_buffer_desc displ_val_buff = gss_buffer_desc(0, NULL)
 *     cdef int complete
 */
  __pyx_t_1.length = 0;
  __pyx_t_1.value = NULL;
  __pyx_v_val_buff = __pyx_t_1;

  /* "gssapi/raw/ext_rfc6680.pyx":214
 * 
 *     cdef gss_buffer_desc val_buff = gss_buffer_desc(0, NULL)
 *     cdef gss_buffer_desc displ_val_buff = gss_buffer_desc(0, NULL)             # <<<<<<<<<<<<<<
 *     cdef int complete
 *     cdef int authenticated
 */
  __pyx_t_1.length = 0;
  __pyx_t_1.value = NULL;
  __pyx_v_displ_val_buff = __pyx_t_1;

  /* "gssapi/raw/ext_rfc6680.pyx":218
 *     cdef int authenticated
 * 
 *     cdef int more_val = -1             # <<<<<<<<<<<<<<
 *     py_vals = []
 *     py_displ_vals = []
 */
  __pyx_v_more_val = -1;

  /* "gssapi/raw/ext_rfc6680.pyx":219
 * 
 *     cdef int more_val = -1
 *     py_vals = []             # <<<<<<<<<<<<<<
 *     py_displ_vals = []
 * 
 */
  __pyx_t_4 = PyList_New(0); if (unlikely(!__pyx_t_4)) {__pyx_filename = __pyx_f[0]; __pyx_lineno = 219; __pyx_clineno = __LINE__; goto __pyx_L1_error;}
  __Pyx_GOTREF(__pyx_t_4);
  __pyx_v_py_vals = ((PyObject*)__pyx_t_4);
  __pyx_t_4 = 0;

  /* "gssapi/raw/ext_rfc6680.pyx":220
 *     cdef int more_val = -1
 *     py_vals = []
 *     py_displ_vals = []             # <<<<<<<<<<<<<<
 * 
 *     cdef OM_uint32 maj_stat, min_stat
 */
  __pyx_t_4 = PyList_New(0); if (unlikely(!__pyx_t_4)) {__pyx_filename = __pyx_f[0]; __pyx_lineno = 220; __pyx_clineno = __LINE__; goto __pyx_L1_error;}
  __Pyx_GOTREF(__pyx_t_4);
  __pyx_v_py_displ_vals = ((PyObject*)__pyx_t_4);
  __pyx_t_4 = 0;

  /* "gssapi/raw/ext_rfc6680.pyx":224
 *     cdef OM_uint32 maj_stat, min_stat
 * 
 *     while more_val != 0:             # <<<<<<<<<<<<<<
 *         maj_stat = gss_get_name_attribute(&min_stat, name.raw_name,
 *                                           &attr_buff,
 */
  while (1) {
    __pyx_t_5 = ((__pyx_v_more_val != 0) != 0);
    if (!__pyx_t_5) break;

    /* "gssapi/raw/ext_rfc6680.pyx":225
 * 
 *     while more_val != 0:
 *         maj_stat = gss_get_name_attribute(&min_stat, name.raw_name,             # <<<<<<<<<<<<<<
 *                                           &attr_buff,
 *                                           &authenticated, &complete,
 */
    __pyx_v_maj_stat = gss_get_name_attribute((&__pyx_v_min_stat), __pyx_v_name->raw_name, (&__pyx_v_attr_buff), (&__pyx_v_authenticated), (&__pyx_v_complete), (&__pyx_v_val_buff), (&__pyx_v_displ_val_buff), (&__pyx_v_more_val));

    /* "gssapi/raw/ext_rfc6680.pyx":231
 *                                           &more_val)
 * 
 *         if maj_stat == GSS_S_COMPLETE:             # <<<<<<<<<<<<<<
 *             py_vals.append(val_buff.value[:val_buff.length])
 *             py_displ_vals.append(
 */
    __pyx_t_5 = ((__pyx_v_maj_stat == GSS_S_COMPLETE) != 0);
    if (__pyx_t_5) {

      /* "gssapi/raw/ext_rfc6680.pyx":232
 * 
 *         if maj_stat == GSS_S_COMPLETE:
 *             py_vals.append(val_buff.value[:val_buff.length])             # <<<<<<<<<<<<<<
 *             py_displ_vals.append(
 *                 displ_val_buff.value[:displ_val_buff.length])
 */
      __pyx_t_4 = __Pyx_PyBytes_FromStringAndSize(__pyx_v_val_buff.value + 0, __pyx_v_val_buff.length - 0); if (unlikely(!__pyx_t_4)) {__pyx_filename = __pyx_f[0]; __pyx_lineno = 232; __pyx_clineno = __LINE__; goto __pyx_L1_error;}
      __Pyx_GOTREF(__pyx_t_4);
      __pyx_t_6 = __Pyx_PyList_Append(__pyx_v_py_vals, __pyx_t_4); if (unlikely(__pyx_t_6 == -1)) {__pyx_filename = __pyx_f[0]; __pyx_lineno = 232; __pyx_clineno = __LINE__; goto __pyx_L1_error;}
      __Pyx_DECREF(__pyx_t_4); __pyx_t_4 = 0;

      /* "gssapi/raw/ext_rfc6680.pyx":234
 *             py_vals.append(val_buff.value[:val_buff.length])
 *             py_displ_vals.append(
 *                 displ_val_buff.value[:displ_val_buff.length])             # <<<<<<<<<<<<<<
 * 
 *             gss_release_buffer(&min_stat, &val_buff)
 */
      __pyx_t_4 = __Pyx_PyBytes_FromStringAndSize(__pyx_v_displ_val_buff.value + 0, __pyx_v_displ_val_buff.length - 0); if (unlikely(!__pyx_t_4)) {__pyx_filename = __pyx_f[0]; __pyx_lineno = 234; __pyx_clineno = __LINE__; goto __pyx_L1_error;}
      __Pyx_GOTREF(__pyx_t_4);

      /* "gssapi/raw/ext_rfc6680.pyx":233
 *         if maj_stat == GSS_S_COMPLETE:
 *             py_vals.append(val_buff.value[:val_buff.length])
 *             py_displ_vals.append(             # <<<<<<<<<<<<<<
 *                 displ_val_buff.value[:displ_val_buff.length])
 * 
 */
      __pyx_t_6 = __Pyx_PyList_Append(__pyx_v_py_displ_vals, __pyx_t_4); if (unlikely(__pyx_t_6 == -1)) {__pyx_filename = __pyx_f[0]; __pyx_lineno = 233; __pyx_clineno = __LINE__; goto __pyx_L1_error;}
      __Pyx_DECREF(__pyx_t_4); __pyx_t_4 = 0;

      /* "gssapi/raw/ext_rfc6680.pyx":236
 *                 displ_val_buff.value[:displ_val_buff.length])
 * 
 *             gss_release_buffer(&min_stat, &val_buff)             # <<<<<<<<<<<<<<
 *             gss_release_buffer(&min_stat, &displ_val_buff)
 *         else:
 */
      gss_release_buffer((&__pyx_v_min_stat), (&__pyx_v_val_buff));

      /* "gssapi/raw/ext_rfc6680.pyx":237
 * 
 *             gss_release_buffer(&min_stat, &val_buff)
 *             gss_release_buffer(&min_stat, &displ_val_buff)             # <<<<<<<<<<<<<<
 *         else:
 *             raise GSSError(maj_stat, min_stat)
 */
      gss_release_buffer((&__pyx_v_min_stat), (&__pyx_v_displ_val_buff));
      goto __pyx_L5;
    }
    /*else*/ {

      /* "gssapi/raw/ext_rfc6680.pyx":239
 *             gss_release_buffer(&min_stat, &displ_val_buff)
 *         else:
 *             raise GSSError(maj_stat, min_stat)             # <<<<<<<<<<<<<<
 * 
 *     return GetNameAttributeResult(py_vals, py_displ_vals, <bint>authenticated,
 */
      __pyx_t_7 = __Pyx_GetModuleGlobalName(__pyx_n_s_GSSError); if (unlikely(!__pyx_t_7)) {__pyx_filename = __pyx_f[0]; __pyx_lineno = 239; __pyx_clineno = __LINE__; goto __pyx_L1_error;}
      __Pyx_GOTREF(__pyx_t_7);
      __pyx_t_8 = __Pyx_PyInt_From_uint32_t(__pyx_v_maj_stat); if (unlikely(!__pyx_t_8)) {__pyx_filename = __pyx_f[0]; __pyx_lineno = 239; __pyx_clineno = __LINE__; goto __pyx_L1_error;}
      __Pyx_GOTREF(__pyx_t_8);
      __pyx_t_9 = __Pyx_PyInt_From_uint32_t(__pyx_v_min_stat); if (unlikely(!__pyx_t_9)) {__pyx_filename = __pyx_f[0]; __pyx_lineno = 239; __pyx_clineno = __LINE__; goto __pyx_L1_error;}
      __Pyx_GOTREF(__pyx_t_9);
      __pyx_t_10 = NULL;
      __pyx_t_2 = 0;
      if (CYTHON_COMPILING_IN_CPYTHON && unlikely(PyMethod_Check(__pyx_t_7))) {
        __pyx_t_10 = PyMethod_GET_SELF(__pyx_t_7);
        if (likely(__pyx_t_10)) {
          PyObject* function = PyMethod_GET_FUNCTION(__pyx_t_7);
          __Pyx_INCREF(__pyx_t_10);
          __Pyx_INCREF(function);
          __Pyx_DECREF_SET(__pyx_t_7, function);
          __pyx_t_2 = 1;
        }
      }
      __pyx_t_11 = PyTuple_New(2+__pyx_t_2); if (unlikely(!__pyx_t_11)) {__pyx_filename = __pyx_f[0]; __pyx_lineno = 239; __pyx_clineno = __LINE__; goto __pyx_L1_error;}
      __Pyx_GOTREF(__pyx_t_11);
      if (__pyx_t_10) {
        PyTuple_SET_ITEM(__pyx_t_11, 0, __pyx_t_10); __Pyx_GIVEREF(__pyx_t_10); __pyx_t_10 = NULL;
      }
      PyTuple_SET_ITEM(__pyx_t_11, 0+__pyx_t_2, __pyx_t_8);
      __Pyx_GIVEREF(__pyx_t_8);
      PyTuple_SET_ITEM(__pyx_t_11, 1+__pyx_t_2, __pyx_t_9);
      __Pyx_GIVEREF(__pyx_t_9);
      __pyx_t_8 = 0;
      __pyx_t_9 = 0;
      __pyx_t_4 = __Pyx_PyObject_Call(__pyx_t_7, __pyx_t_11, NULL); if (unlikely(!__pyx_t_4)) {__pyx_filename = __pyx_f[0]; __pyx_lineno = 239; __pyx_clineno = __LINE__; goto __pyx_L1_error;}
      __Pyx_GOTREF(__pyx_t_4);
      __Pyx_DECREF(__pyx_t_11); __pyx_t_11 = 0;
      __Pyx_DECREF(__pyx_t_7); __pyx_t_7 = 0;
      __Pyx_Raise(__pyx_t_4, 0, 0, 0);
      __Pyx_DECREF(__pyx_t_4); __pyx_t_4 = 0;
      {__pyx_filename = __pyx_f[0]; __pyx_lineno = 239; __pyx_clineno = __LINE__; goto __pyx_L1_error;}
    }
    __pyx_L5:;
  }

  /* "gssapi/raw/ext_rfc6680.pyx":241
 *             raise GSSError(maj_stat, min_stat)
 * 
 *     return GetNameAttributeResult(py_vals, py_displ_vals, <bint>authenticated,             # <<<<<<<<<<<<<<
 *                                   <bint>complete)
 * 
 */
  __Pyx_XDECREF(__pyx_r);
  __pyx_t_7 = __Pyx_GetModuleGlobalName(__pyx_n_s_GetNameAttributeResult); if (unlikely(!__pyx_t_7)) {__pyx_filename = __pyx_f[0]; __pyx_lineno = 241; __pyx_clineno = __LINE__; goto __pyx_L1_error;}
  __Pyx_GOTREF(__pyx_t_7);
  __pyx_t_11 = __Pyx_PyBool_FromLong((__pyx_v_authenticated != 0)); if (unlikely(!__pyx_t_11)) {__pyx_filename = __pyx_f[0]; __pyx_lineno = 241; __pyx_clineno = __LINE__; goto __pyx_L1_error;}
  __Pyx_GOTREF(__pyx_t_11);

  /* "gssapi/raw/ext_rfc6680.pyx":242
 * 
 *     return GetNameAttributeResult(py_vals, py_displ_vals, <bint>authenticated,
 *                                   <bint>complete)             # <<<<<<<<<<<<<<
 * 
 * 
 */
  __pyx_t_9 = __Pyx_PyBool_FromLong((__pyx_v_complete != 0)); if (unlikely(!__pyx_t_9)) {__pyx_filename = __pyx_f[0]; __pyx_lineno = 242; __pyx_clineno = __LINE__; goto __pyx_L1_error;}
  __Pyx_GOTREF(__pyx_t_9);
  __pyx_t_8 = NULL;
  __pyx_t_2 = 0;
  if (CYTHON_COMPILING_IN_CPYTHON && unlikely(PyMethod_Check(__pyx_t_7))) {
    __pyx_t_8 = PyMethod_GET_SELF(__pyx_t_7);
    if (likely(__pyx_t_8)) {
      PyObject* function = PyMethod_GET_FUNCTION(__pyx_t_7);
      __Pyx_INCREF(__pyx_t_8);
      __Pyx_INCREF(function);
      __Pyx_DECREF_SET(__pyx_t_7, function);
      __pyx_t_2 = 1;
    }
  }
  __pyx_t_10 = PyTuple_New(4+__pyx_t_2); if (unlikely(!__pyx_t_10)) {__pyx_filename = __pyx_f[0]; __pyx_lineno = 241; __pyx_clineno = __LINE__; goto __pyx_L1_error;}
  __Pyx_GOTREF(__pyx_t_10);
  if (__pyx_t_8) {
    PyTuple_SET_ITEM(__pyx_t_10, 0, __pyx_t_8); __Pyx_GIVEREF(__pyx_t_8); __pyx_t_8 = NULL;
  }
  __Pyx_INCREF(__pyx_v_py_vals);
  PyTuple_SET_ITEM(__pyx_t_10, 0+__pyx_t_2, __pyx_v_py_vals);
  __Pyx_GIVEREF(__pyx_v_py_vals);
  __Pyx_INCREF(__pyx_v_py_displ_vals);
  PyTuple_SET_ITEM(__pyx_t_10, 1+__pyx_t_2, __pyx_v_py_displ_vals);
  __Pyx_GIVEREF(__pyx_v_py_displ_vals);
  PyTuple_SET_ITEM(__pyx_t_10, 2+__pyx_t_2, __pyx_t_11);
  __Pyx_GIVEREF(__pyx_t_11);
  PyTuple_SET_ITEM(__pyx_t_10, 3+__pyx_t_2, __pyx_t_9);
  __Pyx_GIVEREF(__pyx_t_9);
  __pyx_t_11 = 0;
  __pyx_t_9 = 0;
  __pyx_t_4 = __Pyx_PyObject_Call(__pyx_t_7, __pyx_t_10, NULL); if (unlikely(!__pyx_t_4)) {__pyx_filename = __pyx_f[0]; __pyx_lineno = 241; __pyx_clineno = __LINE__; goto __pyx_L1_error;}
  __Pyx_GOTREF(__pyx_t_4);
  __Pyx_DECREF(__pyx_t_10); __pyx_t_10 = 0;
  __Pyx_DECREF(__pyx_t_7); __pyx_t_7 = 0;
  __pyx_r = __pyx_t_4;
  __pyx_t_4 = 0;
  goto __pyx_L0;

  /* "gssapi/raw/ext_rfc6680.pyx":186
 * 
 * 
 * def get_name_attribute(Name name not None, attr not None, more=None):             # <<<<<<<<<<<<<<
 *     """
 *     Get the value(s) of a Name attribute
 */

  /* function exit code */
  __pyx_L1_error:;
  __Pyx_XDECREF(__pyx_t_4);
  __Pyx_XDECREF(__pyx_t_7);
  __Pyx_XDECREF(__pyx_t_8);
  __Pyx_XDECREF(__pyx_t_9);
  __Pyx_XDECREF(__pyx_t_10);
  __Pyx_XDECREF(__pyx_t_11);
  __Pyx_AddTraceback("gssapi.raw.ext_rfc6680.get_name_attribute", __pyx_clineno, __pyx_lineno, __pyx_filename);
  __pyx_r = NULL;
  __pyx_L0:;
  __Pyx_XDECREF(__pyx_v_py_vals);
  __Pyx_XDECREF(__pyx_v_py_displ_vals);
  __Pyx_XGIVEREF(__pyx_r);
  __Pyx_RefNannyFinishContext();
  return __pyx_r;
}

/* "gssapi/raw/ext_rfc6680.pyx":245
 * 
 * 
 * def delete_name_attribute(Name name not None, attr not None):             # <<<<<<<<<<<<<<
 *     """
 *     Remove an attribute from a Name
 */

/* Python wrapper */
static PyObject *__pyx_pw_6gssapi_3raw_11ext_rfc6680_9delete_name_attribute(PyObject *__pyx_self, PyObject *__pyx_args, PyObject *__pyx_kwds); /*proto*/
static char __pyx_doc_6gssapi_3raw_11ext_rfc6680_8delete_name_attribute[] = "\n    Remove an attribute from a Name\n\n    This method removes an attribute from a Name.  This method may be\n    used before :func:`set_name_attribute` clear the values of an attribute\n    before setting a new value (making the latter method work like a 'set'\n    operation instead of an 'add' operation).\n\n    Note that the removal of certain attributes may not be allowed.\n\n    Args:\n        name (Name): the name to remove the attribute from\n        attr (bytes): the name of the attribute\n\n    Raises:\n        OperationUnavailableError\n        UnauthorizedError\n    ";
static PyMethodDef __pyx_mdef_6gssapi_3raw_11ext_rfc6680_9delete_name_attribute = {"delete_name_attribute", (PyCFunction)__pyx_pw_6gssapi_3raw_11ext_rfc6680_9delete_name_attribute, METH_VARARGS|METH_KEYWORDS, __pyx_doc_6gssapi_3raw_11ext_rfc6680_8delete_name_attribute};
static PyObject *__pyx_pw_6gssapi_3raw_11ext_rfc6680_9delete_name_attribute(PyObject *__pyx_self, PyObject *__pyx_args, PyObject *__pyx_kwds) {
  struct __pyx_obj_6gssapi_3raw_5names_Name *__pyx_v_name = 0;
  PyObject *__pyx_v_attr = 0;
  int __pyx_lineno = 0;
  const char *__pyx_filename = NULL;
  int __pyx_clineno = 0;
  PyObject *__pyx_r = 0;
  __Pyx_RefNannyDeclarations
  __Pyx_RefNannySetupContext("delete_name_attribute (wrapper)", 0);
  {
    static PyObject **__pyx_pyargnames[] = {&__pyx_n_s_name,&__pyx_n_s_attr,0};
    PyObject* values[2] = {0,0};
    if (unlikely(__pyx_kwds)) {
      Py_ssize_t kw_args;
      const Py_ssize_t pos_args = PyTuple_GET_SIZE(__pyx_args);
      switch (pos_args) {
        case  2: values[1] = PyTuple_GET_ITEM(__pyx_args, 1);
        case  1: values[0] = PyTuple_GET_ITEM(__pyx_args, 0);
        case  0: break;
        default: goto __pyx_L5_argtuple_error;
      }
      kw_args = PyDict_Size(__pyx_kwds);
      switch (pos_args) {
        case  0:
        if (likely((values[0] = PyDict_GetItem(__pyx_kwds, __pyx_n_s_name)) != 0)) kw_args--;
        else goto __pyx_L5_argtuple_error;
        case  1:
        if (likely((values[1] = PyDict_GetItem(__pyx_kwds, __pyx_n_s_attr)) != 0)) kw_args--;
        else {
          __Pyx_RaiseArgtupleInvalid("delete_name_attribute", 1, 2, 2, 1); {__pyx_filename = __pyx_f[0]; __pyx_lineno = 245; __pyx_clineno = __LINE__; goto __pyx_L3_error;}
        }
      }
      if (unlikely(kw_args > 0)) {
        if (unlikely(__Pyx_ParseOptionalKeywords(__pyx_kwds, __pyx_pyargnames, 0, values, pos_args, "delete_name_attribute") < 0)) {__pyx_filename = __pyx_f[0]; __pyx_lineno = 245; __pyx_clineno = __LINE__; goto __pyx_L3_error;}
      }
    } else if (PyTuple_GET_SIZE(__pyx_args) != 2) {
      goto __pyx_L5_argtuple_error;
    } else {
      values[0] = PyTuple_GET_ITEM(__pyx_args, 0);
      values[1] = PyTuple_GET_ITEM(__pyx_args, 1);
    }
    __pyx_v_name = ((struct __pyx_obj_6gssapi_3raw_5names_Name *)values[0]);
    __pyx_v_attr = values[1];
  }
  goto __pyx_L4_argument_unpacking_done;
  __pyx_L5_argtuple_error:;
  __Pyx_RaiseArgtupleInvalid("delete_name_attribute", 1, 2, 2, PyTuple_GET_SIZE(__pyx_args)); {__pyx_filename = __pyx_f[0]; __pyx_lineno = 245; __pyx_clineno = __LINE__; goto __pyx_L3_error;}
  __pyx_L3_error:;
  __Pyx_AddTraceback("gssapi.raw.ext_rfc6680.delete_name_attribute", __pyx_clineno, __pyx_lineno, __pyx_filename);
  __Pyx_RefNannyFinishContext();
  return NULL;
  __pyx_L4_argument_unpacking_done:;
  if (unlikely(!__Pyx_ArgTypeTest(((PyObject *)__pyx_v_name), __pyx_ptype_6gssapi_3raw_5names_Name, 0, "name", 0))) {__pyx_filename = __pyx_f[0]; __pyx_lineno = 245; __pyx_clineno = __LINE__; goto __pyx_L1_error;}
  if (unlikely(((PyObject *)__pyx_v_attr) == Py_None)) {
    PyErr_Format(PyExc_TypeError, "Argument '%.200s' must not be None", "attr"); {__pyx_filename = __pyx_f[0]; __pyx_lineno = 245; __pyx_clineno = __LINE__; goto __pyx_L1_error;}
  }
  __pyx_r = __pyx_pf_6gssapi_3raw_11ext_rfc6680_8delete_name_attribute(__pyx_self, __pyx_v_name, __pyx_v_attr);

  /* function exit code */
  goto __pyx_L0;
  __pyx_L1_error:;
  __pyx_r = NULL;
  __pyx_L0:;
  __Pyx_RefNannyFinishContext();
  return __pyx_r;
}

static PyObject *__pyx_pf_6gssapi_3raw_11ext_rfc6680_8delete_name_attribute(CYTHON_UNUSED PyObject *__pyx_self, struct __pyx_obj_6gssapi_3raw_5names_Name *__pyx_v_name, PyObject *__pyx_v_attr) {
  gss_buffer_desc __pyx_v_attr_buff;
  OM_uint32 __pyx_v_maj_stat;
  OM_uint32 __pyx_v_min_stat;
  PyObject *__pyx_r = NULL;
  __Pyx_RefNannyDeclarations
  gss_buffer_desc __pyx_t_1;
  Py_ssize_t __pyx_t_2;
  char *__pyx_t_3;
  int __pyx_t_4;
  PyObject *__pyx_t_5 = NULL;
  PyObject *__pyx_t_6 = NULL;
  PyObject *__pyx_t_7 = NULL;
  PyObject *__pyx_t_8 = NULL;
  PyObject *__pyx_t_9 = NULL;
  PyObject *__pyx_t_10 = NULL;
  int __pyx_lineno = 0;
  const char *__pyx_filename = NULL;
  int __pyx_clineno = 0;
  __Pyx_RefNannySetupContext("delete_name_attribute", 0);

  /* "gssapi/raw/ext_rfc6680.pyx":265
 *     """
 * 
 *     cdef gss_buffer_desc attr_buff = gss_buffer_desc(len(attr), attr)             # <<<<<<<<<<<<<<
 * 
 *     cdef OM_uint32 maj_stat, min_stat
 */
  __pyx_t_2 = PyObject_Length(__pyx_v_attr); if (unlikely(__pyx_t_2 == -1)) {__pyx_filename = __pyx_f[0]; __pyx_lineno = 265; __pyx_clineno = __LINE__; goto __pyx_L1_error;}
  __pyx_t_1.length = __pyx_t_2;
  __pyx_t_3 = __Pyx_PyObject_AsString(__pyx_v_attr); if (unlikely((!__pyx_t_3) && PyErr_Occurred())) {__pyx_filename = __pyx_f[0]; __pyx_lineno = 265; __pyx_clineno = __LINE__; goto __pyx_L1_error;}
  __pyx_t_1.value = __pyx_t_3;
  __pyx_v_attr_buff = __pyx_t_1;

  /* "gssapi/raw/ext_rfc6680.pyx":269
 *     cdef OM_uint32 maj_stat, min_stat
 * 
 *     maj_stat = gss_delete_name_attribute(&min_stat, name.raw_name,             # <<<<<<<<<<<<<<
 *                                          &attr_buff)
 * 
 */
  __pyx_v_maj_stat = gss_delete_name_attribute((&__pyx_v_min_stat), __pyx_v_name->raw_name, (&__pyx_v_attr_buff));

  /* "gssapi/raw/ext_rfc6680.pyx":272
 *                                          &attr_buff)
 * 
 *     if maj_stat != GSS_S_COMPLETE:             # <<<<<<<<<<<<<<
 *         raise GSSError(maj_stat, min_stat)
 * 
 */
  __pyx_t_4 = ((__pyx_v_maj_stat != GSS_S_COMPLETE) != 0);
  if (__pyx_t_4) {

    /* "gssapi/raw/ext_rfc6680.pyx":273
 * 
 *     if maj_stat != GSS_S_COMPLETE:
 *         raise GSSError(maj_stat, min_stat)             # <<<<<<<<<<<<<<
 * 
 * 
 */
    __pyx_t_6 = __Pyx_GetModuleGlobalName(__pyx_n_s_GSSError); if (unlikely(!__pyx_t_6)) {__pyx_filename = __pyx_f[0]; __pyx_lineno = 273; __pyx_clineno = __LINE__; goto __pyx_L1_error;}
    __Pyx_GOTREF(__pyx_t_6);
    __pyx_t_7 = __Pyx_PyInt_From_uint32_t(__pyx_v_maj_stat); if (unlikely(!__pyx_t_7)) {__pyx_filename = __pyx_f[0]; __pyx_lineno = 273; __pyx_clineno = __LINE__; goto __pyx_L1_error;}
    __Pyx_GOTREF(__pyx_t_7);
    __pyx_t_8 = __Pyx_PyInt_From_uint32_t(__pyx_v_min_stat); if (unlikely(!__pyx_t_8)) {__pyx_filename = __pyx_f[0]; __pyx_lineno = 273; __pyx_clineno = __LINE__; goto __pyx_L1_error;}
    __Pyx_GOTREF(__pyx_t_8);
    __pyx_t_9 = NULL;
    __pyx_t_2 = 0;
    if (CYTHON_COMPILING_IN_CPYTHON && unlikely(PyMethod_Check(__pyx_t_6))) {
      __pyx_t_9 = PyMethod_GET_SELF(__pyx_t_6);
      if (likely(__pyx_t_9)) {
        PyObject* function = PyMethod_GET_FUNCTION(__pyx_t_6);
        __Pyx_INCREF(__pyx_t_9);
        __Pyx_INCREF(function);
        __Pyx_DECREF_SET(__pyx_t_6, function);
        __pyx_t_2 = 1;
      }
    }
    __pyx_t_10 = PyTuple_New(2+__pyx_t_2); if (unlikely(!__pyx_t_10)) {__pyx_filename = __pyx_f[0]; __pyx_lineno = 273; __pyx_clineno = __LINE__; goto __pyx_L1_error;}
    __Pyx_GOTREF(__pyx_t_10);
    if (__pyx_t_9) {
      PyTuple_SET_ITEM(__pyx_t_10, 0, __pyx_t_9); __Pyx_GIVEREF(__pyx_t_9); __pyx_t_9 = NULL;
    }
    PyTuple_SET_ITEM(__pyx_t_10, 0+__pyx_t_2, __pyx_t_7);
    __Pyx_GIVEREF(__pyx_t_7);
    PyTuple_SET_ITEM(__pyx_t_10, 1+__pyx_t_2, __pyx_t_8);
    __Pyx_GIVEREF(__pyx_t_8);
    __pyx_t_7 = 0;
    __pyx_t_8 = 0;
    __pyx_t_5 = __Pyx_PyObject_Call(__pyx_t_6, __pyx_t_10, NULL); if (unlikely(!__pyx_t_5)) {__pyx_filename = __pyx_f[0]; __pyx_lineno = 273; __pyx_clineno = __LINE__; goto __pyx_L1_error;}
    __Pyx_GOTREF(__pyx_t_5);
    __Pyx_DECREF(__pyx_t_10); __pyx_t_10 = 0;
    __Pyx_DECREF(__pyx_t_6); __pyx_t_6 = 0;
    __Pyx_Raise(__pyx_t_5, 0, 0, 0);
    __Pyx_DECREF(__pyx_t_5); __pyx_t_5 = 0;
    {__pyx_filename = __pyx_f[0]; __pyx_lineno = 273; __pyx_clineno = __LINE__; goto __pyx_L1_error;}
  }

  /* "gssapi/raw/ext_rfc6680.pyx":245
 * 
 * 
 * def delete_name_attribute(Name name not None, attr not None):             # <<<<<<<<<<<<<<
 *     """
 *     Remove an attribute from a Name
 */

  /* function exit code */
  __pyx_r = Py_None; __Pyx_INCREF(Py_None);
  goto __pyx_L0;
  __pyx_L1_error:;
  __Pyx_XDECREF(__pyx_t_5);
  __Pyx_XDECREF(__pyx_t_6);
  __Pyx_XDECREF(__pyx_t_7);
  __Pyx_XDECREF(__pyx_t_8);
  __Pyx_XDECREF(__pyx_t_9);
  __Pyx_XDECREF(__pyx_t_10);
  __Pyx_AddTraceback("gssapi.raw.ext_rfc6680.delete_name_attribute", __pyx_clineno, __pyx_lineno, __pyx_filename);
  __pyx_r = NULL;
  __pyx_L0:;
  __Pyx_XGIVEREF(__pyx_r);
  __Pyx_RefNannyFinishContext();
  return __pyx_r;
}

/* "gssapi/raw/ext_rfc6680.pyx":276
 * 
 * 
 * def export_name_composite(Name name not None):             # <<<<<<<<<<<<<<
 *     """
 *     Export a name, preserving attribute information
 */

/* Python wrapper */
static PyObject *__pyx_pw_6gssapi_3raw_11ext_rfc6680_11export_name_composite(PyObject *__pyx_self, PyObject *__pyx_v_name); /*proto*/
static char __pyx_doc_6gssapi_3raw_11ext_rfc6680_10export_name_composite[] = "\n    Export a name, preserving attribute information\n\n    This method functions similarly to :func:`export_name`, except that\n    it preserves attribute information.  The resulting bytes may be imported\n    using :func:`import_name` with the `NameType.composite_export` name type.\n\n    Args:\n        name (Name): the name to export\n\n    Returns:\n        bytes: the exported composite name\n\n    Raises:\n        GSSError\n    ";
static PyMethodDef __pyx_mdef_6gssapi_3raw_11ext_rfc6680_11export_name_composite = {"export_name_composite", (PyCFunction)__pyx_pw_6gssapi_3raw_11ext_rfc6680_11export_name_composite, METH_O, __pyx_doc_6gssapi_3raw_11ext_rfc6680_10export_name_composite};
static PyObject *__pyx_pw_6gssapi_3raw_11ext_rfc6680_11export_name_composite(PyObject *__pyx_self, PyObject *__pyx_v_name) {
  CYTHON_UNUSED int __pyx_lineno = 0;
  CYTHON_UNUSED const char *__pyx_filename = NULL;
  CYTHON_UNUSED int __pyx_clineno = 0;
  PyObject *__pyx_r = 0;
  __Pyx_RefNannyDeclarations
  __Pyx_RefNannySetupContext("export_name_composite (wrapper)", 0);
  if (unlikely(!__Pyx_ArgTypeTest(((PyObject *)__pyx_v_name), __pyx_ptype_6gssapi_3raw_5names_Name, 0, "name", 0))) {__pyx_filename = __pyx_f[0]; __pyx_lineno = 276; __pyx_clineno = __LINE__; goto __pyx_L1_error;}
  __pyx_r = __pyx_pf_6gssapi_3raw_11ext_rfc6680_10export_name_composite(__pyx_self, ((struct __pyx_obj_6gssapi_3raw_5names_Name *)__pyx_v_name));

  /* function exit code */
  goto __pyx_L0;
  __pyx_L1_error:;
  __pyx_r = NULL;
  __pyx_L0:;
  __Pyx_RefNannyFinishContext();
  return __pyx_r;
}

static PyObject *__pyx_pf_6gssapi_3raw_11ext_rfc6680_10export_name_composite(CYTHON_UNUSED PyObject *__pyx_self, struct __pyx_obj_6gssapi_3raw_5names_Name *__pyx_v_name) {
  gss_buffer_desc __pyx_v_res;
  OM_uint32 __pyx_v_maj_stat;
  OM_uint32 __pyx_v_min_stat;
  PyObject *__pyx_v_py_res = NULL;
  PyObject *__pyx_r = NULL;
  __Pyx_RefNannyDeclarations
  gss_buffer_desc __pyx_t_1;
  int __pyx_t_2;
  PyObject *__pyx_t_3 = NULL;
  PyObject *__pyx_t_4 = NULL;
  PyObject *__pyx_t_5 = NULL;
  PyObject *__pyx_t_6 = NULL;
  PyObject *__pyx_t_7 = NULL;
  Py_ssize_t __pyx_t_8;
  PyObject *__pyx_t_9 = NULL;
  int __pyx_lineno = 0;
  const char *__pyx_filename = NULL;
  int __pyx_clineno = 0;
  __Pyx_RefNannySetupContext("export_name_composite", 0);

  /* "gssapi/raw/ext_rfc6680.pyx":294
 *     """
 * 
 *     cdef gss_buffer_desc res = gss_buffer_desc(0, NULL)             # <<<<<<<<<<<<<<
 * 
 *     cdef OM_uint32 maj_stat, min_stat
 */
  __pyx_t_1.length = 0;
  __pyx_t_1.value = NULL;
  __pyx_v_res = __pyx_t_1;

  /* "gssapi/raw/ext_rfc6680.pyx":298
 *     cdef OM_uint32 maj_stat, min_stat
 * 
 *     maj_stat = gss_export_name_composite(&min_stat, name.raw_name, &res)             # <<<<<<<<<<<<<<
 * 
 *     if maj_stat == GSS_S_COMPLETE:
 */
  __pyx_v_maj_stat = gss_export_name_composite((&__pyx_v_min_stat), __pyx_v_name->raw_name, (&__pyx_v_res));

  /* "gssapi/raw/ext_rfc6680.pyx":300
 *     maj_stat = gss_export_name_composite(&min_stat, name.raw_name, &res)
 * 
 *     if maj_stat == GSS_S_COMPLETE:             # <<<<<<<<<<<<<<
 *         py_res = res.value[:res.length]
 *         gss_release_buffer(&min_stat, &res)
 */
  __pyx_t_2 = ((__pyx_v_maj_stat == GSS_S_COMPLETE) != 0);
  if (__pyx_t_2) {

    /* "gssapi/raw/ext_rfc6680.pyx":301
 * 
 *     if maj_stat == GSS_S_COMPLETE:
 *         py_res = res.value[:res.length]             # <<<<<<<<<<<<<<
 *         gss_release_buffer(&min_stat, &res)
 *         return py_res
 */
    __pyx_t_3 = __Pyx_PyBytes_FromStringAndSize(__pyx_v_res.value + 0, __pyx_v_res.length - 0); if (unlikely(!__pyx_t_3)) {__pyx_filename = __pyx_f[0]; __pyx_lineno = 301; __pyx_clineno = __LINE__; goto __pyx_L1_error;}
    __Pyx_GOTREF(__pyx_t_3);
    __pyx_v_py_res = ((PyObject*)__pyx_t_3);
    __pyx_t_3 = 0;

    /* "gssapi/raw/ext_rfc6680.pyx":302
 *     if maj_stat == GSS_S_COMPLETE:
 *         py_res = res.value[:res.length]
 *         gss_release_buffer(&min_stat, &res)             # <<<<<<<<<<<<<<
 *         return py_res
 *     else:
 */
    gss_release_buffer((&__pyx_v_min_stat), (&__pyx_v_res));

    /* "gssapi/raw/ext_rfc6680.pyx":303
 *         py_res = res.value[:res.length]
 *         gss_release_buffer(&min_stat, &res)
 *         return py_res             # <<<<<<<<<<<<<<
 *     else:
 *         raise GSSError(maj_stat, min_stat)
 */
    __Pyx_XDECREF(__pyx_r);
    __Pyx_INCREF(__pyx_v_py_res);
    __pyx_r = __pyx_v_py_res;
    goto __pyx_L0;
  }
  /*else*/ {

    /* "gssapi/raw/ext_rfc6680.pyx":305
 *         return py_res
 *     else:
 *         raise GSSError(maj_stat, min_stat)             # <<<<<<<<<<<<<<
 */
    __pyx_t_4 = __Pyx_GetModuleGlobalName(__pyx_n_s_GSSError); if (unlikely(!__pyx_t_4)) {__pyx_filename = __pyx_f[0]; __pyx_lineno = 305; __pyx_clineno = __LINE__; goto __pyx_L1_error;}
    __Pyx_GOTREF(__pyx_t_4);
    __pyx_t_5 = __Pyx_PyInt_From_uint32_t(__pyx_v_maj_stat); if (unlikely(!__pyx_t_5)) {__pyx_filename = __pyx_f[0]; __pyx_lineno = 305; __pyx_clineno = __LINE__; goto __pyx_L1_error;}
    __Pyx_GOTREF(__pyx_t_5);
    __pyx_t_6 = __Pyx_PyInt_From_uint32_t(__pyx_v_min_stat); if (unlikely(!__pyx_t_6)) {__pyx_filename = __pyx_f[0]; __pyx_lineno = 305; __pyx_clineno = __LINE__; goto __pyx_L1_error;}
    __Pyx_GOTREF(__pyx_t_6);
    __pyx_t_7 = NULL;
    __pyx_t_8 = 0;
    if (CYTHON_COMPILING_IN_CPYTHON && unlikely(PyMethod_Check(__pyx_t_4))) {
      __pyx_t_7 = PyMethod_GET_SELF(__pyx_t_4);
      if (likely(__pyx_t_7)) {
        PyObject* function = PyMethod_GET_FUNCTION(__pyx_t_4);
        __Pyx_INCREF(__pyx_t_7);
        __Pyx_INCREF(function);
        __Pyx_DECREF_SET(__pyx_t_4, function);
        __pyx_t_8 = 1;
      }
    }
    __pyx_t_9 = PyTuple_New(2+__pyx_t_8); if (unlikely(!__pyx_t_9)) {__pyx_filename = __pyx_f[0]; __pyx_lineno = 305; __pyx_clineno = __LINE__; goto __pyx_L1_error;}
    __Pyx_GOTREF(__pyx_t_9);
    if (__pyx_t_7) {
      PyTuple_SET_ITEM(__pyx_t_9, 0, __pyx_t_7); __Pyx_GIVEREF(__pyx_t_7); __pyx_t_7 = NULL;
    }
    PyTuple_SET_ITEM(__pyx_t_9, 0+__pyx_t_8, __pyx_t_5);
    __Pyx_GIVEREF(__pyx_t_5);
    PyTuple_SET_ITEM(__pyx_t_9, 1+__pyx_t_8, __pyx_t_6);
    __Pyx_GIVEREF(__pyx_t_6);
    __pyx_t_5 = 0;
    __pyx_t_6 = 0;
    __pyx_t_3 = __Pyx_PyObject_Call(__pyx_t_4, __pyx_t_9, NULL); if (unlikely(!__pyx_t_3)) {__pyx_filename = __pyx_f[0]; __pyx_lineno = 305; __pyx_clineno = __LINE__; goto __pyx_L1_error;}
    __Pyx_GOTREF(__pyx_t_3);
    __Pyx_DECREF(__pyx_t_9); __pyx_t_9 = 0;
    __Pyx_DECREF(__pyx_t_4); __pyx_t_4 = 0;
    __Pyx_Raise(__pyx_t_3, 0, 0, 0);
    __Pyx_DECREF(__pyx_t_3); __pyx_t_3 = 0;
    {__pyx_filename = __pyx_f[0]; __pyx_lineno = 305; __pyx_clineno = __LINE__; goto __pyx_L1_error;}
  }

  /* "gssapi/raw/ext_rfc6680.pyx":276
 * 
 * 
 * def export_name_composite(Name name not None):             # <<<<<<<<<<<<<<
 *     """
 *     Export a name, preserving attribute information
 */

  /* function exit code */
  __pyx_L1_error:;
  __Pyx_XDECREF(__pyx_t_3);
  __Pyx_XDECREF(__pyx_t_4);
  __Pyx_XDECREF(__pyx_t_5);
  __Pyx_XDECREF(__pyx_t_6);
  __Pyx_XDECREF(__pyx_t_7);
  __Pyx_XDECREF(__pyx_t_9);
  __Pyx_AddTraceback("gssapi.raw.ext_rfc6680.export_name_composite", __pyx_clineno, __pyx_lineno, __pyx_filename);
  __pyx_r = NULL;
  __pyx_L0:;
  __Pyx_XDECREF(__pyx_v_py_res);
  __Pyx_XGIVEREF(__pyx_r);
  __Pyx_RefNannyFinishContext();
  return __pyx_r;
}

static PyMethodDef __pyx_methods[] = {
  {0, 0, 0, 0}
};

#if PY_MAJOR_VERSION >= 3
static struct PyModuleDef __pyx_moduledef = {
  #if PY_VERSION_HEX < 0x03020000
    { PyObject_HEAD_INIT(NULL) NULL, 0, NULL },
  #else
    PyModuleDef_HEAD_INIT,
  #endif
    "ext_rfc6680",
    0, /* m_doc */
    -1, /* m_size */
    __pyx_methods /* m_methods */,
    NULL, /* m_reload */
    NULL, /* m_traverse */
    NULL, /* m_clear */
    NULL /* m_free */
};
#endif

static __Pyx_StringTabEntry __pyx_string_tab[] = {
  {&__pyx_n_s_BASE, __pyx_k_BASE, sizeof(__pyx_k_BASE), 0, 0, 1, 1},
  {&__pyx_n_s_GSSAPI, __pyx_k_GSSAPI, sizeof(__pyx_k_GSSAPI), 0, 0, 1, 1},
  {&__pyx_n_s_GSSError, __pyx_k_GSSError, sizeof(__pyx_k_GSSError), 0, 0, 1, 1},
  {&__pyx_n_s_GetNameAttributeResult, __pyx_k_GetNameAttributeResult, sizeof(__pyx_k_GetNameAttributeResult), 0, 0, 1, 1},
  {&__pyx_n_s_InquireNameResult, __pyx_k_InquireNameResult, sizeof(__pyx_k_InquireNameResult), 0, 0, 1, 1},
  {&__pyx_n_s_attr, __pyx_k_attr, sizeof(__pyx_k_attr), 0, 0, 1, 1},
  {&__pyx_n_s_attr_buff, __pyx_k_attr_buff, sizeof(__pyx_k_attr_buff), 0, 0, 1, 1},
  {&__pyx_n_s_attr_name, __pyx_k_attr_name, sizeof(__pyx_k_attr_name), 0, 0, 1, 1},
  {&__pyx_n_s_attr_names, __pyx_k_attr_names, sizeof(__pyx_k_attr_names), 0, 0, 1, 1},
  {&__pyx_n_s_attr_names_ptr, __pyx_k_attr_names_ptr, sizeof(__pyx_k_attr_names_ptr), 0, 0, 1, 1},
  {&__pyx_n_s_attrs, __pyx_k_attrs, sizeof(__pyx_k_attrs), 0, 0, 1, 1},
  {&__pyx_n_s_authenticated, __pyx_k_authenticated, sizeof(__pyx_k_authenticated), 0, 0, 1, 1},
  {&__pyx_n_s_complete, __pyx_k_complete, sizeof(__pyx_k_complete), 0, 0, 1, 1},
  {&__pyx_n_s_delete_name_attribute, __pyx_k_delete_name_attribute, sizeof(__pyx_k_delete_name_attribute), 0, 0, 1, 1},
  {&__pyx_n_s_displ_val_buff, __pyx_k_displ_val_buff, sizeof(__pyx_k_displ_val_buff), 0, 0, 1, 1},
  {&__pyx_n_s_display_name_ext, __pyx_k_display_name_ext, sizeof(__pyx_k_display_name_ext), 0, 0, 1, 1},
  {&__pyx_n_s_export_name_composite, __pyx_k_export_name_composite, sizeof(__pyx_k_export_name_composite), 0, 0, 1, 1},
  {&__pyx_n_s_get_name_attribute, __pyx_k_get_name_attribute, sizeof(__pyx_k_get_name_attribute), 0, 0, 1, 1},
  {&__pyx_n_s_gssapi_raw_ext_rfc6680, __pyx_k_gssapi_raw_ext_rfc6680, sizeof(__pyx_k_gssapi_raw_ext_rfc6680), 0, 0, 1, 1},
  {&__pyx_n_s_gssapi_raw_misc, __pyx_k_gssapi_raw_misc, sizeof(__pyx_k_gssapi_raw_misc), 0, 0, 1, 1},
  {&__pyx_n_s_gssapi_raw_named_tuples, __pyx_k_gssapi_raw_named_tuples, sizeof(__pyx_k_gssapi_raw_named_tuples), 0, 0, 1, 1},
  {&__pyx_kp_s_home_directxman12_dev_pythongss, __pyx_k_home_directxman12_dev_pythongss, sizeof(__pyx_k_home_directxman12_dev_pythongss), 0, 0, 1, 0},
  {&__pyx_n_s_i, __pyx_k_i, sizeof(__pyx_k_i), 0, 0, 1, 1},
  {&__pyx_n_s_import, __pyx_k_import, sizeof(__pyx_k_import), 0, 0, 1, 1},
  {&__pyx_n_s_inquire_name, __pyx_k_inquire_name, sizeof(__pyx_k_inquire_name), 0, 0, 1, 1},
  {&__pyx_n_s_length, __pyx_k_length, sizeof(__pyx_k_length), 0, 0, 1, 1},
  {&__pyx_n_s_main, __pyx_k_main, sizeof(__pyx_k_main), 0, 0, 1, 1},
  {&__pyx_n_s_maj_stat, __pyx_k_maj_stat, sizeof(__pyx_k_maj_stat), 0, 0, 1, 1},
  {&__pyx_n_s_mech_name, __pyx_k_mech_name, sizeof(__pyx_k_mech_name), 0, 0, 1, 1},
  {&__pyx_n_s_min_stat, __pyx_k_min_stat, sizeof(__pyx_k_min_stat), 0, 0, 1, 1},
  {&__pyx_n_s_mn_mech, __pyx_k_mn_mech, sizeof(__pyx_k_mn_mech), 0, 0, 1, 1},
  {&__pyx_n_s_mn_mech_ptr, __pyx_k_mn_mech_ptr, sizeof(__pyx_k_mn_mech_ptr), 0, 0, 1, 1},
  {&__pyx_n_s_more, __pyx_k_more, sizeof(__pyx_k_more), 0, 0, 1, 1},
  {&__pyx_n_s_more_val, __pyx_k_more_val, sizeof(__pyx_k_more_val), 0, 0, 1, 1},
  {&__pyx_n_s_name, __pyx_k_name, sizeof(__pyx_k_name), 0, 0, 1, 1},
  {&__pyx_n_s_name_is_mn, __pyx_k_name_is_mn, sizeof(__pyx_k_name_is_mn), 0, 0, 1, 1},
  {&__pyx_n_s_name_is_mn_ptr, __pyx_k_name_is_mn_ptr, sizeof(__pyx_k_name_is_mn_ptr), 0, 0, 1, 1},
  {&__pyx_n_s_name_text, __pyx_k_name_text, sizeof(__pyx_k_name_text), 0, 0, 1, 1},
  {&__pyx_n_s_name_type, __pyx_k_name_type, sizeof(__pyx_k_name_type), 0, 0, 1, 1},
  {&__pyx_n_s_output_name, __pyx_k_output_name, sizeof(__pyx_k_output_name), 0, 0, 1, 1},
  {&__pyx_n_s_py_attr_names, __pyx_k_py_attr_names, sizeof(__pyx_k_py_attr_names), 0, 0, 1, 1},
  {&__pyx_n_s_py_displ_vals, __pyx_k_py_displ_vals, sizeof(__pyx_k_py_displ_vals), 0, 0, 1, 1},
  {&__pyx_n_s_py_mech, __pyx_k_py_mech, sizeof(__pyx_k_py_mech), 0, 0, 1, 1},
  {&__pyx_n_s_py_res, __pyx_k_py_res, sizeof(__pyx_k_py_res), 0, 0, 1, 1},
  {&__pyx_n_s_py_vals, __pyx_k_py_vals, sizeof(__pyx_k_py_vals), 0, 0, 1, 1},
  {&__pyx_n_s_pyx_vtable, __pyx_k_pyx_vtable, sizeof(__pyx_k_pyx_vtable), 0, 0, 1, 1},
  {&__pyx_n_s_range, __pyx_k_range, sizeof(__pyx_k_range), 0, 0, 1, 1},
  {&__pyx_n_s_res, __pyx_k_res, sizeof(__pyx_k_res), 0, 0, 1, 1},
  {&__pyx_n_s_set_name_attribute, __pyx_k_set_name_attribute, sizeof(__pyx_k_set_name_attribute), 0, 0, 1, 1},
  {&__pyx_n_s_test, __pyx_k_test, sizeof(__pyx_k_test), 0, 0, 1, 1},
  {&__pyx_n_s_val, __pyx_k_val, sizeof(__pyx_k_val), 0, 0, 1, 1},
  {&__pyx_n_s_val_buff, __pyx_k_val_buff, sizeof(__pyx_k_val_buff), 0, 0, 1, 1},
  {&__pyx_n_s_value, __pyx_k_value, sizeof(__pyx_k_value), 0, 0, 1, 1},
  {&__pyx_n_s_value_len, __pyx_k_value_len, sizeof(__pyx_k_value_len), 0, 0, 1, 1},
  {0, 0, 0, 0, 0, 0, 0}
};
static int __Pyx_InitCachedBuiltins(void) {
  __pyx_builtin_range = __Pyx_GetBuiltinName(__pyx_n_s_range); if (!__pyx_builtin_range) {__pyx_filename = __pyx_f[0]; __pyx_lineno = 125; __pyx_clineno = __LINE__; goto __pyx_L1_error;}
  return 0;
  __pyx_L1_error:;
  return -1;
}

static int __Pyx_InitCachedConstants(void) {
  __Pyx_RefNannyDeclarations
  __Pyx_RefNannySetupContext("__Pyx_InitCachedConstants", 0);

  /* "gssapi/raw/ext_rfc6680.pyx":39
 * 
 * 
 * def display_name_ext(Name name not None, OID name_type not None):             # <<<<<<<<<<<<<<
 *     """
 *     Display the given Name using the given name type OID
 */
  __pyx_tuple_ = PyTuple_Pack(6, __pyx_n_s_name, __pyx_n_s_name_type, __pyx_n_s_output_name, __pyx_n_s_maj_stat, __pyx_n_s_min_stat, __pyx_n_s_name_text); if (unlikely(!__pyx_tuple_)) {__pyx_filename = __pyx_f[0]; __pyx_lineno = 39; __pyx_clineno = __LINE__; goto __pyx_L1_error;}
  __Pyx_GOTREF(__pyx_tuple_);
  __Pyx_GIVEREF(__pyx_tuple_);
  __pyx_codeobj__2 = (PyObject*)__Pyx_PyCode_New(2, 0, 6, 0, 0, __pyx_empty_bytes, __pyx_empty_tuple, __pyx_empty_tuple, __pyx_tuple_, __pyx_empty_tuple, __pyx_empty_tuple, __pyx_kp_s_home_directxman12_dev_pythongss, __pyx_n_s_display_name_ext, 39, __pyx_empty_bytes); if (unlikely(!__pyx_codeobj__2)) {__pyx_filename = __pyx_f[0]; __pyx_lineno = 39; __pyx_clineno = __LINE__; goto __pyx_L1_error;}

  /* "gssapi/raw/ext_rfc6680.pyx":76
 * 
 * 
 * def inquire_name(Name name not None, mech_name=True, attrs=True):             # <<<<<<<<<<<<<<
 *     """
 *     Get information about a Name
 */
  __pyx_tuple__3 = PyTuple_Pack(15, __pyx_n_s_name, __pyx_n_s_mech_name, __pyx_n_s_attrs, __pyx_n_s_name_is_mn_ptr, __pyx_n_s_mn_mech_ptr, __pyx_n_s_attr_names_ptr, __pyx_n_s_attr_names, __pyx_n_s_name_is_mn, __pyx_n_s_mn_mech, __pyx_n_s_maj_stat, __pyx_n_s_min_stat, __pyx_n_s_i, __pyx_n_s_py_mech, __pyx_n_s_py_attr_names, __pyx_n_s_attr_name); if (unlikely(!__pyx_tuple__3)) {__pyx_filename = __pyx_f[0]; __pyx_lineno = 76; __pyx_clineno = __LINE__; goto __pyx_L1_error;}
  __Pyx_GOTREF(__pyx_tuple__3);
  __Pyx_GIVEREF(__pyx_tuple__3);
  __pyx_codeobj__4 = (PyObject*)__Pyx_PyCode_New(3, 0, 15, 0, 0, __pyx_empty_bytes, __pyx_empty_tuple, __pyx_empty_tuple, __pyx_tuple__3, __pyx_empty_tuple, __pyx_empty_tuple, __pyx_kp_s_home_directxman12_dev_pythongss, __pyx_n_s_inquire_name, 76, __pyx_empty_bytes); if (unlikely(!__pyx_codeobj__4)) {__pyx_filename = __pyx_f[0]; __pyx_lineno = 76; __pyx_clineno = __LINE__; goto __pyx_L1_error;}

  /* "gssapi/raw/ext_rfc6680.pyx":140
 * 
 * 
 * def set_name_attribute(Name name not None, attr not None, value not None,             # <<<<<<<<<<<<<<
 *                        bint complete=False):
 *     """
 */
  __pyx_tuple__5 = PyTuple_Pack(11, __pyx_n_s_name, __pyx_n_s_attr, __pyx_n_s_value, __pyx_n_s_complete, __pyx_n_s_attr_buff, __pyx_n_s_val_buff, __pyx_n_s_maj_stat, __pyx_n_s_min_stat, __pyx_n_s_value_len, __pyx_n_s_i, __pyx_n_s_val); if (unlikely(!__pyx_tuple__5)) {__pyx_filename = __pyx_f[0]; __pyx_lineno = 140; __pyx_clineno = __LINE__; goto __pyx_L1_error;}
  __Pyx_GOTREF(__pyx_tuple__5);
  __Pyx_GIVEREF(__pyx_tuple__5);
  __pyx_codeobj__6 = (PyObject*)__Pyx_PyCode_New(4, 0, 11, 0, 0, __pyx_empty_bytes, __pyx_empty_tuple, __pyx_empty_tuple, __pyx_tuple__5, __pyx_empty_tuple, __pyx_empty_tuple, __pyx_kp_s_home_directxman12_dev_pythongss, __pyx_n_s_set_name_attribute, 140, __pyx_empty_bytes); if (unlikely(!__pyx_codeobj__6)) {__pyx_filename = __pyx_f[0]; __pyx_lineno = 140; __pyx_clineno = __LINE__; goto __pyx_L1_error;}

  /* "gssapi/raw/ext_rfc6680.pyx":186
 * 
 * 
 * def get_name_attribute(Name name not None, attr not None, more=None):             # <<<<<<<<<<<<<<
 *     """
 *     Get the value(s) of a Name attribute
 */
  __pyx_tuple__7 = PyTuple_Pack(13, __pyx_n_s_name, __pyx_n_s_attr, __pyx_n_s_more, __pyx_n_s_attr_buff, __pyx_n_s_val_buff, __pyx_n_s_displ_val_buff, __pyx_n_s_complete, __pyx_n_s_authenticated, __pyx_n_s_more_val, __pyx_n_s_py_vals, __pyx_n_s_py_displ_vals, __pyx_n_s_maj_stat, __pyx_n_s_min_stat); if (unlikely(!__pyx_tuple__7)) {__pyx_filename = __pyx_f[0]; __pyx_lineno = 186; __pyx_clineno = __LINE__; goto __pyx_L1_error;}
  __Pyx_GOTREF(__pyx_tuple__7);
  __Pyx_GIVEREF(__pyx_tuple__7);
  __pyx_codeobj__8 = (PyObject*)__Pyx_PyCode_New(3, 0, 13, 0, 0, __pyx_empty_bytes, __pyx_empty_tuple, __pyx_empty_tuple, __pyx_tuple__7, __pyx_empty_tuple, __pyx_empty_tuple, __pyx_kp_s_home_directxman12_dev_pythongss, __pyx_n_s_get_name_attribute, 186, __pyx_empty_bytes); if (unlikely(!__pyx_codeobj__8)) {__pyx_filename = __pyx_f[0]; __pyx_lineno = 186; __pyx_clineno = __LINE__; goto __pyx_L1_error;}

  /* "gssapi/raw/ext_rfc6680.pyx":245
 * 
 * 
 * def delete_name_attribute(Name name not None, attr not None):             # <<<<<<<<<<<<<<
 *     """
 *     Remove an attribute from a Name
 */
  __pyx_tuple__9 = PyTuple_Pack(5, __pyx_n_s_name, __pyx_n_s_attr, __pyx_n_s_attr_buff, __pyx_n_s_maj_stat, __pyx_n_s_min_stat); if (unlikely(!__pyx_tuple__9)) {__pyx_filename = __pyx_f[0]; __pyx_lineno = 245; __pyx_clineno = __LINE__; goto __pyx_L1_error;}
  __Pyx_GOTREF(__pyx_tuple__9);
  __Pyx_GIVEREF(__pyx_tuple__9);
  __pyx_codeobj__10 = (PyObject*)__Pyx_PyCode_New(2, 0, 5, 0, 0, __pyx_empty_bytes, __pyx_empty_tuple, __pyx_empty_tuple, __pyx_tuple__9, __pyx_empty_tuple, __pyx_empty_tuple, __pyx_kp_s_home_directxman12_dev_pythongss, __pyx_n_s_delete_name_attribute, 245, __pyx_empty_bytes); if (unlikely(!__pyx_codeobj__10)) {__pyx_filename = __pyx_f[0]; __pyx_lineno = 245; __pyx_clineno = __LINE__; goto __pyx_L1_error;}

  /* "gssapi/raw/ext_rfc6680.pyx":276
 * 
 * 
 * def export_name_composite(Name name not None):             # <<<<<<<<<<<<<<
 *     """
 *     Export a name, preserving attribute information
 */
  __pyx_tuple__11 = PyTuple_Pack(5, __pyx_n_s_name, __pyx_n_s_res, __pyx_n_s_maj_stat, __pyx_n_s_min_stat, __pyx_n_s_py_res); if (unlikely(!__pyx_tuple__11)) {__pyx_filename = __pyx_f[0]; __pyx_lineno = 276; __pyx_clineno = __LINE__; goto __pyx_L1_error;}
  __Pyx_GOTREF(__pyx_tuple__11);
  __Pyx_GIVEREF(__pyx_tuple__11);
  __pyx_codeobj__12 = (PyObject*)__Pyx_PyCode_New(1, 0, 5, 0, 0, __pyx_empty_bytes, __pyx_empty_tuple, __pyx_empty_tuple, __pyx_tuple__11, __pyx_empty_tuple, __pyx_empty_tuple, __pyx_kp_s_home_directxman12_dev_pythongss, __pyx_n_s_export_name_composite, 276, __pyx_empty_bytes); if (unlikely(!__pyx_codeobj__12)) {__pyx_filename = __pyx_f[0]; __pyx_lineno = 276; __pyx_clineno = __LINE__; goto __pyx_L1_error;}
  __Pyx_RefNannyFinishContext();
  return 0;
  __pyx_L1_error:;
  __Pyx_RefNannyFinishContext();
  return -1;
}

static int __Pyx_InitGlobals(void) {
  if (__Pyx_InitStrings(__pyx_string_tab) < 0) {__pyx_filename = __pyx_f[0]; __pyx_lineno = 1; __pyx_clineno = __LINE__; goto __pyx_L1_error;};
  return 0;
  __pyx_L1_error:;
  return -1;
}

#if PY_MAJOR_VERSION < 3
PyMODINIT_FUNC initext_rfc6680(void); /*proto*/
PyMODINIT_FUNC initext_rfc6680(void)
#else
PyMODINIT_FUNC PyInit_ext_rfc6680(void); /*proto*/
PyMODINIT_FUNC PyInit_ext_rfc6680(void)
#endif
{
  PyObject *__pyx_t_1 = NULL;
  PyObject *__pyx_t_2 = NULL;
  int __pyx_lineno = 0;
  const char *__pyx_filename = NULL;
  int __pyx_clineno = 0;
  __Pyx_RefNannyDeclarations
  #if CYTHON_REFNANNY
  __Pyx_RefNanny = __Pyx_RefNannyImportAPI("refnanny");
  if (!__Pyx_RefNanny) {
      PyErr_Clear();
      __Pyx_RefNanny = __Pyx_RefNannyImportAPI("Cython.Runtime.refnanny");
      if (!__Pyx_RefNanny)
          Py_FatalError("failed to import 'refnanny' module");
  }
  #endif
  __Pyx_RefNannySetupContext("PyMODINIT_FUNC PyInit_ext_rfc6680(void)", 0);
  if ( __Pyx_check_binary_version() < 0) {__pyx_filename = __pyx_f[0]; __pyx_lineno = 1; __pyx_clineno = __LINE__; goto __pyx_L1_error;}
  __pyx_empty_tuple = PyTuple_New(0); if (unlikely(!__pyx_empty_tuple)) {__pyx_filename = __pyx_f[0]; __pyx_lineno = 1; __pyx_clineno = __LINE__; goto __pyx_L1_error;}
  __pyx_empty_bytes = PyBytes_FromStringAndSize("", 0); if (unlikely(!__pyx_empty_bytes)) {__pyx_filename = __pyx_f[0]; __pyx_lineno = 1; __pyx_clineno = __LINE__; goto __pyx_L1_error;}
  #ifdef __Pyx_CyFunction_USED
  if (__Pyx_CyFunction_init() < 0) {__pyx_filename = __pyx_f[0]; __pyx_lineno = 1; __pyx_clineno = __LINE__; goto __pyx_L1_error;}
  #endif
  #ifdef __Pyx_FusedFunction_USED
  if (__pyx_FusedFunction_init() < 0) {__pyx_filename = __pyx_f[0]; __pyx_lineno = 1; __pyx_clineno = __LINE__; goto __pyx_L1_error;}
  #endif
  #ifdef __Pyx_Generator_USED
  if (__pyx_Generator_init() < 0) {__pyx_filename = __pyx_f[0]; __pyx_lineno = 1; __pyx_clineno = __LINE__; goto __pyx_L1_error;}
  #endif
  /*--- Library function declarations ---*/
  /*--- Threads initialization code ---*/
  #if defined(__PYX_FORCE_INIT_THREADS) && __PYX_FORCE_INIT_THREADS
  #ifdef WITH_THREAD /* Python build with threading support? */
  PyEval_InitThreads();
  #endif
  #endif
  /*--- Module creation code ---*/
  #if PY_MAJOR_VERSION < 3
  __pyx_m = Py_InitModule4("ext_rfc6680", __pyx_methods, 0, 0, PYTHON_API_VERSION); Py_XINCREF(__pyx_m);
  #else
  __pyx_m = PyModule_Create(&__pyx_moduledef);
  #endif
  if (unlikely(!__pyx_m)) {__pyx_filename = __pyx_f[0]; __pyx_lineno = 1; __pyx_clineno = __LINE__; goto __pyx_L1_error;}
  __pyx_d = PyModule_GetDict(__pyx_m); if (unlikely(!__pyx_d)) {__pyx_filename = __pyx_f[0]; __pyx_lineno = 1; __pyx_clineno = __LINE__; goto __pyx_L1_error;}
  Py_INCREF(__pyx_d);
  __pyx_b = PyImport_AddModule(__Pyx_BUILTIN_MODULE_NAME); if (unlikely(!__pyx_b)) {__pyx_filename = __pyx_f[0]; __pyx_lineno = 1; __pyx_clineno = __LINE__; goto __pyx_L1_error;}
  #if CYTHON_COMPILING_IN_PYPY
  Py_INCREF(__pyx_b);
  #endif
  if (PyObject_SetAttrString(__pyx_m, "__builtins__", __pyx_b) < 0) {__pyx_filename = __pyx_f[0]; __pyx_lineno = 1; __pyx_clineno = __LINE__; goto __pyx_L1_error;};
  /*--- Initialize various global constants etc. ---*/
  if (unlikely(__Pyx_InitGlobals() < 0)) {__pyx_filename = __pyx_f[0]; __pyx_lineno = 1; __pyx_clineno = __LINE__; goto __pyx_L1_error;}
  #if PY_MAJOR_VERSION < 3 && (__PYX_DEFAULT_STRING_ENCODING_IS_ASCII || __PYX_DEFAULT_STRING_ENCODING_IS_DEFAULT)
  if (__Pyx_init_sys_getdefaultencoding_params() < 0) {__pyx_filename = __pyx_f[0]; __pyx_lineno = 1; __pyx_clineno = __LINE__; goto __pyx_L1_error;}
  #endif
  if (__pyx_module_is_main_gssapi__raw__ext_rfc6680) {
    if (PyObject_SetAttrString(__pyx_m, "__name__", __pyx_n_s_main) < 0) {__pyx_filename = __pyx_f[0]; __pyx_lineno = 1; __pyx_clineno = __LINE__; goto __pyx_L1_error;};
  }
  #if PY_MAJOR_VERSION >= 3
  {
    PyObject *modules = PyImport_GetModuleDict(); if (unlikely(!modules)) {__pyx_filename = __pyx_f[0]; __pyx_lineno = 1; __pyx_clineno = __LINE__; goto __pyx_L1_error;}
    if (!PyDict_GetItemString(modules, "gssapi.raw.ext_rfc6680")) {
      if (unlikely(PyDict_SetItemString(modules, "gssapi.raw.ext_rfc6680", __pyx_m) < 0)) {__pyx_filename = __pyx_f[0]; __pyx_lineno = 1; __pyx_clineno = __LINE__; goto __pyx_L1_error;}
    }
  }
  #endif
  /*--- Builtin init code ---*/
  if (unlikely(__Pyx_InitCachedBuiltins() < 0)) {__pyx_filename = __pyx_f[0]; __pyx_lineno = 1; __pyx_clineno = __LINE__; goto __pyx_L1_error;}
  /*--- Constants init code ---*/
  if (unlikely(__Pyx_InitCachedConstants() < 0)) {__pyx_filename = __pyx_f[0]; __pyx_lineno = 1; __pyx_clineno = __LINE__; goto __pyx_L1_error;}
  /*--- Global init code ---*/
  /*--- Variable export code ---*/
  /*--- Function export code ---*/
  /*--- Type init code ---*/
  /*--- Type import code ---*/
  __pyx_ptype_6gssapi_3raw_5names_Name = __Pyx_ImportType("gssapi.raw.names", "Name", sizeof(struct __pyx_obj_6gssapi_3raw_5names_Name), 1); if (unlikely(!__pyx_ptype_6gssapi_3raw_5names_Name)) {__pyx_filename = __pyx_f[1]; __pyx_lineno = 3; __pyx_clineno = __LINE__; goto __pyx_L1_error;}
  __pyx_ptype_6gssapi_3raw_4oids_OID = __Pyx_ImportType("gssapi.raw.oids", "OID", sizeof(struct __pyx_obj_6gssapi_3raw_4oids_OID), 1); if (unlikely(!__pyx_ptype_6gssapi_3raw_4oids_OID)) {__pyx_filename = __pyx_f[2]; __pyx_lineno = 4; __pyx_clineno = __LINE__; goto __pyx_L1_error;}
  __pyx_vtabptr_6gssapi_3raw_4oids_OID = (struct __pyx_vtabstruct_6gssapi_3raw_4oids_OID*)__Pyx_GetVtable(__pyx_ptype_6gssapi_3raw_4oids_OID->tp_dict); if (unlikely(!__pyx_vtabptr_6gssapi_3raw_4oids_OID)) {__pyx_filename = __pyx_f[2]; __pyx_lineno = 4; __pyx_clineno = __LINE__; goto __pyx_L1_error;}
  /*--- Variable import code ---*/
  /*--- Function import code ---*/
  /*--- Execution code ---*/

  /* "gssapi/raw/ext_rfc6680.pyx":1
 * GSSAPI="BASE"  # This ensures that a full module is generated by Cython             # <<<<<<<<<<<<<<
 * 
 * from gssapi.raw.cython_types cimport *
 */
  if (PyDict_SetItem(__pyx_d, __pyx_n_s_GSSAPI, __pyx_n_s_BASE) < 0) {__pyx_filename = __pyx_f[0]; __pyx_lineno = 1; __pyx_clineno = __LINE__; goto __pyx_L1_error;}

  /* "gssapi/raw/ext_rfc6680.pyx":8
 * from gssapi.raw.oids cimport OID
 * 
 * from gssapi.raw.misc import GSSError             # <<<<<<<<<<<<<<
 * from gssapi.raw.named_tuples import InquireNameResult, GetNameAttributeResult
 * 
 */
  __pyx_t_1 = PyList_New(1); if (unlikely(!__pyx_t_1)) {__pyx_filename = __pyx_f[0]; __pyx_lineno = 8; __pyx_clineno = __LINE__; goto __pyx_L1_error;}
  __Pyx_GOTREF(__pyx_t_1);
  __Pyx_INCREF(__pyx_n_s_GSSError);
  PyList_SET_ITEM(__pyx_t_1, 0, __pyx_n_s_GSSError);
  __Pyx_GIVEREF(__pyx_n_s_GSSError);
  __pyx_t_2 = __Pyx_Import(__pyx_n_s_gssapi_raw_misc, __pyx_t_1, -1); if (unlikely(!__pyx_t_2)) {__pyx_filename = __pyx_f[0]; __pyx_lineno = 8; __pyx_clineno = __LINE__; goto __pyx_L1_error;}
  __Pyx_GOTREF(__pyx_t_2);
  __Pyx_DECREF(__pyx_t_1); __pyx_t_1 = 0;
  __pyx_t_1 = __Pyx_ImportFrom(__pyx_t_2, __pyx_n_s_GSSError); if (unlikely(!__pyx_t_1)) {__pyx_filename = __pyx_f[0]; __pyx_lineno = 8; __pyx_clineno = __LINE__; goto __pyx_L1_error;}
  __Pyx_GOTREF(__pyx_t_1);
  if (PyDict_SetItem(__pyx_d, __pyx_n_s_GSSError, __pyx_t_1) < 0) {__pyx_filename = __pyx_f[0]; __pyx_lineno = 8; __pyx_clineno = __LINE__; goto __pyx_L1_error;}
  __Pyx_DECREF(__pyx_t_1); __pyx_t_1 = 0;
  __Pyx_DECREF(__pyx_t_2); __pyx_t_2 = 0;

  /* "gssapi/raw/ext_rfc6680.pyx":9
 * 
 * from gssapi.raw.misc import GSSError
 * from gssapi.raw.named_tuples import InquireNameResult, GetNameAttributeResult             # <<<<<<<<<<<<<<
 * 
 * cdef extern from "gssapi/gssapi_ext.h":
 */
  __pyx_t_2 = PyList_New(2); if (unlikely(!__pyx_t_2)) {__pyx_filename = __pyx_f[0]; __pyx_lineno = 9; __pyx_clineno = __LINE__; goto __pyx_L1_error;}
  __Pyx_GOTREF(__pyx_t_2);
  __Pyx_INCREF(__pyx_n_s_InquireNameResult);
  PyList_SET_ITEM(__pyx_t_2, 0, __pyx_n_s_InquireNameResult);
  __Pyx_GIVEREF(__pyx_n_s_InquireNameResult);
  __Pyx_INCREF(__pyx_n_s_GetNameAttributeResult);
  PyList_SET_ITEM(__pyx_t_2, 1, __pyx_n_s_GetNameAttributeResult);
  __Pyx_GIVEREF(__pyx_n_s_GetNameAttributeResult);
  __pyx_t_1 = __Pyx_Import(__pyx_n_s_gssapi_raw_named_tuples, __pyx_t_2, -1); if (unlikely(!__pyx_t_1)) {__pyx_filename = __pyx_f[0]; __pyx_lineno = 9; __pyx_clineno = __LINE__; goto __pyx_L1_error;}
  __Pyx_GOTREF(__pyx_t_1);
  __Pyx_DECREF(__pyx_t_2); __pyx_t_2 = 0;
  __pyx_t_2 = __Pyx_ImportFrom(__pyx_t_1, __pyx_n_s_InquireNameResult); if (unlikely(!__pyx_t_2)) {__pyx_filename = __pyx_f[0]; __pyx_lineno = 9; __pyx_clineno = __LINE__; goto __pyx_L1_error;}
  __Pyx_GOTREF(__pyx_t_2);
  if (PyDict_SetItem(__pyx_d, __pyx_n_s_InquireNameResult, __pyx_t_2) < 0) {__pyx_filename = __pyx_f[0]; __pyx_lineno = 9; __pyx_clineno = __LINE__; goto __pyx_L1_error;}
  __Pyx_DECREF(__pyx_t_2); __pyx_t_2 = 0;
  __pyx_t_2 = __Pyx_ImportFrom(__pyx_t_1, __pyx_n_s_GetNameAttributeResult); if (unlikely(!__pyx_t_2)) {__pyx_filename = __pyx_f[0]; __pyx_lineno = 9; __pyx_clineno = __LINE__; goto __pyx_L1_error;}
  __Pyx_GOTREF(__pyx_t_2);
  if (PyDict_SetItem(__pyx_d, __pyx_n_s_GetNameAttributeResult, __pyx_t_2) < 0) {__pyx_filename = __pyx_f[0]; __pyx_lineno = 9; __pyx_clineno = __LINE__; goto __pyx_L1_error;}
  __Pyx_DECREF(__pyx_t_2); __pyx_t_2 = 0;
  __Pyx_DECREF(__pyx_t_1); __pyx_t_1 = 0;

  /* "gssapi/raw/ext_rfc6680.pyx":39
 * 
 * 
 * def display_name_ext(Name name not None, OID name_type not None):             # <<<<<<<<<<<<<<
 *     """
 *     Display the given Name using the given name type OID
 */
  __pyx_t_1 = PyCFunction_NewEx(&__pyx_mdef_6gssapi_3raw_11ext_rfc6680_1display_name_ext, NULL, __pyx_n_s_gssapi_raw_ext_rfc6680); if (unlikely(!__pyx_t_1)) {__pyx_filename = __pyx_f[0]; __pyx_lineno = 39; __pyx_clineno = __LINE__; goto __pyx_L1_error;}
  __Pyx_GOTREF(__pyx_t_1);
  if (PyDict_SetItem(__pyx_d, __pyx_n_s_display_name_ext, __pyx_t_1) < 0) {__pyx_filename = __pyx_f[0]; __pyx_lineno = 39; __pyx_clineno = __LINE__; goto __pyx_L1_error;}
  __Pyx_DECREF(__pyx_t_1); __pyx_t_1 = 0;

  /* "gssapi/raw/ext_rfc6680.pyx":76
 * 
 * 
 * def inquire_name(Name name not None, mech_name=True, attrs=True):             # <<<<<<<<<<<<<<
 *     """
 *     Get information about a Name
 */
  __pyx_t_1 = PyCFunction_NewEx(&__pyx_mdef_6gssapi_3raw_11ext_rfc6680_3inquire_name, NULL, __pyx_n_s_gssapi_raw_ext_rfc6680); if (unlikely(!__pyx_t_1)) {__pyx_filename = __pyx_f[0]; __pyx_lineno = 76; __pyx_clineno = __LINE__; goto __pyx_L1_error;}
  __Pyx_GOTREF(__pyx_t_1);
  if (PyDict_SetItem(__pyx_d, __pyx_n_s_inquire_name, __pyx_t_1) < 0) {__pyx_filename = __pyx_f[0]; __pyx_lineno = 76; __pyx_clineno = __LINE__; goto __pyx_L1_error;}
  __Pyx_DECREF(__pyx_t_1); __pyx_t_1 = 0;

  /* "gssapi/raw/ext_rfc6680.pyx":140
 * 
 * 
 * def set_name_attribute(Name name not None, attr not None, value not None,             # <<<<<<<<<<<<<<
 *                        bint complete=False):
 *     """
 */
  __pyx_t_1 = PyCFunction_NewEx(&__pyx_mdef_6gssapi_3raw_11ext_rfc6680_5set_name_attribute, NULL, __pyx_n_s_gssapi_raw_ext_rfc6680); if (unlikely(!__pyx_t_1)) {__pyx_filename = __pyx_f[0]; __pyx_lineno = 140; __pyx_clineno = __LINE__; goto __pyx_L1_error;}
  __Pyx_GOTREF(__pyx_t_1);
  if (PyDict_SetItem(__pyx_d, __pyx_n_s_set_name_attribute, __pyx_t_1) < 0) {__pyx_filename = __pyx_f[0]; __pyx_lineno = 140; __pyx_clineno = __LINE__; goto __pyx_L1_error;}
  __Pyx_DECREF(__pyx_t_1); __pyx_t_1 = 0;

  /* "gssapi/raw/ext_rfc6680.pyx":186
 * 
 * 
 * def get_name_attribute(Name name not None, attr not None, more=None):             # <<<<<<<<<<<<<<
 *     """
 *     Get the value(s) of a Name attribute
 */
  __pyx_t_1 = PyCFunction_NewEx(&__pyx_mdef_6gssapi_3raw_11ext_rfc6680_7get_name_attribute, NULL, __pyx_n_s_gssapi_raw_ext_rfc6680); if (unlikely(!__pyx_t_1)) {__pyx_filename = __pyx_f[0]; __pyx_lineno = 186; __pyx_clineno = __LINE__; goto __pyx_L1_error;}
  __Pyx_GOTREF(__pyx_t_1);
  if (PyDict_SetItem(__pyx_d, __pyx_n_s_get_name_attribute, __pyx_t_1) < 0) {__pyx_filename = __pyx_f[0]; __pyx_lineno = 186; __pyx_clineno = __LINE__; goto __pyx_L1_error;}
  __Pyx_DECREF(__pyx_t_1); __pyx_t_1 = 0;

  /* "gssapi/raw/ext_rfc6680.pyx":245
 * 
 * 
 * def delete_name_attribute(Name name not None, attr not None):             # <<<<<<<<<<<<<<
 *     """
 *     Remove an attribute from a Name
 */
  __pyx_t_1 = PyCFunction_NewEx(&__pyx_mdef_6gssapi_3raw_11ext_rfc6680_9delete_name_attribute, NULL, __pyx_n_s_gssapi_raw_ext_rfc6680); if (unlikely(!__pyx_t_1)) {__pyx_filename = __pyx_f[0]; __pyx_lineno = 245; __pyx_clineno = __LINE__; goto __pyx_L1_error;}
  __Pyx_GOTREF(__pyx_t_1);
  if (PyDict_SetItem(__pyx_d, __pyx_n_s_delete_name_attribute, __pyx_t_1) < 0) {__pyx_filename = __pyx_f[0]; __pyx_lineno = 245; __pyx_clineno = __LINE__; goto __pyx_L1_error;}
  __Pyx_DECREF(__pyx_t_1); __pyx_t_1 = 0;

  /* "gssapi/raw/ext_rfc6680.pyx":276
 * 
 * 
 * def export_name_composite(Name name not None):             # <<<<<<<<<<<<<<
 *     """
 *     Export a name, preserving attribute information
 */
  __pyx_t_1 = PyCFunction_NewEx(&__pyx_mdef_6gssapi_3raw_11ext_rfc6680_11export_name_composite, NULL, __pyx_n_s_gssapi_raw_ext_rfc6680); if (unlikely(!__pyx_t_1)) {__pyx_filename = __pyx_f[0]; __pyx_lineno = 276; __pyx_clineno = __LINE__; goto __pyx_L1_error;}
  __Pyx_GOTREF(__pyx_t_1);
  if (PyDict_SetItem(__pyx_d, __pyx_n_s_export_name_composite, __pyx_t_1) < 0) {__pyx_filename = __pyx_f[0]; __pyx_lineno = 276; __pyx_clineno = __LINE__; goto __pyx_L1_error;}
  __Pyx_DECREF(__pyx_t_1); __pyx_t_1 = 0;

  /* "gssapi/raw/ext_rfc6680.pyx":1
 * GSSAPI="BASE"  # This ensures that a full module is generated by Cython             # <<<<<<<<<<<<<<
 * 
 * from gssapi.raw.cython_types cimport *
 */
  __pyx_t_1 = PyDict_New(); if (unlikely(!__pyx_t_1)) {__pyx_filename = __pyx_f[0]; __pyx_lineno = 1; __pyx_clineno = __LINE__; goto __pyx_L1_error;}
  __Pyx_GOTREF(__pyx_t_1);
  if (PyDict_SetItem(__pyx_d, __pyx_n_s_test, __pyx_t_1) < 0) {__pyx_filename = __pyx_f[0]; __pyx_lineno = 1; __pyx_clineno = __LINE__; goto __pyx_L1_error;}
  __Pyx_DECREF(__pyx_t_1); __pyx_t_1 = 0;

  /*--- Wrapped vars code ---*/

  goto __pyx_L0;
  __pyx_L1_error:;
  __Pyx_XDECREF(__pyx_t_1);
  __Pyx_XDECREF(__pyx_t_2);
  if (__pyx_m) {
    if (__pyx_d) {
      __Pyx_AddTraceback("init gssapi.raw.ext_rfc6680", __pyx_clineno, __pyx_lineno, __pyx_filename);
      Py_DECREF(__pyx_d); __pyx_d = 0;
    }
    Py_DECREF(__pyx_m); __pyx_m = 0;
  } else if (!PyErr_Occurred()) {
    PyErr_SetString(PyExc_ImportError, "init gssapi.raw.ext_rfc6680");
  }
  __pyx_L0:;
  __Pyx_RefNannyFinishContext();
  #if PY_MAJOR_VERSION < 3
  return;
  #else
  return __pyx_m;
  #endif
}

/* Runtime support code */
#if CYTHON_REFNANNY
static __Pyx_RefNannyAPIStruct *__Pyx_RefNannyImportAPI(const char *modname) {
    PyObject *m = NULL, *p = NULL;
    void *r = NULL;
    m = PyImport_ImportModule((char *)modname);
    if (!m) goto end;
    p = PyObject_GetAttrString(m, (char *)"RefNannyAPI");
    if (!p) goto end;
    r = PyLong_AsVoidPtr(p);
end:
    Py_XDECREF(p);
    Py_XDECREF(m);
    return (__Pyx_RefNannyAPIStruct *)r;
}
#endif

static PyObject *__Pyx_GetBuiltinName(PyObject *name) {
    PyObject* result = __Pyx_PyObject_GetAttrStr(__pyx_b, name);
    if (unlikely(!result)) {
        PyErr_Format(PyExc_NameError,
#if PY_MAJOR_VERSION >= 3
            "name '%U' is not defined", name);
#else
            "name '%.200s' is not defined", PyString_AS_STRING(name));
#endif
    }
    return result;
}

static void __Pyx_RaiseArgtupleInvalid(
    const char* func_name,
    int exact,
    Py_ssize_t num_min,
    Py_ssize_t num_max,
    Py_ssize_t num_found)
{
    Py_ssize_t num_expected;
    const char *more_or_less;
    if (num_found < num_min) {
        num_expected = num_min;
        more_or_less = "at least";
    } else {
        num_expected = num_max;
        more_or_less = "at most";
    }
    if (exact) {
        more_or_less = "exactly";
    }
    PyErr_Format(PyExc_TypeError,
                 "%.200s() takes %.8s %" CYTHON_FORMAT_SSIZE_T "d positional argument%.1s (%" CYTHON_FORMAT_SSIZE_T "d given)",
                 func_name, more_or_less, num_expected,
                 (num_expected == 1) ? "" : "s", num_found);
}

static void __Pyx_RaiseDoubleKeywordsError(
    const char* func_name,
    PyObject* kw_name)
{
    PyErr_Format(PyExc_TypeError,
        #if PY_MAJOR_VERSION >= 3
        "%s() got multiple values for keyword argument '%U'", func_name, kw_name);
        #else
        "%s() got multiple values for keyword argument '%s'", func_name,
        PyString_AsString(kw_name));
        #endif
}

static int __Pyx_ParseOptionalKeywords(
    PyObject *kwds,
    PyObject **argnames[],
    PyObject *kwds2,
    PyObject *values[],
    Py_ssize_t num_pos_args,
    const char* function_name)
{
    PyObject *key = 0, *value = 0;
    Py_ssize_t pos = 0;
    PyObject*** name;
    PyObject*** first_kw_arg = argnames + num_pos_args;
    while (PyDict_Next(kwds, &pos, &key, &value)) {
        name = first_kw_arg;
        while (*name && (**name != key)) name++;
        if (*name) {
            values[name-argnames] = value;
            continue;
        }
        name = first_kw_arg;
        #if PY_MAJOR_VERSION < 3
        if (likely(PyString_CheckExact(key)) || likely(PyString_Check(key))) {
            while (*name) {
                if ((CYTHON_COMPILING_IN_PYPY || PyString_GET_SIZE(**name) == PyString_GET_SIZE(key))
                        && _PyString_Eq(**name, key)) {
                    values[name-argnames] = value;
                    break;
                }
                name++;
            }
            if (*name) continue;
            else {
                PyObject*** argname = argnames;
                while (argname != first_kw_arg) {
                    if ((**argname == key) || (
                            (CYTHON_COMPILING_IN_PYPY || PyString_GET_SIZE(**argname) == PyString_GET_SIZE(key))
                             && _PyString_Eq(**argname, key))) {
                        goto arg_passed_twice;
                    }
                    argname++;
                }
            }
        } else
        #endif
        if (likely(PyUnicode_Check(key))) {
            while (*name) {
                int cmp = (**name == key) ? 0 :
                #if !CYTHON_COMPILING_IN_PYPY && PY_MAJOR_VERSION >= 3
                    (PyUnicode_GET_SIZE(**name) != PyUnicode_GET_SIZE(key)) ? 1 :
                #endif
                    PyUnicode_Compare(**name, key);
                if (cmp < 0 && unlikely(PyErr_Occurred())) goto bad;
                if (cmp == 0) {
                    values[name-argnames] = value;
                    break;
                }
                name++;
            }
            if (*name) continue;
            else {
                PyObject*** argname = argnames;
                while (argname != first_kw_arg) {
                    int cmp = (**argname == key) ? 0 :
                    #if !CYTHON_COMPILING_IN_PYPY && PY_MAJOR_VERSION >= 3
                        (PyUnicode_GET_SIZE(**argname) != PyUnicode_GET_SIZE(key)) ? 1 :
                    #endif
                        PyUnicode_Compare(**argname, key);
                    if (cmp < 0 && unlikely(PyErr_Occurred())) goto bad;
                    if (cmp == 0) goto arg_passed_twice;
                    argname++;
                }
            }
        } else
            goto invalid_keyword_type;
        if (kwds2) {
            if (unlikely(PyDict_SetItem(kwds2, key, value))) goto bad;
        } else {
            goto invalid_keyword;
        }
    }
    return 0;
arg_passed_twice:
    __Pyx_RaiseDoubleKeywordsError(function_name, key);
    goto bad;
invalid_keyword_type:
    PyErr_Format(PyExc_TypeError,
        "%.200s() keywords must be strings", function_name);
    goto bad;
invalid_keyword:
    PyErr_Format(PyExc_TypeError,
    #if PY_MAJOR_VERSION < 3
        "%.200s() got an unexpected keyword argument '%.200s'",
        function_name, PyString_AsString(key));
    #else
        "%s() got an unexpected keyword argument '%U'",
        function_name, key);
    #endif
bad:
    return -1;
}

static void __Pyx_RaiseArgumentTypeInvalid(const char* name, PyObject *obj, PyTypeObject *type) {
    PyErr_Format(PyExc_TypeError,
        "Argument '%.200s' has incorrect type (expected %.200s, got %.200s)",
        name, type->tp_name, Py_TYPE(obj)->tp_name);
}
static CYTHON_INLINE int __Pyx_ArgTypeTest(PyObject *obj, PyTypeObject *type, int none_allowed,
    const char *name, int exact)
{
    if (unlikely(!type)) {
        PyErr_SetString(PyExc_SystemError, "Missing type object");
        return 0;
    }
    if (none_allowed && obj == Py_None) return 1;
    else if (exact) {
        if (likely(Py_TYPE(obj) == type)) return 1;
        #if PY_MAJOR_VERSION == 2
        else if ((type == &PyBaseString_Type) && likely(__Pyx_PyBaseString_CheckExact(obj))) return 1;
        #endif
    }
    else {
        if (likely(PyObject_TypeCheck(obj, type))) return 1;
    }
    __Pyx_RaiseArgumentTypeInvalid(name, obj, type);
    return 0;
}

static CYTHON_INLINE PyObject *__Pyx_GetModuleGlobalName(PyObject *name) {
    PyObject *result;
#if CYTHON_COMPILING_IN_CPYTHON
    result = PyDict_GetItem(__pyx_d, name);
    if (likely(result)) {
        Py_INCREF(result);
    } else {
#else
    result = PyObject_GetItem(__pyx_d, name);
    if (!result) {
        PyErr_Clear();
#endif
        result = __Pyx_GetBuiltinName(name);
    }
    return result;
}

#if CYTHON_COMPILING_IN_CPYTHON
static CYTHON_INLINE PyObject* __Pyx_PyObject_Call(PyObject *func, PyObject *arg, PyObject *kw) {
    PyObject *result;
    ternaryfunc call = func->ob_type->tp_call;
    if (unlikely(!call))
        return PyObject_Call(func, arg, kw);
    if (unlikely(Py_EnterRecursiveCall((char*)" while calling a Python object")))
        return NULL;
    result = (*call)(func, arg, kw);
    Py_LeaveRecursiveCall();
    if (unlikely(!result) && unlikely(!PyErr_Occurred())) {
        PyErr_SetString(
            PyExc_SystemError,
            "NULL result without error in PyObject_Call");
    }
    return result;
}
#endif

static CYTHON_INLINE void __Pyx_ErrRestore(PyObject *type, PyObject *value, PyObject *tb) {
#if CYTHON_COMPILING_IN_CPYTHON
    PyObject *tmp_type, *tmp_value, *tmp_tb;
    PyThreadState *tstate = PyThreadState_GET();
    tmp_type = tstate->curexc_type;
    tmp_value = tstate->curexc_value;
    tmp_tb = tstate->curexc_traceback;
    tstate->curexc_type = type;
    tstate->curexc_value = value;
    tstate->curexc_traceback = tb;
    Py_XDECREF(tmp_type);
    Py_XDECREF(tmp_value);
    Py_XDECREF(tmp_tb);
#else
    PyErr_Restore(type, value, tb);
#endif
}
static CYTHON_INLINE void __Pyx_ErrFetch(PyObject **type, PyObject **value, PyObject **tb) {
#if CYTHON_COMPILING_IN_CPYTHON
    PyThreadState *tstate = PyThreadState_GET();
    *type = tstate->curexc_type;
    *value = tstate->curexc_value;
    *tb = tstate->curexc_traceback;
    tstate->curexc_type = 0;
    tstate->curexc_value = 0;
    tstate->curexc_traceback = 0;
#else
    PyErr_Fetch(type, value, tb);
#endif
}

#if PY_MAJOR_VERSION < 3
static void __Pyx_Raise(PyObject *type, PyObject *value, PyObject *tb,
                        CYTHON_UNUSED PyObject *cause) {
    Py_XINCREF(type);
    if (!value || value == Py_None)
        value = NULL;
    else
        Py_INCREF(value);
    if (!tb || tb == Py_None)
        tb = NULL;
    else {
        Py_INCREF(tb);
        if (!PyTraceBack_Check(tb)) {
            PyErr_SetString(PyExc_TypeError,
                "raise: arg 3 must be a traceback or None");
            goto raise_error;
        }
    }
    if (PyType_Check(type)) {
#if CYTHON_COMPILING_IN_PYPY
        if (!value) {
            Py_INCREF(Py_None);
            value = Py_None;
        }
#endif
        PyErr_NormalizeException(&type, &value, &tb);
    } else {
        if (value) {
            PyErr_SetString(PyExc_TypeError,
                "instance exception may not have a separate value");
            goto raise_error;
        }
        value = type;
        type = (PyObject*) Py_TYPE(type);
        Py_INCREF(type);
        if (!PyType_IsSubtype((PyTypeObject *)type, (PyTypeObject *)PyExc_BaseException)) {
            PyErr_SetString(PyExc_TypeError,
                "raise: exception class must be a subclass of BaseException");
            goto raise_error;
        }
    }
    __Pyx_ErrRestore(type, value, tb);
    return;
raise_error:
    Py_XDECREF(value);
    Py_XDECREF(type);
    Py_XDECREF(tb);
    return;
}
#else
static void __Pyx_Raise(PyObject *type, PyObject *value, PyObject *tb, PyObject *cause) {
    PyObject* owned_instance = NULL;
    if (tb == Py_None) {
        tb = 0;
    } else if (tb && !PyTraceBack_Check(tb)) {
        PyErr_SetString(PyExc_TypeError,
            "raise: arg 3 must be a traceback or None");
        goto bad;
    }
    if (value == Py_None)
        value = 0;
    if (PyExceptionInstance_Check(type)) {
        if (value) {
            PyErr_SetString(PyExc_TypeError,
                "instance exception may not have a separate value");
            goto bad;
        }
        value = type;
        type = (PyObject*) Py_TYPE(value);
    } else if (PyExceptionClass_Check(type)) {
        PyObject *instance_class = NULL;
        if (value && PyExceptionInstance_Check(value)) {
            instance_class = (PyObject*) Py_TYPE(value);
            if (instance_class != type) {
                if (PyObject_IsSubclass(instance_class, type)) {
                    type = instance_class;
                } else {
                    instance_class = NULL;
                }
            }
        }
        if (!instance_class) {
            PyObject *args;
            if (!value)
                args = PyTuple_New(0);
            else if (PyTuple_Check(value)) {
                Py_INCREF(value);
                args = value;
            } else
                args = PyTuple_Pack(1, value);
            if (!args)
                goto bad;
            owned_instance = PyObject_Call(type, args, NULL);
            Py_DECREF(args);
            if (!owned_instance)
                goto bad;
            value = owned_instance;
            if (!PyExceptionInstance_Check(value)) {
                PyErr_Format(PyExc_TypeError,
                             "calling %R should have returned an instance of "
                             "BaseException, not %R",
                             type, Py_TYPE(value));
                goto bad;
            }
        }
    } else {
        PyErr_SetString(PyExc_TypeError,
            "raise: exception class must be a subclass of BaseException");
        goto bad;
    }
#if PY_VERSION_HEX >= 0x03030000
    if (cause) {
#else
    if (cause && cause != Py_None) {
#endif
        PyObject *fixed_cause;
        if (cause == Py_None) {
            fixed_cause = NULL;
        } else if (PyExceptionClass_Check(cause)) {
            fixed_cause = PyObject_CallObject(cause, NULL);
            if (fixed_cause == NULL)
                goto bad;
        } else if (PyExceptionInstance_Check(cause)) {
            fixed_cause = cause;
            Py_INCREF(fixed_cause);
        } else {
            PyErr_SetString(PyExc_TypeError,
                            "exception causes must derive from "
                            "BaseException");
            goto bad;
        }
        PyException_SetCause(value, fixed_cause);
    }
    PyErr_SetObject(type, value);
    if (tb) {
        PyThreadState *tstate = PyThreadState_GET();
        PyObject* tmp_tb = tstate->curexc_traceback;
        if (tb != tmp_tb) {
            Py_INCREF(tb);
            tstate->curexc_traceback = tb;
            Py_XDECREF(tmp_tb);
        }
    }
bad:
    Py_XDECREF(owned_instance);
    return;
}
#endif

static void* __Pyx_GetVtable(PyObject *dict) {
    void* ptr;
    PyObject *ob = PyObject_GetItem(dict, __pyx_n_s_pyx_vtable);
    if (!ob)
        goto bad;
#if PY_VERSION_HEX >= 0x02070000
    ptr = PyCapsule_GetPointer(ob, 0);
#else
    ptr = PyCObject_AsVoidPtr(ob);
#endif
    if (!ptr && !PyErr_Occurred())
        PyErr_SetString(PyExc_RuntimeError, "invalid vtable found for imported type");
    Py_DECREF(ob);
    return ptr;
bad:
    Py_XDECREF(ob);
    return NULL;
}

static PyObject* __Pyx_ImportFrom(PyObject* module, PyObject* name) {
    PyObject* value = __Pyx_PyObject_GetAttrStr(module, name);
    if (unlikely(!value) && PyErr_ExceptionMatches(PyExc_AttributeError)) {
        PyErr_Format(PyExc_ImportError,
        #if PY_MAJOR_VERSION < 3
            "cannot import name %.230s", PyString_AS_STRING(name));
        #else
            "cannot import name %S", name);
        #endif
    }
    return value;
}

static int __pyx_bisect_code_objects(__Pyx_CodeObjectCacheEntry* entries, int count, int code_line) {
    int start = 0, mid = 0, end = count - 1;
    if (end >= 0 && code_line > entries[end].code_line) {
        return count;
    }
    while (start < end) {
        mid = (start + end) / 2;
        if (code_line < entries[mid].code_line) {
            end = mid;
        } else if (code_line > entries[mid].code_line) {
             start = mid + 1;
        } else {
            return mid;
        }
    }
    if (code_line <= entries[mid].code_line) {
        return mid;
    } else {
        return mid + 1;
    }
}
static PyCodeObject *__pyx_find_code_object(int code_line) {
    PyCodeObject* code_object;
    int pos;
    if (unlikely(!code_line) || unlikely(!__pyx_code_cache.entries)) {
        return NULL;
    }
    pos = __pyx_bisect_code_objects(__pyx_code_cache.entries, __pyx_code_cache.count, code_line);
    if (unlikely(pos >= __pyx_code_cache.count) || unlikely(__pyx_code_cache.entries[pos].code_line != code_line)) {
        return NULL;
    }
    code_object = __pyx_code_cache.entries[pos].code_object;
    Py_INCREF(code_object);
    return code_object;
}
static void __pyx_insert_code_object(int code_line, PyCodeObject* code_object) {
    int pos, i;
    __Pyx_CodeObjectCacheEntry* entries = __pyx_code_cache.entries;
    if (unlikely(!code_line)) {
        return;
    }
    if (unlikely(!entries)) {
        entries = (__Pyx_CodeObjectCacheEntry*)PyMem_Malloc(64*sizeof(__Pyx_CodeObjectCacheEntry));
        if (likely(entries)) {
            __pyx_code_cache.entries = entries;
            __pyx_code_cache.max_count = 64;
            __pyx_code_cache.count = 1;
            entries[0].code_line = code_line;
            entries[0].code_object = code_object;
            Py_INCREF(code_object);
        }
        return;
    }
    pos = __pyx_bisect_code_objects(__pyx_code_cache.entries, __pyx_code_cache.count, code_line);
    if ((pos < __pyx_code_cache.count) && unlikely(__pyx_code_cache.entries[pos].code_line == code_line)) {
        PyCodeObject* tmp = entries[pos].code_object;
        entries[pos].code_object = code_object;
        Py_DECREF(tmp);
        return;
    }
    if (__pyx_code_cache.count == __pyx_code_cache.max_count) {
        int new_max = __pyx_code_cache.max_count + 64;
        entries = (__Pyx_CodeObjectCacheEntry*)PyMem_Realloc(
            __pyx_code_cache.entries, (size_t)new_max*sizeof(__Pyx_CodeObjectCacheEntry));
        if (unlikely(!entries)) {
            return;
        }
        __pyx_code_cache.entries = entries;
        __pyx_code_cache.max_count = new_max;
    }
    for (i=__pyx_code_cache.count; i>pos; i--) {
        entries[i] = entries[i-1];
    }
    entries[pos].code_line = code_line;
    entries[pos].code_object = code_object;
    __pyx_code_cache.count++;
    Py_INCREF(code_object);
}

#include "compile.h"
#include "frameobject.h"
#include "traceback.h"
static PyCodeObject* __Pyx_CreateCodeObjectForTraceback(
            const char *funcname, int c_line,
            int py_line, const char *filename) {
    PyCodeObject *py_code = 0;
    PyObject *py_srcfile = 0;
    PyObject *py_funcname = 0;
    #if PY_MAJOR_VERSION < 3
    py_srcfile = PyString_FromString(filename);
    #else
    py_srcfile = PyUnicode_FromString(filename);
    #endif
    if (!py_srcfile) goto bad;
    if (c_line) {
        #if PY_MAJOR_VERSION < 3
        py_funcname = PyString_FromFormat( "%s (%s:%d)", funcname, __pyx_cfilenm, c_line);
        #else
        py_funcname = PyUnicode_FromFormat( "%s (%s:%d)", funcname, __pyx_cfilenm, c_line);
        #endif
    }
    else {
        #if PY_MAJOR_VERSION < 3
        py_funcname = PyString_FromString(funcname);
        #else
        py_funcname = PyUnicode_FromString(funcname);
        #endif
    }
    if (!py_funcname) goto bad;
    py_code = __Pyx_PyCode_New(
        0,
        0,
        0,
        0,
        0,
        __pyx_empty_bytes, /*PyObject *code,*/
        __pyx_empty_tuple, /*PyObject *consts,*/
        __pyx_empty_tuple, /*PyObject *names,*/
        __pyx_empty_tuple, /*PyObject *varnames,*/
        __pyx_empty_tuple, /*PyObject *freevars,*/
        __pyx_empty_tuple, /*PyObject *cellvars,*/
        py_srcfile,   /*PyObject *filename,*/
        py_funcname,  /*PyObject *name,*/
        py_line,
        __pyx_empty_bytes  /*PyObject *lnotab*/
    );
    Py_DECREF(py_srcfile);
    Py_DECREF(py_funcname);
    return py_code;
bad:
    Py_XDECREF(py_srcfile);
    Py_XDECREF(py_funcname);
    return NULL;
}
static void __Pyx_AddTraceback(const char *funcname, int c_line,
                               int py_line, const char *filename) {
    PyCodeObject *py_code = 0;
    PyFrameObject *py_frame = 0;
    py_code = __pyx_find_code_object(c_line ? c_line : py_line);
    if (!py_code) {
        py_code = __Pyx_CreateCodeObjectForTraceback(
            funcname, c_line, py_line, filename);
        if (!py_code) goto bad;
        __pyx_insert_code_object(c_line ? c_line : py_line, py_code);
    }
    py_frame = PyFrame_New(
        PyThreadState_GET(), /*PyThreadState *tstate,*/
        py_code,             /*PyCodeObject *code,*/
        __pyx_d,      /*PyObject *globals,*/
        0                    /*PyObject *locals*/
    );
    if (!py_frame) goto bad;
    py_frame->f_lineno = py_line;
    PyTraceBack_Here(py_frame);
bad:
    Py_XDECREF(py_code);
    Py_XDECREF(py_frame);
}

static PyObject *__Pyx_Import(PyObject *name, PyObject *from_list, int level) {
    PyObject *empty_list = 0;
    PyObject *module = 0;
    PyObject *global_dict = 0;
    PyObject *empty_dict = 0;
    PyObject *list;
    #if PY_VERSION_HEX < 0x03030000
    PyObject *py_import;
    py_import = __Pyx_PyObject_GetAttrStr(__pyx_b, __pyx_n_s_import);
    if (!py_import)
        goto bad;
    #endif
    if (from_list)
        list = from_list;
    else {
        empty_list = PyList_New(0);
        if (!empty_list)
            goto bad;
        list = empty_list;
    }
    global_dict = PyModule_GetDict(__pyx_m);
    if (!global_dict)
        goto bad;
    empty_dict = PyDict_New();
    if (!empty_dict)
        goto bad;
    {
        #if PY_MAJOR_VERSION >= 3
        if (level == -1) {
            if (strchr(__Pyx_MODULE_NAME, '.')) {
                #if PY_VERSION_HEX < 0x03030000
                PyObject *py_level = PyInt_FromLong(1);
                if (!py_level)
                    goto bad;
                module = PyObject_CallFunctionObjArgs(py_import,
                    name, global_dict, empty_dict, list, py_level, NULL);
                Py_DECREF(py_level);
                #else
                module = PyImport_ImportModuleLevelObject(
                    name, global_dict, empty_dict, list, 1);
                #endif
                if (!module) {
                    if (!PyErr_ExceptionMatches(PyExc_ImportError))
                        goto bad;
                    PyErr_Clear();
                }
            }
            level = 0;
        }
        #endif
        if (!module) {
            #if PY_VERSION_HEX < 0x03030000
            PyObject *py_level = PyInt_FromLong(level);
            if (!py_level)
                goto bad;
            module = PyObject_CallFunctionObjArgs(py_import,
                name, global_dict, empty_dict, list, py_level, NULL);
            Py_DECREF(py_level);
            #else
            module = PyImport_ImportModuleLevelObject(
                name, global_dict, empty_dict, list, level);
            #endif
        }
    }
bad:
    #if PY_VERSION_HEX < 0x03030000
    Py_XDECREF(py_import);
    #endif
    Py_XDECREF(empty_list);
    Py_XDECREF(empty_dict);
    return module;
}

static CYTHON_INLINE PyObject* __Pyx_PyInt_From_uint32_t(uint32_t value) {
    const uint32_t neg_one = (uint32_t) -1, const_zero = 0;
    const int is_unsigned = neg_one > const_zero;
    if (is_unsigned) {
        if (sizeof(uint32_t) < sizeof(long)) {
            return PyInt_FromLong((long) value);
        } else if (sizeof(uint32_t) <= sizeof(unsigned long)) {
            return PyLong_FromUnsignedLong((unsigned long) value);
        } else if (sizeof(uint32_t) <= sizeof(unsigned long long)) {
            return PyLong_FromUnsignedLongLong((unsigned long long) value);
        }
    } else {
        if (sizeof(uint32_t) <= sizeof(long)) {
            return PyInt_FromLong((long) value);
        } else if (sizeof(uint32_t) <= sizeof(long long)) {
            return PyLong_FromLongLong((long long) value);
        }
    }
    {
        int one = 1; int little = (int)*(unsigned char *)&one;
        unsigned char *bytes = (unsigned char *)&value;
        return _PyLong_FromByteArray(bytes, sizeof(uint32_t),
                                     little, !is_unsigned);
    }
}

#define __PYX_VERIFY_RETURN_INT(target_type, func_type, func_value)       \
    {                                                                     \
        func_type value = func_value;                                     \
        if (sizeof(target_type) < sizeof(func_type)) {                    \
            if (unlikely(value != (func_type) (target_type) value)) {     \
                func_type zero = 0;                                       \
                if (is_unsigned && unlikely(value < zero))                \
                    goto raise_neg_overflow;                              \
                else                                                      \
                    goto raise_overflow;                                  \
            }                                                             \
        }                                                                 \
        return (target_type) value;                                       \
    }

#if CYTHON_COMPILING_IN_CPYTHON && PY_MAJOR_VERSION >= 3
 #if CYTHON_USE_PYLONG_INTERNALS
  #include "longintrepr.h"
 #endif
#endif

static CYTHON_INLINE int __Pyx_PyInt_As_int(PyObject *x) {
    const int neg_one = (int) -1, const_zero = 0;
    const int is_unsigned = neg_one > const_zero;
#if PY_MAJOR_VERSION < 3
    if (likely(PyInt_Check(x))) {
        if (sizeof(int) < sizeof(long)) {
            __PYX_VERIFY_RETURN_INT(int, long, PyInt_AS_LONG(x))
        } else {
            long val = PyInt_AS_LONG(x);
            if (is_unsigned && unlikely(val < 0)) {
                goto raise_neg_overflow;
            }
            return (int) val;
        }
    } else
#endif
    if (likely(PyLong_Check(x))) {
        if (is_unsigned) {
#if CYTHON_COMPILING_IN_CPYTHON && PY_MAJOR_VERSION >= 3
 #if CYTHON_USE_PYLONG_INTERNALS
            switch (Py_SIZE(x)) {
                case  0: return 0;
                case  1: __PYX_VERIFY_RETURN_INT(int, digit, ((PyLongObject*)x)->ob_digit[0]);
            }
 #endif
#endif
            if (unlikely(Py_SIZE(x) < 0)) {
                goto raise_neg_overflow;
            }
            if (sizeof(int) <= sizeof(unsigned long)) {
                __PYX_VERIFY_RETURN_INT(int, unsigned long, PyLong_AsUnsignedLong(x))
            } else if (sizeof(int) <= sizeof(unsigned long long)) {
                __PYX_VERIFY_RETURN_INT(int, unsigned long long, PyLong_AsUnsignedLongLong(x))
            }
        } else {
#if CYTHON_COMPILING_IN_CPYTHON && PY_MAJOR_VERSION >= 3
 #if CYTHON_USE_PYLONG_INTERNALS
            switch (Py_SIZE(x)) {
                case  0: return 0;
                case  1: __PYX_VERIFY_RETURN_INT(int,  digit, +(((PyLongObject*)x)->ob_digit[0]));
                case -1: __PYX_VERIFY_RETURN_INT(int, sdigit, -(sdigit) ((PyLongObject*)x)->ob_digit[0]);
            }
 #endif
#endif
            if (sizeof(int) <= sizeof(long)) {
                __PYX_VERIFY_RETURN_INT(int, long, PyLong_AsLong(x))
            } else if (sizeof(int) <= sizeof(long long)) {
                __PYX_VERIFY_RETURN_INT(int, long long, PyLong_AsLongLong(x))
            }
        }
        {
#if CYTHON_COMPILING_IN_PYPY && !defined(_PyLong_AsByteArray)
            PyErr_SetString(PyExc_RuntimeError,
                            "_PyLong_AsByteArray() not available in PyPy, cannot convert large numbers");
#else
            int val;
            PyObject *v = __Pyx_PyNumber_Int(x);
 #if PY_MAJOR_VERSION < 3
            if (likely(v) && !PyLong_Check(v)) {
                PyObject *tmp = v;
                v = PyNumber_Long(tmp);
                Py_DECREF(tmp);
            }
 #endif
            if (likely(v)) {
                int one = 1; int is_little = (int)*(unsigned char *)&one;
                unsigned char *bytes = (unsigned char *)&val;
                int ret = _PyLong_AsByteArray((PyLongObject *)v,
                                              bytes, sizeof(val),
                                              is_little, !is_unsigned);
                Py_DECREF(v);
                if (likely(!ret))
                    return val;
            }
#endif
            return (int) -1;
        }
    } else {
        int val;
        PyObject *tmp = __Pyx_PyNumber_Int(x);
        if (!tmp) return (int) -1;
        val = __Pyx_PyInt_As_int(tmp);
        Py_DECREF(tmp);
        return val;
    }
raise_overflow:
    PyErr_SetString(PyExc_OverflowError,
        "value too large to convert to int");
    return (int) -1;
raise_neg_overflow:
    PyErr_SetString(PyExc_OverflowError,
        "can't convert negative value to int");
    return (int) -1;
}

static CYTHON_INLINE PyObject* __Pyx_PyInt_From_long(long value) {
    const long neg_one = (long) -1, const_zero = 0;
    const int is_unsigned = neg_one > const_zero;
    if (is_unsigned) {
        if (sizeof(long) < sizeof(long)) {
            return PyInt_FromLong((long) value);
        } else if (sizeof(long) <= sizeof(unsigned long)) {
            return PyLong_FromUnsignedLong((unsigned long) value);
        } else if (sizeof(long) <= sizeof(unsigned long long)) {
            return PyLong_FromUnsignedLongLong((unsigned long long) value);
        }
    } else {
        if (sizeof(long) <= sizeof(long)) {
            return PyInt_FromLong((long) value);
        } else if (sizeof(long) <= sizeof(long long)) {
            return PyLong_FromLongLong((long long) value);
        }
    }
    {
        int one = 1; int little = (int)*(unsigned char *)&one;
        unsigned char *bytes = (unsigned char *)&value;
        return _PyLong_FromByteArray(bytes, sizeof(long),
                                     little, !is_unsigned);
    }
}

static CYTHON_INLINE long __Pyx_PyInt_As_long(PyObject *x) {
    const long neg_one = (long) -1, const_zero = 0;
    const int is_unsigned = neg_one > const_zero;
#if PY_MAJOR_VERSION < 3
    if (likely(PyInt_Check(x))) {
        if (sizeof(long) < sizeof(long)) {
            __PYX_VERIFY_RETURN_INT(long, long, PyInt_AS_LONG(x))
        } else {
            long val = PyInt_AS_LONG(x);
            if (is_unsigned && unlikely(val < 0)) {
                goto raise_neg_overflow;
            }
            return (long) val;
        }
    } else
#endif
    if (likely(PyLong_Check(x))) {
        if (is_unsigned) {
#if CYTHON_COMPILING_IN_CPYTHON && PY_MAJOR_VERSION >= 3
 #if CYTHON_USE_PYLONG_INTERNALS
            switch (Py_SIZE(x)) {
                case  0: return 0;
                case  1: __PYX_VERIFY_RETURN_INT(long, digit, ((PyLongObject*)x)->ob_digit[0]);
            }
 #endif
#endif
            if (unlikely(Py_SIZE(x) < 0)) {
                goto raise_neg_overflow;
            }
            if (sizeof(long) <= sizeof(unsigned long)) {
                __PYX_VERIFY_RETURN_INT(long, unsigned long, PyLong_AsUnsignedLong(x))
            } else if (sizeof(long) <= sizeof(unsigned long long)) {
                __PYX_VERIFY_RETURN_INT(long, unsigned long long, PyLong_AsUnsignedLongLong(x))
            }
        } else {
#if CYTHON_COMPILING_IN_CPYTHON && PY_MAJOR_VERSION >= 3
 #if CYTHON_USE_PYLONG_INTERNALS
            switch (Py_SIZE(x)) {
                case  0: return 0;
                case  1: __PYX_VERIFY_RETURN_INT(long,  digit, +(((PyLongObject*)x)->ob_digit[0]));
                case -1: __PYX_VERIFY_RETURN_INT(long, sdigit, -(sdigit) ((PyLongObject*)x)->ob_digit[0]);
            }
 #endif
#endif
            if (sizeof(long) <= sizeof(long)) {
                __PYX_VERIFY_RETURN_INT(long, long, PyLong_AsLong(x))
            } else if (sizeof(long) <= sizeof(long long)) {
                __PYX_VERIFY_RETURN_INT(long, long long, PyLong_AsLongLong(x))
            }
        }
        {
#if CYTHON_COMPILING_IN_PYPY && !defined(_PyLong_AsByteArray)
            PyErr_SetString(PyExc_RuntimeError,
                            "_PyLong_AsByteArray() not available in PyPy, cannot convert large numbers");
#else
            long val;
            PyObject *v = __Pyx_PyNumber_Int(x);
 #if PY_MAJOR_VERSION < 3
            if (likely(v) && !PyLong_Check(v)) {
                PyObject *tmp = v;
                v = PyNumber_Long(tmp);
                Py_DECREF(tmp);
            }
 #endif
            if (likely(v)) {
                int one = 1; int is_little = (int)*(unsigned char *)&one;
                unsigned char *bytes = (unsigned char *)&val;
                int ret = _PyLong_AsByteArray((PyLongObject *)v,
                                              bytes, sizeof(val),
                                              is_little, !is_unsigned);
                Py_DECREF(v);
                if (likely(!ret))
                    return val;
            }
#endif
            return (long) -1;
        }
    } else {
        long val;
        PyObject *tmp = __Pyx_PyNumber_Int(x);
        if (!tmp) return (long) -1;
        val = __Pyx_PyInt_As_long(tmp);
        Py_DECREF(tmp);
        return val;
    }
raise_overflow:
    PyErr_SetString(PyExc_OverflowError,
        "value too large to convert to long");
    return (long) -1;
raise_neg_overflow:
    PyErr_SetString(PyExc_OverflowError,
        "can't convert negative value to long");
    return (long) -1;
}

static int __Pyx_check_binary_version(void) {
    char ctversion[4], rtversion[4];
    PyOS_snprintf(ctversion, 4, "%d.%d", PY_MAJOR_VERSION, PY_MINOR_VERSION);
    PyOS_snprintf(rtversion, 4, "%s", Py_GetVersion());
    if (ctversion[0] != rtversion[0] || ctversion[2] != rtversion[2]) {
        char message[200];
        PyOS_snprintf(message, sizeof(message),
                      "compiletime version %s of module '%.100s' "
                      "does not match runtime version %s",
                      ctversion, __Pyx_MODULE_NAME, rtversion);
        return PyErr_WarnEx(NULL, message, 1);
    }
    return 0;
}

#ifndef __PYX_HAVE_RT_ImportModule
#define __PYX_HAVE_RT_ImportModule
static PyObject *__Pyx_ImportModule(const char *name) {
    PyObject *py_name = 0;
    PyObject *py_module = 0;
    py_name = __Pyx_PyIdentifier_FromString(name);
    if (!py_name)
        goto bad;
    py_module = PyImport_Import(py_name);
    Py_DECREF(py_name);
    return py_module;
bad:
    Py_XDECREF(py_name);
    return 0;
}
#endif

#ifndef __PYX_HAVE_RT_ImportType
#define __PYX_HAVE_RT_ImportType
static PyTypeObject *__Pyx_ImportType(const char *module_name, const char *class_name,
    size_t size, int strict)
{
    PyObject *py_module = 0;
    PyObject *result = 0;
    PyObject *py_name = 0;
    char warning[200];
    Py_ssize_t basicsize;
#ifdef Py_LIMITED_API
    PyObject *py_basicsize;
#endif
    py_module = __Pyx_ImportModule(module_name);
    if (!py_module)
        goto bad;
    py_name = __Pyx_PyIdentifier_FromString(class_name);
    if (!py_name)
        goto bad;
    result = PyObject_GetAttr(py_module, py_name);
    Py_DECREF(py_name);
    py_name = 0;
    Py_DECREF(py_module);
    py_module = 0;
    if (!result)
        goto bad;
    if (!PyType_Check(result)) {
        PyErr_Format(PyExc_TypeError,
            "%.200s.%.200s is not a type object",
            module_name, class_name);
        goto bad;
    }
#ifndef Py_LIMITED_API
    basicsize = ((PyTypeObject *)result)->tp_basicsize;
#else
    py_basicsize = PyObject_GetAttrString(result, "__basicsize__");
    if (!py_basicsize)
        goto bad;
    basicsize = PyLong_AsSsize_t(py_basicsize);
    Py_DECREF(py_basicsize);
    py_basicsize = 0;
    if (basicsize == (Py_ssize_t)-1 && PyErr_Occurred())
        goto bad;
#endif
    if (!strict && (size_t)basicsize > size) {
        PyOS_snprintf(warning, sizeof(warning),
            "%s.%s size changed, may indicate binary incompatibility",
            module_name, class_name);
        if (PyErr_WarnEx(NULL, warning, 0) < 0) goto bad;
    }
    else if ((size_t)basicsize != size) {
        PyErr_Format(PyExc_ValueError,
            "%.200s.%.200s has the wrong size, try recompiling",
            module_name, class_name);
        goto bad;
    }
    return (PyTypeObject *)result;
bad:
    Py_XDECREF(py_module);
    Py_XDECREF(result);
    return NULL;
}
#endif

static int __Pyx_InitStrings(__Pyx_StringTabEntry *t) {
    while (t->p) {
        #if PY_MAJOR_VERSION < 3
        if (t->is_unicode) {
            *t->p = PyUnicode_DecodeUTF8(t->s, t->n - 1, NULL);
        } else if (t->intern) {
            *t->p = PyString_InternFromString(t->s);
        } else {
            *t->p = PyString_FromStringAndSize(t->s, t->n - 1);
        }
        #else
        if (t->is_unicode | t->is_str) {
            if (t->intern) {
                *t->p = PyUnicode_InternFromString(t->s);
            } else if (t->encoding) {
                *t->p = PyUnicode_Decode(t->s, t->n - 1, t->encoding, NULL);
            } else {
                *t->p = PyUnicode_FromStringAndSize(t->s, t->n - 1);
            }
        } else {
            *t->p = PyBytes_FromStringAndSize(t->s, t->n - 1);
        }
        #endif
        if (!*t->p)
            return -1;
        ++t;
    }
    return 0;
}

static CYTHON_INLINE PyObject* __Pyx_PyUnicode_FromString(const char* c_str) {
    return __Pyx_PyUnicode_FromStringAndSize(c_str, (Py_ssize_t)strlen(c_str));
}
static CYTHON_INLINE char* __Pyx_PyObject_AsString(PyObject* o) {
    Py_ssize_t ignore;
    return __Pyx_PyObject_AsStringAndSize(o, &ignore);
}
static CYTHON_INLINE char* __Pyx_PyObject_AsStringAndSize(PyObject* o, Py_ssize_t *length) {
#if __PYX_DEFAULT_STRING_ENCODING_IS_ASCII || __PYX_DEFAULT_STRING_ENCODING_IS_DEFAULT
    if (
#if PY_MAJOR_VERSION < 3 && __PYX_DEFAULT_STRING_ENCODING_IS_ASCII
            __Pyx_sys_getdefaultencoding_not_ascii &&
#endif
            PyUnicode_Check(o)) {
#if PY_VERSION_HEX < 0x03030000
        char* defenc_c;
        PyObject* defenc = _PyUnicode_AsDefaultEncodedString(o, NULL);
        if (!defenc) return NULL;
        defenc_c = PyBytes_AS_STRING(defenc);
#if __PYX_DEFAULT_STRING_ENCODING_IS_ASCII
        {
            char* end = defenc_c + PyBytes_GET_SIZE(defenc);
            char* c;
            for (c = defenc_c; c < end; c++) {
                if ((unsigned char) (*c) >= 128) {
                    PyUnicode_AsASCIIString(o);
                    return NULL;
                }
            }
        }
#endif
        *length = PyBytes_GET_SIZE(defenc);
        return defenc_c;
#else
        if (__Pyx_PyUnicode_READY(o) == -1) return NULL;
#if __PYX_DEFAULT_STRING_ENCODING_IS_ASCII
        if (PyUnicode_IS_ASCII(o)) {
            *length = PyUnicode_GET_LENGTH(o);
            return PyUnicode_AsUTF8(o);
        } else {
            PyUnicode_AsASCIIString(o);
            return NULL;
        }
#else
        return PyUnicode_AsUTF8AndSize(o, length);
#endif
#endif
    } else
#endif
#if !CYTHON_COMPILING_IN_PYPY
    if (PyByteArray_Check(o)) {
        *length = PyByteArray_GET_SIZE(o);
        return PyByteArray_AS_STRING(o);
    } else
#endif
    {
        char* result;
        int r = PyBytes_AsStringAndSize(o, &result, length);
        if (unlikely(r < 0)) {
            return NULL;
        } else {
            return result;
        }
    }
}
static CYTHON_INLINE int __Pyx_PyObject_IsTrue(PyObject* x) {
   int is_true = x == Py_True;
   if (is_true | (x == Py_False) | (x == Py_None)) return is_true;
   else return PyObject_IsTrue(x);
}
static CYTHON_INLINE PyObject* __Pyx_PyNumber_Int(PyObject* x) {
  PyNumberMethods *m;
  const char *name = NULL;
  PyObject *res = NULL;
#if PY_MAJOR_VERSION < 3
  if (PyInt_Check(x) || PyLong_Check(x))
#else
  if (PyLong_Check(x))
#endif
    return Py_INCREF(x), x;
  m = Py_TYPE(x)->tp_as_number;
#if PY_MAJOR_VERSION < 3
  if (m && m->nb_int) {
    name = "int";
    res = PyNumber_Int(x);
  }
  else if (m && m->nb_long) {
    name = "long";
    res = PyNumber_Long(x);
  }
#else
  if (m && m->nb_int) {
    name = "int";
    res = PyNumber_Long(x);
  }
#endif
  if (res) {
#if PY_MAJOR_VERSION < 3
    if (!PyInt_Check(res) && !PyLong_Check(res)) {
#else
    if (!PyLong_Check(res)) {
#endif
      PyErr_Format(PyExc_TypeError,
                   "__%.4s__ returned non-%.4s (type %.200s)",
                   name, name, Py_TYPE(res)->tp_name);
      Py_DECREF(res);
      return NULL;
    }
  }
  else if (!PyErr_Occurred()) {
    PyErr_SetString(PyExc_TypeError,
                    "an integer is required");
  }
  return res;
}
static CYTHON_INLINE Py_ssize_t __Pyx_PyIndex_AsSsize_t(PyObject* b) {
  Py_ssize_t ival;
  PyObject *x;
#if PY_MAJOR_VERSION < 3
  if (likely(PyInt_CheckExact(b)))
      return PyInt_AS_LONG(b);
#endif
  if (likely(PyLong_CheckExact(b))) {
    #if CYTHON_COMPILING_IN_CPYTHON && PY_MAJOR_VERSION >= 3
     #if CYTHON_USE_PYLONG_INTERNALS
       switch (Py_SIZE(b)) {
       case -1: return -(sdigit)((PyLongObject*)b)->ob_digit[0];
       case  0: return 0;
       case  1: return ((PyLongObject*)b)->ob_digit[0];
       }
     #endif
    #endif
    return PyLong_AsSsize_t(b);
  }
  x = PyNumber_Index(b);
  if (!x) return -1;
  ival = PyInt_AsSsize_t(x);
  Py_DECREF(x);
  return ival;
}
static CYTHON_INLINE PyObject * __Pyx_PyInt_FromSize_t(size_t ival) {
    return PyInt_FromSize_t(ival);
}


#endif /* Py_PYTHON_H */
