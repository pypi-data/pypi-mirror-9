/* Generated by Cython 0.21.2 */

#define PY_SSIZE_T_CLEAN
#ifndef CYTHON_USE_PYLONG_INTERNALS
#ifdef PYLONG_BITS_IN_DIGIT
#define CYTHON_USE_PYLONG_INTERNALS 0
#else
#include "pyconfig.h"
#ifdef PYLONG_BITS_IN_DIGIT
#define CYTHON_USE_PYLONG_INTERNALS 1
#else
#define CYTHON_USE_PYLONG_INTERNALS 0
#endif
#endif
#endif
#include "Python.h"
#ifndef Py_PYTHON_H
    #error Python headers needed to compile C extensions, please install development version of Python.
#elif PY_VERSION_HEX < 0x02060000 || (0x03000000 <= PY_VERSION_HEX && PY_VERSION_HEX < 0x03020000)
    #error Cython requires Python 2.6+ or Python 3.2+.
#else
#define CYTHON_ABI "0_21_2"
#include <stddef.h>
#ifndef offsetof
#define offsetof(type, member) ( (size_t) & ((type*)0) -> member )
#endif
#if !defined(WIN32) && !defined(MS_WINDOWS)
  #ifndef __stdcall
    #define __stdcall
  #endif
  #ifndef __cdecl
    #define __cdecl
  #endif
  #ifndef __fastcall
    #define __fastcall
  #endif
#endif
#ifndef DL_IMPORT
  #define DL_IMPORT(t) t
#endif
#ifndef DL_EXPORT
  #define DL_EXPORT(t) t
#endif
#ifndef PY_LONG_LONG
  #define PY_LONG_LONG LONG_LONG
#endif
#ifndef Py_HUGE_VAL
  #define Py_HUGE_VAL HUGE_VAL
#endif
#ifdef PYPY_VERSION
#define CYTHON_COMPILING_IN_PYPY 1
#define CYTHON_COMPILING_IN_CPYTHON 0
#else
#define CYTHON_COMPILING_IN_PYPY 0
#define CYTHON_COMPILING_IN_CPYTHON 1
#endif
#if CYTHON_COMPILING_IN_PYPY && PY_VERSION_HEX < 0x02070600
#define Py_OptimizeFlag 0
#endif
#define __PYX_BUILD_PY_SSIZE_T "n"
#define CYTHON_FORMAT_SSIZE_T "z"
#if PY_MAJOR_VERSION < 3
  #define __Pyx_BUILTIN_MODULE_NAME "__builtin__"
  #define __Pyx_PyCode_New(a, k, l, s, f, code, c, n, v, fv, cell, fn, name, fline, lnos) \
          PyCode_New(a+k, l, s, f, code, c, n, v, fv, cell, fn, name, fline, lnos)
  #define __Pyx_DefaultClassType PyClass_Type
#else
  #define __Pyx_BUILTIN_MODULE_NAME "builtins"
  #define __Pyx_PyCode_New(a, k, l, s, f, code, c, n, v, fv, cell, fn, name, fline, lnos) \
          PyCode_New(a, k, l, s, f, code, c, n, v, fv, cell, fn, name, fline, lnos)
  #define __Pyx_DefaultClassType PyType_Type
#endif
#if PY_MAJOR_VERSION >= 3
  #define Py_TPFLAGS_CHECKTYPES 0
  #define Py_TPFLAGS_HAVE_INDEX 0
  #define Py_TPFLAGS_HAVE_NEWBUFFER 0
#endif
#if PY_VERSION_HEX < 0x030400a1 && !defined(Py_TPFLAGS_HAVE_FINALIZE)
  #define Py_TPFLAGS_HAVE_FINALIZE 0
#endif
#if PY_VERSION_HEX > 0x03030000 && defined(PyUnicode_KIND)
  #define CYTHON_PEP393_ENABLED 1
  #define __Pyx_PyUnicode_READY(op)       (likely(PyUnicode_IS_READY(op)) ? \
                                              0 : _PyUnicode_Ready((PyObject *)(op)))
  #define __Pyx_PyUnicode_GET_LENGTH(u)   PyUnicode_GET_LENGTH(u)
  #define __Pyx_PyUnicode_READ_CHAR(u, i) PyUnicode_READ_CHAR(u, i)
  #define __Pyx_PyUnicode_KIND(u)         PyUnicode_KIND(u)
  #define __Pyx_PyUnicode_DATA(u)         PyUnicode_DATA(u)
  #define __Pyx_PyUnicode_READ(k, d, i)   PyUnicode_READ(k, d, i)
#else
  #define CYTHON_PEP393_ENABLED 0
  #define __Pyx_PyUnicode_READY(op)       (0)
  #define __Pyx_PyUnicode_GET_LENGTH(u)   PyUnicode_GET_SIZE(u)
  #define __Pyx_PyUnicode_READ_CHAR(u, i) ((Py_UCS4)(PyUnicode_AS_UNICODE(u)[i]))
  #define __Pyx_PyUnicode_KIND(u)         (sizeof(Py_UNICODE))
  #define __Pyx_PyUnicode_DATA(u)         ((void*)PyUnicode_AS_UNICODE(u))
  #define __Pyx_PyUnicode_READ(k, d, i)   ((void)(k), (Py_UCS4)(((Py_UNICODE*)d)[i]))
#endif
#if CYTHON_COMPILING_IN_PYPY
  #define __Pyx_PyUnicode_Concat(a, b)      PyNumber_Add(a, b)
  #define __Pyx_PyUnicode_ConcatSafe(a, b)  PyNumber_Add(a, b)
  #define __Pyx_PyFrozenSet_Size(s)         PyObject_Size(s)
#else
  #define __Pyx_PyUnicode_Concat(a, b)      PyUnicode_Concat(a, b)
  #define __Pyx_PyUnicode_ConcatSafe(a, b)  ((unlikely((a) == Py_None) || unlikely((b) == Py_None)) ? \
      PyNumber_Add(a, b) : __Pyx_PyUnicode_Concat(a, b))
  #define __Pyx_PyFrozenSet_Size(s)         PySet_Size(s)
#endif
#define __Pyx_PyString_FormatSafe(a, b)   ((unlikely((a) == Py_None)) ? PyNumber_Remainder(a, b) : __Pyx_PyString_Format(a, b))
#define __Pyx_PyUnicode_FormatSafe(a, b)  ((unlikely((a) == Py_None)) ? PyNumber_Remainder(a, b) : PyUnicode_Format(a, b))
#if PY_MAJOR_VERSION >= 3
  #define __Pyx_PyString_Format(a, b)  PyUnicode_Format(a, b)
#else
  #define __Pyx_PyString_Format(a, b)  PyString_Format(a, b)
#endif
#if PY_MAJOR_VERSION >= 3
  #define PyBaseString_Type            PyUnicode_Type
  #define PyStringObject               PyUnicodeObject
  #define PyString_Type                PyUnicode_Type
  #define PyString_Check               PyUnicode_Check
  #define PyString_CheckExact          PyUnicode_CheckExact
#endif
#if PY_MAJOR_VERSION >= 3
  #define __Pyx_PyBaseString_Check(obj) PyUnicode_Check(obj)
  #define __Pyx_PyBaseString_CheckExact(obj) PyUnicode_CheckExact(obj)
#else
  #define __Pyx_PyBaseString_Check(obj) (PyString_Check(obj) || PyUnicode_Check(obj))
  #define __Pyx_PyBaseString_CheckExact(obj) (PyString_CheckExact(obj) || PyUnicode_CheckExact(obj))
#endif
#ifndef PySet_CheckExact
  #define PySet_CheckExact(obj)        (Py_TYPE(obj) == &PySet_Type)
#endif
#define __Pyx_TypeCheck(obj, type) PyObject_TypeCheck(obj, (PyTypeObject *)type)
#if PY_MAJOR_VERSION >= 3
  #define PyIntObject                  PyLongObject
  #define PyInt_Type                   PyLong_Type
  #define PyInt_Check(op)              PyLong_Check(op)
  #define PyInt_CheckExact(op)         PyLong_CheckExact(op)
  #define PyInt_FromString             PyLong_FromString
  #define PyInt_FromUnicode            PyLong_FromUnicode
  #define PyInt_FromLong               PyLong_FromLong
  #define PyInt_FromSize_t             PyLong_FromSize_t
  #define PyInt_FromSsize_t            PyLong_FromSsize_t
  #define PyInt_AsLong                 PyLong_AsLong
  #define PyInt_AS_LONG                PyLong_AS_LONG
  #define PyInt_AsSsize_t              PyLong_AsSsize_t
  #define PyInt_AsUnsignedLongMask     PyLong_AsUnsignedLongMask
  #define PyInt_AsUnsignedLongLongMask PyLong_AsUnsignedLongLongMask
  #define PyNumber_Int                 PyNumber_Long
#endif
#if PY_MAJOR_VERSION >= 3
  #define PyBoolObject                 PyLongObject
#endif
#if PY_MAJOR_VERSION >= 3 && CYTHON_COMPILING_IN_PYPY
  #ifndef PyUnicode_InternFromString
    #define PyUnicode_InternFromString(s) PyUnicode_FromString(s)
  #endif
#endif
#if PY_VERSION_HEX < 0x030200A4
  typedef long Py_hash_t;
  #define __Pyx_PyInt_FromHash_t PyInt_FromLong
  #define __Pyx_PyInt_AsHash_t   PyInt_AsLong
#else
  #define __Pyx_PyInt_FromHash_t PyInt_FromSsize_t
  #define __Pyx_PyInt_AsHash_t   PyInt_AsSsize_t
#endif
#if PY_MAJOR_VERSION >= 3
  #define __Pyx_PyMethod_New(func, self, klass) ((self) ? PyMethod_New(func, self) : PyInstanceMethod_New(func))
#else
  #define __Pyx_PyMethod_New(func, self, klass) PyMethod_New(func, self, klass)
#endif
#ifndef CYTHON_INLINE
  #if defined(__GNUC__)
    #define CYTHON_INLINE __inline__
  #elif defined(_MSC_VER)
    #define CYTHON_INLINE __inline
  #elif defined (__STDC_VERSION__) && __STDC_VERSION__ >= 199901L
    #define CYTHON_INLINE inline
  #else
    #define CYTHON_INLINE
  #endif
#endif
#ifndef CYTHON_RESTRICT
  #if defined(__GNUC__)
    #define CYTHON_RESTRICT __restrict__
  #elif defined(_MSC_VER) && _MSC_VER >= 1400
    #define CYTHON_RESTRICT __restrict
  #elif defined (__STDC_VERSION__) && __STDC_VERSION__ >= 199901L
    #define CYTHON_RESTRICT restrict
  #else
    #define CYTHON_RESTRICT
  #endif
#endif
#ifdef NAN
#define __PYX_NAN() ((float) NAN)
#else
static CYTHON_INLINE float __PYX_NAN() {
  /* Initialize NaN. The sign is irrelevant, an exponent with all bits 1 and
   a nonzero mantissa means NaN. If the first bit in the mantissa is 1, it is
   a quiet NaN. */
  float value;
  memset(&value, 0xFF, sizeof(value));
  return value;
}
#endif
#ifdef __cplusplus
template<typename T>
void __Pyx_call_destructor(T* x) {
    x->~T();
}
#endif


#if PY_MAJOR_VERSION >= 3
  #define __Pyx_PyNumber_Divide(x,y)         PyNumber_TrueDivide(x,y)
  #define __Pyx_PyNumber_InPlaceDivide(x,y)  PyNumber_InPlaceTrueDivide(x,y)
#else
  #define __Pyx_PyNumber_Divide(x,y)         PyNumber_Divide(x,y)
  #define __Pyx_PyNumber_InPlaceDivide(x,y)  PyNumber_InPlaceDivide(x,y)
#endif

#ifndef __PYX_EXTERN_C
  #ifdef __cplusplus
    #define __PYX_EXTERN_C extern "C"
  #else
    #define __PYX_EXTERN_C extern
  #endif
#endif

#if defined(WIN32) || defined(MS_WINDOWS)
#define _USE_MATH_DEFINES
#endif
#include <math.h>
#define __PYX_HAVE__thinc__weights
#define __PYX_HAVE_API__thinc__weights
#include "stdint.h"
#include "math.h"
#include "string.h"
#ifdef _OPENMP
#include <omp.h>
#endif /* _OPENMP */

#ifdef PYREX_WITHOUT_ASSERTIONS
#define CYTHON_WITHOUT_ASSERTIONS
#endif

#ifndef CYTHON_UNUSED
# if defined(__GNUC__)
#   if !(defined(__cplusplus)) || (__GNUC__ > 3 || (__GNUC__ == 3 && __GNUC_MINOR__ >= 4))
#     define CYTHON_UNUSED __attribute__ ((__unused__))
#   else
#     define CYTHON_UNUSED
#   endif
# elif defined(__ICC) || (defined(__INTEL_COMPILER) && !defined(_MSC_VER))
#   define CYTHON_UNUSED __attribute__ ((__unused__))
# else
#   define CYTHON_UNUSED
# endif
#endif
typedef struct {PyObject **p; char *s; const Py_ssize_t n; const char* encoding;
                const char is_unicode; const char is_str; const char intern; } __Pyx_StringTabEntry;

#define __PYX_DEFAULT_STRING_ENCODING_IS_ASCII 0
#define __PYX_DEFAULT_STRING_ENCODING_IS_DEFAULT 0
#define __PYX_DEFAULT_STRING_ENCODING ""
#define __Pyx_PyObject_FromString __Pyx_PyBytes_FromString
#define __Pyx_PyObject_FromStringAndSize __Pyx_PyBytes_FromStringAndSize
#define __Pyx_fits_Py_ssize_t(v, type, is_signed)  (    \
    (sizeof(type) < sizeof(Py_ssize_t))  ||             \
    (sizeof(type) > sizeof(Py_ssize_t) &&               \
          likely(v < (type)PY_SSIZE_T_MAX ||            \
                 v == (type)PY_SSIZE_T_MAX)  &&         \
          (!is_signed || likely(v > (type)PY_SSIZE_T_MIN ||       \
                                v == (type)PY_SSIZE_T_MIN)))  ||  \
    (sizeof(type) == sizeof(Py_ssize_t) &&              \
          (is_signed || likely(v < (type)PY_SSIZE_T_MAX ||        \
                               v == (type)PY_SSIZE_T_MAX)))  )
static CYTHON_INLINE char* __Pyx_PyObject_AsString(PyObject*);
static CYTHON_INLINE char* __Pyx_PyObject_AsStringAndSize(PyObject*, Py_ssize_t* length);
#define __Pyx_PyByteArray_FromString(s) PyByteArray_FromStringAndSize((const char*)s, strlen((const char*)s))
#define __Pyx_PyByteArray_FromStringAndSize(s, l) PyByteArray_FromStringAndSize((const char*)s, l)
#define __Pyx_PyBytes_FromString        PyBytes_FromString
#define __Pyx_PyBytes_FromStringAndSize PyBytes_FromStringAndSize
static CYTHON_INLINE PyObject* __Pyx_PyUnicode_FromString(const char*);
#if PY_MAJOR_VERSION < 3
    #define __Pyx_PyStr_FromString        __Pyx_PyBytes_FromString
    #define __Pyx_PyStr_FromStringAndSize __Pyx_PyBytes_FromStringAndSize
#else
    #define __Pyx_PyStr_FromString        __Pyx_PyUnicode_FromString
    #define __Pyx_PyStr_FromStringAndSize __Pyx_PyUnicode_FromStringAndSize
#endif
#define __Pyx_PyObject_AsSString(s)    ((signed char*) __Pyx_PyObject_AsString(s))
#define __Pyx_PyObject_AsUString(s)    ((unsigned char*) __Pyx_PyObject_AsString(s))
#define __Pyx_PyObject_FromUString(s)  __Pyx_PyObject_FromString((const char*)s)
#define __Pyx_PyBytes_FromUString(s)   __Pyx_PyBytes_FromString((const char*)s)
#define __Pyx_PyByteArray_FromUString(s)   __Pyx_PyByteArray_FromString((const char*)s)
#define __Pyx_PyStr_FromUString(s)     __Pyx_PyStr_FromString((const char*)s)
#define __Pyx_PyUnicode_FromUString(s) __Pyx_PyUnicode_FromString((const char*)s)
#if PY_MAJOR_VERSION < 3
static CYTHON_INLINE size_t __Pyx_Py_UNICODE_strlen(const Py_UNICODE *u)
{
    const Py_UNICODE *u_end = u;
    while (*u_end++) ;
    return (size_t)(u_end - u - 1);
}
#else
#define __Pyx_Py_UNICODE_strlen Py_UNICODE_strlen
#endif
#define __Pyx_PyUnicode_FromUnicode(u)       PyUnicode_FromUnicode(u, __Pyx_Py_UNICODE_strlen(u))
#define __Pyx_PyUnicode_FromUnicodeAndLength PyUnicode_FromUnicode
#define __Pyx_PyUnicode_AsUnicode            PyUnicode_AsUnicode
#define __Pyx_Owned_Py_None(b) (Py_INCREF(Py_None), Py_None)
#define __Pyx_PyBool_FromLong(b) ((b) ? (Py_INCREF(Py_True), Py_True) : (Py_INCREF(Py_False), Py_False))
static CYTHON_INLINE int __Pyx_PyObject_IsTrue(PyObject*);
static CYTHON_INLINE PyObject* __Pyx_PyNumber_Int(PyObject* x);
static CYTHON_INLINE Py_ssize_t __Pyx_PyIndex_AsSsize_t(PyObject*);
static CYTHON_INLINE PyObject * __Pyx_PyInt_FromSize_t(size_t);
#if CYTHON_COMPILING_IN_CPYTHON
#define __pyx_PyFloat_AsDouble(x) (PyFloat_CheckExact(x) ? PyFloat_AS_DOUBLE(x) : PyFloat_AsDouble(x))
#else
#define __pyx_PyFloat_AsDouble(x) PyFloat_AsDouble(x)
#endif
#define __pyx_PyFloat_AsFloat(x) ((float) __pyx_PyFloat_AsDouble(x))
#if PY_MAJOR_VERSION < 3 && __PYX_DEFAULT_STRING_ENCODING_IS_ASCII
static int __Pyx_sys_getdefaultencoding_not_ascii;
static int __Pyx_init_sys_getdefaultencoding_params(void) {
    PyObject* sys;
    PyObject* default_encoding = NULL;
    PyObject* ascii_chars_u = NULL;
    PyObject* ascii_chars_b = NULL;
    const char* default_encoding_c;
    sys = PyImport_ImportModule("sys");
    if (!sys) goto bad;
    default_encoding = PyObject_CallMethod(sys, (char*) (const char*) "getdefaultencoding", NULL);
    Py_DECREF(sys);
    if (!default_encoding) goto bad;
    default_encoding_c = PyBytes_AsString(default_encoding);
    if (!default_encoding_c) goto bad;
    if (strcmp(default_encoding_c, "ascii") == 0) {
        __Pyx_sys_getdefaultencoding_not_ascii = 0;
    } else {
        char ascii_chars[128];
        int c;
        for (c = 0; c < 128; c++) {
            ascii_chars[c] = c;
        }
        __Pyx_sys_getdefaultencoding_not_ascii = 1;
        ascii_chars_u = PyUnicode_DecodeASCII(ascii_chars, 128, NULL);
        if (!ascii_chars_u) goto bad;
        ascii_chars_b = PyUnicode_AsEncodedString(ascii_chars_u, default_encoding_c, NULL);
        if (!ascii_chars_b || !PyBytes_Check(ascii_chars_b) || memcmp(ascii_chars, PyBytes_AS_STRING(ascii_chars_b), 128) != 0) {
            PyErr_Format(
                PyExc_ValueError,
                "This module compiled with c_string_encoding=ascii, but default encoding '%.200s' is not a superset of ascii.",
                default_encoding_c);
            goto bad;
        }
        Py_DECREF(ascii_chars_u);
        Py_DECREF(ascii_chars_b);
    }
    Py_DECREF(default_encoding);
    return 0;
bad:
    Py_XDECREF(default_encoding);
    Py_XDECREF(ascii_chars_u);
    Py_XDECREF(ascii_chars_b);
    return -1;
}
#endif
#if __PYX_DEFAULT_STRING_ENCODING_IS_DEFAULT && PY_MAJOR_VERSION >= 3
#define __Pyx_PyUnicode_FromStringAndSize(c_str, size) PyUnicode_DecodeUTF8(c_str, size, NULL)
#else
#define __Pyx_PyUnicode_FromStringAndSize(c_str, size) PyUnicode_Decode(c_str, size, __PYX_DEFAULT_STRING_ENCODING, NULL)
#if __PYX_DEFAULT_STRING_ENCODING_IS_DEFAULT
static char* __PYX_DEFAULT_STRING_ENCODING;
static int __Pyx_init_sys_getdefaultencoding_params(void) {
    PyObject* sys;
    PyObject* default_encoding = NULL;
    char* default_encoding_c;
    sys = PyImport_ImportModule("sys");
    if (!sys) goto bad;
    default_encoding = PyObject_CallMethod(sys, (char*) (const char*) "getdefaultencoding", NULL);
    Py_DECREF(sys);
    if (!default_encoding) goto bad;
    default_encoding_c = PyBytes_AsString(default_encoding);
    if (!default_encoding_c) goto bad;
    __PYX_DEFAULT_STRING_ENCODING = (char*) malloc(strlen(default_encoding_c));
    if (!__PYX_DEFAULT_STRING_ENCODING) goto bad;
    strcpy(__PYX_DEFAULT_STRING_ENCODING, default_encoding_c);
    Py_DECREF(default_encoding);
    return 0;
bad:
    Py_XDECREF(default_encoding);
    return -1;
}
#endif
#endif


/* Test for GCC > 2.95 */
#if defined(__GNUC__)     && (__GNUC__ > 2 || (__GNUC__ == 2 && (__GNUC_MINOR__ > 95)))
  #define likely(x)   __builtin_expect(!!(x), 1)
  #define unlikely(x) __builtin_expect(!!(x), 0)
#else /* !__GNUC__ or GCC < 2.95 */
  #define likely(x)   (x)
  #define unlikely(x) (x)
#endif /* __GNUC__ */

static PyObject *__pyx_m;
static PyObject *__pyx_d;
static PyObject *__pyx_b;
static PyObject *__pyx_empty_tuple;
static PyObject *__pyx_empty_bytes;
static int __pyx_lineno;
static int __pyx_clineno = 0;
static const char * __pyx_cfilenm= __FILE__;
static const char *__pyx_filename;


static const char *__pyx_f[] = {
  "thinc/weights.pyx",
  ".env/lib/python2.7/site-packages/cymem/cymem.pxd",
  ".env/lib/python2.7/site-packages/preshed/maps.pxd",
  "thinc/features.pxd",
};

/* "thinc/typedefs.pxd":7
 * 
 * 
 * ctypedef float weight_t             # <<<<<<<<<<<<<<
 * ctypedef uint64_t atom_t
 * ctypedef uint64_t feat_t
 */
typedef float __pyx_t_5thinc_8typedefs_weight_t;

/* "thinc/typedefs.pxd":8
 * 
 * ctypedef float weight_t
 * ctypedef uint64_t atom_t             # <<<<<<<<<<<<<<
 * ctypedef uint64_t feat_t
 * ctypedef int32_t class_t
 */
typedef uint64_t __pyx_t_5thinc_8typedefs_atom_t;

/* "thinc/typedefs.pxd":9
 * ctypedef float weight_t
 * ctypedef uint64_t atom_t
 * ctypedef uint64_t feat_t             # <<<<<<<<<<<<<<
 * ctypedef int32_t class_t
 * ctypedef uint32_t count_t
 */
typedef uint64_t __pyx_t_5thinc_8typedefs_feat_t;

/* "thinc/typedefs.pxd":10
 * ctypedef uint64_t atom_t
 * ctypedef uint64_t feat_t
 * ctypedef int32_t class_t             # <<<<<<<<<<<<<<
 * ctypedef uint32_t count_t
 * ctypedef uint32_t time_t
 */
typedef int32_t __pyx_t_5thinc_8typedefs_class_t;

/* "thinc/typedefs.pxd":11
 * ctypedef uint64_t feat_t
 * ctypedef int32_t class_t
 * ctypedef uint32_t count_t             # <<<<<<<<<<<<<<
 * ctypedef uint32_t time_t
 */
typedef uint32_t __pyx_t_5thinc_8typedefs_count_t;

/* "thinc/typedefs.pxd":12
 * ctypedef int32_t class_t
 * ctypedef uint32_t count_t
 * ctypedef uint32_t time_t             # <<<<<<<<<<<<<<
 */
typedef uint32_t __pyx_t_5thinc_8typedefs_time_t;

/* "preshed/maps.pxd":5
 * 
 * 
 * ctypedef uint64_t key_t             # <<<<<<<<<<<<<<
 * 
 * 
 */
typedef uint64_t __pyx_t_7preshed_4maps_key_t;

/*--- Type declarations ---*/
struct __pyx_obj_5cymem_5cymem_Pool;
struct __pyx_obj_5cymem_5cymem_Address;
struct __pyx_obj_7preshed_4maps_PreshMap;
struct __pyx_obj_7preshed_4maps_PreshMapArray;
struct __pyx_obj_5thinc_8features_Extractor;
struct __pyx_t_7preshed_4maps_Cell;
struct __pyx_t_7preshed_4maps_MapStruct;

/* "preshed/maps.pxd":8
 * 
 * 
 * cdef struct Cell:             # <<<<<<<<<<<<<<
 *     key_t key
 *     void* value
 */
struct __pyx_t_7preshed_4maps_Cell {
  __pyx_t_7preshed_4maps_key_t key;
  void *value;
};

/* "preshed/maps.pxd":13
 * 
 * 
 * cdef struct MapStruct:             # <<<<<<<<<<<<<<
 *     Cell* cells
 *     void* value_for_empty_key
 */
struct __pyx_t_7preshed_4maps_MapStruct {
  struct __pyx_t_7preshed_4maps_Cell *cells;
  void *value_for_empty_key;
  void *value_for_del_key;
  __pyx_t_7preshed_4maps_key_t length;
  __pyx_t_7preshed_4maps_key_t filled;
  int is_empty_key_set;
  int is_del_key_set;
};
struct __pyx_t_5thinc_8features_Template;
struct __pyx_t_5thinc_8features_Feature;

/* "thinc/features.pxd":8
 * 
 * 
 * cdef struct Template:             # <<<<<<<<<<<<<<
 *     int[MAX_TEMPLATE_LEN] indices
 *     int length
 */
struct __pyx_t_5thinc_8features_Template {
  int indices[10];
  int length;
  __pyx_t_5thinc_8typedefs_atom_t atoms[10];
};

/* "thinc/features.pxd":14
 * 
 * 
 * cdef struct Feature:             # <<<<<<<<<<<<<<
 *     int i
 *     feat_t key
 */
struct __pyx_t_5thinc_8features_Feature {
  int i;
  __pyx_t_5thinc_8typedefs_feat_t key;
  __pyx_t_5thinc_8typedefs_weight_t value;
};
struct __pyx_t_5thinc_7weights_WeightLine;
struct __pyx_t_5thinc_7weights_MetaData;
struct __pyx_t_5thinc_7weights_MDLine;
struct __pyx_t_5thinc_7weights_TrainFeat;

/* "thinc/weights.pxd":21
 * 
 * 
 * ctypedef weight_t[LINE_SIZE] weight_line_t             # <<<<<<<<<<<<<<
 * 
 * 
 */
typedef __pyx_t_5thinc_8typedefs_weight_t __pyx_t_5thinc_7weights_weight_line_t[7];

/* "thinc/weights.pxd":26
 * # A set of weights, to be read in. Start indicates the class that w[0] refers
 * # to. Subsequent weights go from there.
 * cdef struct WeightLine:             # <<<<<<<<<<<<<<
 *     weight_line_t line
 *     int32_t start
 */
struct __pyx_t_5thinc_7weights_WeightLine {
  __pyx_t_5thinc_7weights_weight_line_t line;
  int32_t start;
};

/* "thinc/weights.pxd":31
 * 
 * 
 * cdef struct MetaData:             # <<<<<<<<<<<<<<
 *     weight_t total
 *     time_t time
 */
struct __pyx_t_5thinc_7weights_MetaData {
  __pyx_t_5thinc_8typedefs_weight_t total;
  __pyx_t_5thinc_8typedefs_time_t time;
};

/* "thinc/weights.pxd":38
 * 
 * 
 * cdef struct MDLine:             # <<<<<<<<<<<<<<
 *      MetaData[LINE_SIZE] line
 * 
 */
struct __pyx_t_5thinc_7weights_MDLine {
  struct __pyx_t_5thinc_7weights_MetaData line[7];
};

/* "thinc/weights.pxd":42
 * 
 * 
 * cdef struct TrainFeat:             # <<<<<<<<<<<<<<
 *     WeightLine* weights
 *     MDLine* meta
 */
struct __pyx_t_5thinc_7weights_TrainFeat {
  struct __pyx_t_5thinc_7weights_WeightLine *weights;
  struct __pyx_t_5thinc_7weights_MDLine *meta;
  uint32_t length;
  uint32_t _resize_at;
};

/* "cymem/cymem.pxd":1
 * cdef class Pool:             # <<<<<<<<<<<<<<
 *     cdef readonly size_t size
 *     cdef readonly dict addresses
 */
struct __pyx_obj_5cymem_5cymem_Pool {
  PyObject_HEAD
  struct __pyx_vtabstruct_5cymem_5cymem_Pool *__pyx_vtab;
  size_t size;
  PyObject *addresses;
};


/* "cymem/cymem.pxd":10
 * 
 * 
 * cdef class Address:             # <<<<<<<<<<<<<<
 *     cdef void* ptr
 */
struct __pyx_obj_5cymem_5cymem_Address {
  PyObject_HEAD
  void *ptr;
};


/* "preshed/maps.pxd":32
 * 
 * 
 * cdef class PreshMap:             # <<<<<<<<<<<<<<
 *     cdef MapStruct* c_map
 *     cdef Pool mem
 */
struct __pyx_obj_7preshed_4maps_PreshMap {
  PyObject_HEAD
  struct __pyx_vtabstruct_7preshed_4maps_PreshMap *__pyx_vtab;
  struct __pyx_t_7preshed_4maps_MapStruct *c_map;
  struct __pyx_obj_5cymem_5cymem_Pool *mem;
};


/* "preshed/maps.pxd":40
 * 
 * 
 * cdef class PreshMapArray:             # <<<<<<<<<<<<<<
 *     cdef Pool mem
 *     cdef MapStruct* maps
 */
struct __pyx_obj_7preshed_4maps_PreshMapArray {
  PyObject_HEAD
  struct __pyx_vtabstruct_7preshed_4maps_PreshMapArray *__pyx_vtab;
  struct __pyx_obj_5cymem_5cymem_Pool *mem;
  struct __pyx_t_7preshed_4maps_MapStruct *maps;
  size_t length;
};


/* "thinc/features.pxd":20
 * 
 * 
 * cdef class Extractor:             # <<<<<<<<<<<<<<
 *     cdef Pool mem
 *     cdef Template* templates
 */
struct __pyx_obj_5thinc_8features_Extractor {
  PyObject_HEAD
  struct __pyx_vtabstruct_5thinc_8features_Extractor *__pyx_vtab;
  struct __pyx_obj_5cymem_5cymem_Pool *mem;
  struct __pyx_t_5thinc_8features_Template *templates;
  struct __pyx_t_5thinc_8features_Feature *feats;
  int n_templ;
};



/* "cymem/cymem.pxd":1
 * cdef class Pool:             # <<<<<<<<<<<<<<
 *     cdef readonly size_t size
 *     cdef readonly dict addresses
 */

struct __pyx_vtabstruct_5cymem_5cymem_Pool {
  void *(*alloc)(struct __pyx_obj_5cymem_5cymem_Pool *, size_t, size_t);
  void (*free)(struct __pyx_obj_5cymem_5cymem_Pool *, void *);
  void *(*realloc)(struct __pyx_obj_5cymem_5cymem_Pool *, void *, size_t);
};
static struct __pyx_vtabstruct_5cymem_5cymem_Pool *__pyx_vtabptr_5cymem_5cymem_Pool;


/* "preshed/maps.pxd":32
 * 
 * 
 * cdef class PreshMap:             # <<<<<<<<<<<<<<
 *     cdef MapStruct* c_map
 *     cdef Pool mem
 */

struct __pyx_vtabstruct_7preshed_4maps_PreshMap {
  void *(*get)(struct __pyx_obj_7preshed_4maps_PreshMap *, __pyx_t_7preshed_4maps_key_t);
  void (*set)(struct __pyx_obj_7preshed_4maps_PreshMap *, __pyx_t_7preshed_4maps_key_t, void *);
};
static struct __pyx_vtabstruct_7preshed_4maps_PreshMap *__pyx_vtabptr_7preshed_4maps_PreshMap;


/* "preshed/maps.pxd":40
 * 
 * 
 * cdef class PreshMapArray:             # <<<<<<<<<<<<<<
 *     cdef Pool mem
 *     cdef MapStruct* maps
 */

struct __pyx_vtabstruct_7preshed_4maps_PreshMapArray {
  void *(*get)(struct __pyx_obj_7preshed_4maps_PreshMapArray *, size_t, __pyx_t_7preshed_4maps_key_t);
  void (*set)(struct __pyx_obj_7preshed_4maps_PreshMapArray *, size_t, __pyx_t_7preshed_4maps_key_t, void *);
};
static struct __pyx_vtabstruct_7preshed_4maps_PreshMapArray *__pyx_vtabptr_7preshed_4maps_PreshMapArray;


/* "thinc/features.pxd":20
 * 
 * 
 * cdef class Extractor:             # <<<<<<<<<<<<<<
 *     cdef Pool mem
 *     cdef Template* templates
 */

struct __pyx_vtabstruct_5thinc_8features_Extractor {
  struct __pyx_t_5thinc_8features_Feature *(*get_feats)(struct __pyx_obj_5thinc_8features_Extractor *, __pyx_t_5thinc_8typedefs_atom_t *, int *);
  int (*set_feats)(struct __pyx_obj_5thinc_8features_Extractor *, struct __pyx_t_5thinc_8features_Feature *, __pyx_t_5thinc_8typedefs_atom_t *);
};
static struct __pyx_vtabstruct_5thinc_8features_Extractor *__pyx_vtabptr_5thinc_8features_Extractor;
#ifndef CYTHON_REFNANNY
  #define CYTHON_REFNANNY 0
#endif
#if CYTHON_REFNANNY
  typedef struct {
    void (*INCREF)(void*, PyObject*, int);
    void (*DECREF)(void*, PyObject*, int);
    void (*GOTREF)(void*, PyObject*, int);
    void (*GIVEREF)(void*, PyObject*, int);
    void* (*SetupContext)(const char*, int, const char*);
    void (*FinishContext)(void**);
  } __Pyx_RefNannyAPIStruct;
  static __Pyx_RefNannyAPIStruct *__Pyx_RefNanny = NULL;
  static __Pyx_RefNannyAPIStruct *__Pyx_RefNannyImportAPI(const char *modname);
  #define __Pyx_RefNannyDeclarations void *__pyx_refnanny = NULL;
#ifdef WITH_THREAD
  #define __Pyx_RefNannySetupContext(name, acquire_gil) \
          if (acquire_gil) { \
              PyGILState_STATE __pyx_gilstate_save = PyGILState_Ensure(); \
              __pyx_refnanny = __Pyx_RefNanny->SetupContext((name), __LINE__, __FILE__); \
              PyGILState_Release(__pyx_gilstate_save); \
          } else { \
              __pyx_refnanny = __Pyx_RefNanny->SetupContext((name), __LINE__, __FILE__); \
          }
#else
  #define __Pyx_RefNannySetupContext(name, acquire_gil) \
          __pyx_refnanny = __Pyx_RefNanny->SetupContext((name), __LINE__, __FILE__)
#endif
  #define __Pyx_RefNannyFinishContext() \
          __Pyx_RefNanny->FinishContext(&__pyx_refnanny)
  #define __Pyx_INCREF(r)  __Pyx_RefNanny->INCREF(__pyx_refnanny, (PyObject *)(r), __LINE__)
  #define __Pyx_DECREF(r)  __Pyx_RefNanny->DECREF(__pyx_refnanny, (PyObject *)(r), __LINE__)
  #define __Pyx_GOTREF(r)  __Pyx_RefNanny->GOTREF(__pyx_refnanny, (PyObject *)(r), __LINE__)
  #define __Pyx_GIVEREF(r) __Pyx_RefNanny->GIVEREF(__pyx_refnanny, (PyObject *)(r), __LINE__)
  #define __Pyx_XINCREF(r)  do { if((r) != NULL) {__Pyx_INCREF(r); }} while(0)
  #define __Pyx_XDECREF(r)  do { if((r) != NULL) {__Pyx_DECREF(r); }} while(0)
  #define __Pyx_XGOTREF(r)  do { if((r) != NULL) {__Pyx_GOTREF(r); }} while(0)
  #define __Pyx_XGIVEREF(r) do { if((r) != NULL) {__Pyx_GIVEREF(r);}} while(0)
#else
  #define __Pyx_RefNannyDeclarations
  #define __Pyx_RefNannySetupContext(name, acquire_gil)
  #define __Pyx_RefNannyFinishContext()
  #define __Pyx_INCREF(r) Py_INCREF(r)
  #define __Pyx_DECREF(r) Py_DECREF(r)
  #define __Pyx_GOTREF(r)
  #define __Pyx_GIVEREF(r)
  #define __Pyx_XINCREF(r) Py_XINCREF(r)
  #define __Pyx_XDECREF(r) Py_XDECREF(r)
  #define __Pyx_XGOTREF(r)
  #define __Pyx_XGIVEREF(r)
#endif
#define __Pyx_XDECREF_SET(r, v) do {                            \
        PyObject *tmp = (PyObject *) r;                         \
        r = v; __Pyx_XDECREF(tmp);                              \
    } while (0)
#define __Pyx_DECREF_SET(r, v) do {                             \
        PyObject *tmp = (PyObject *) r;                         \
        r = v; __Pyx_DECREF(tmp);                               \
    } while (0)
#define __Pyx_CLEAR(r)    do { PyObject* tmp = ((PyObject*)(r)); r = NULL; __Pyx_DECREF(tmp);} while(0)
#define __Pyx_XCLEAR(r)   do { if((r) != NULL) {PyObject* tmp = ((PyObject*)(r)); r = NULL; __Pyx_DECREF(tmp);}} while(0)

#if CYTHON_COMPILING_IN_CPYTHON
static CYTHON_INLINE PyObject* __Pyx_PyObject_GetAttrStr(PyObject* obj, PyObject* attr_name) {
    PyTypeObject* tp = Py_TYPE(obj);
    if (likely(tp->tp_getattro))
        return tp->tp_getattro(obj, attr_name);
#if PY_MAJOR_VERSION < 3
    if (likely(tp->tp_getattr))
        return tp->tp_getattr(obj, PyString_AS_STRING(attr_name));
#endif
    return PyObject_GetAttr(obj, attr_name);
}
#else
#define __Pyx_PyObject_GetAttrStr(o,n) PyObject_GetAttr(o,n)
#endif

static PyObject *__Pyx_GetBuiltinName(PyObject *name);

#ifndef __PYX_FORCE_INIT_THREADS
  #define __PYX_FORCE_INIT_THREADS 0
#endif

static void* __Pyx_GetVtable(PyObject *dict);

typedef struct {
    int code_line;
    PyCodeObject* code_object;
} __Pyx_CodeObjectCacheEntry;
struct __Pyx_CodeObjectCache {
    int count;
    int max_count;
    __Pyx_CodeObjectCacheEntry* entries;
};
static struct __Pyx_CodeObjectCache __pyx_code_cache = {0,0,NULL};
static int __pyx_bisect_code_objects(__Pyx_CodeObjectCacheEntry* entries, int count, int code_line);
static PyCodeObject *__pyx_find_code_object(int code_line);
static void __pyx_insert_code_object(int code_line, PyCodeObject* code_object);

static void __Pyx_AddTraceback(const char *funcname, int c_line,
                               int py_line, const char *filename);

static CYTHON_INLINE PyObject* __Pyx_PyInt_From_int(int value);

static CYTHON_INLINE int __Pyx_PyInt_As_int(PyObject *);

static CYTHON_INLINE PyObject* __Pyx_PyInt_From_uint32_t(uint32_t value);

static CYTHON_INLINE PyObject* __Pyx_PyInt_From_int32_t(int32_t value);

static CYTHON_INLINE int32_t __Pyx_PyInt_As_int32_t(PyObject *);

static int __Pyx_check_twos_complement(void) {
    if (-1 != ~0) {
        PyErr_SetString(PyExc_RuntimeError, "Two's complement required for overflow checks.");
        return 1;
    } else if (sizeof(short) == sizeof(int)) {
        PyErr_SetString(PyExc_RuntimeError, "sizeof(short) < sizeof(int) required for overflow checks.");
        return 1;
    } else {
        return 0;
    }
}
#define __PYX_IS_UNSIGNED(type) (((type) -1) > 0)
#define __PYX_SIGN_BIT(type)    (((unsigned type) 1) << (sizeof(type) * 8 - 1))
#define __PYX_HALF_MAX(type)    (((type) 1) << (sizeof(type) * 8 - 2))
#define __PYX_MIN(type)         (__PYX_IS_UNSIGNED(type) ? (type) 0 : 0 - __PYX_HALF_MAX(type) - __PYX_HALF_MAX(type))
#define __PYX_MAX(type)         (~__PYX_MIN(type))
#define __Pyx_add_no_overflow(a, b, overflow) ((a) + (b))
#define __Pyx_add_const_no_overflow(a, b, overflow) ((a) + (b))
#define __Pyx_sub_no_overflow(a, b, overflow) ((a) - (b))
#define __Pyx_sub_const_no_overflow(a, b, overflow) ((a) - (b))
#define __Pyx_mul_no_overflow(a, b, overflow) ((a) * (b))
#define __Pyx_mul_const_no_overflow(a, b, overflow) ((a) * (b))
#define __Pyx_div_no_overflow(a, b, overflow) ((a) / (b))
#define __Pyx_div_const_no_overflow(a, b, overflow) ((a) / (b))

static CYTHON_INLINE int __Pyx_add_int_checking_overflow(int a, int b, int *overflow);
static CYTHON_INLINE int __Pyx_sub_int_checking_overflow(int a, int b, int *overflow);
static CYTHON_INLINE int __Pyx_mul_int_checking_overflow(int a, int b, int *overflow);
static CYTHON_INLINE int __Pyx_div_int_checking_overflow(int a, int b, int *overflow);
static CYTHON_INLINE int __Pyx_add_const_int_checking_overflow(int a, int b, int *overflow);
static CYTHON_INLINE int __Pyx_sub_const_int_checking_overflow(int a, int b, int *overflow);
static CYTHON_INLINE int __Pyx_mul_const_int_checking_overflow(int a, int constant, int *overflow);
#define __Pyx_div_const_int_checking_overflow __Pyx_div_int_checking_overflow

static CYTHON_INLINE long __Pyx_add_long_checking_overflow(long a, long b, int *overflow);
static CYTHON_INLINE long __Pyx_sub_long_checking_overflow(long a, long b, int *overflow);
static CYTHON_INLINE long __Pyx_mul_long_checking_overflow(long a, long b, int *overflow);
static CYTHON_INLINE long __Pyx_div_long_checking_overflow(long a, long b, int *overflow);
static CYTHON_INLINE long __Pyx_add_const_long_checking_overflow(long a, long b, int *overflow);
static CYTHON_INLINE long __Pyx_sub_const_long_checking_overflow(long a, long b, int *overflow);
static CYTHON_INLINE long __Pyx_mul_const_long_checking_overflow(long a, long constant, int *overflow);
#define __Pyx_div_const_long_checking_overflow __Pyx_div_long_checking_overflow

static CYTHON_INLINE long long __Pyx_add_long_long_checking_overflow(long long a, long long b, int *overflow);
static CYTHON_INLINE long long __Pyx_sub_long_long_checking_overflow(long long a, long long b, int *overflow);
static CYTHON_INLINE long long __Pyx_mul_long_long_checking_overflow(long long a, long long b, int *overflow);
static CYTHON_INLINE long long __Pyx_div_long_long_checking_overflow(long long a, long long b, int *overflow);
static CYTHON_INLINE long long __Pyx_add_const_long_long_checking_overflow(long long a, long long b, int *overflow);
static CYTHON_INLINE long long __Pyx_sub_const_long_long_checking_overflow(long long a, long long b, int *overflow);
static CYTHON_INLINE long long __Pyx_mul_const_long_long_checking_overflow(long long a, long long constant, int *overflow);
#define __Pyx_div_const_long_long_checking_overflow __Pyx_div_long_long_checking_overflow

static CYTHON_INLINE unsigned int __Pyx_add_unsigned_int_checking_overflow(unsigned int a, unsigned int b, int *overflow);
static CYTHON_INLINE unsigned int __Pyx_sub_unsigned_int_checking_overflow(unsigned int a, unsigned int b, int *overflow);
static CYTHON_INLINE unsigned int __Pyx_mul_unsigned_int_checking_overflow(unsigned int a, unsigned int b, int *overflow);
static CYTHON_INLINE unsigned int __Pyx_div_unsigned_int_checking_overflow(unsigned int a, unsigned int b, int *overflow);
#define __Pyx_add_const_unsigned_int_checking_overflow __Pyx_add_unsigned_int_checking_overflow
#define __Pyx_sub_const_unsigned_int_checking_overflow __Pyx_sub_unsigned_int_checking_overflow
static CYTHON_INLINE unsigned int __Pyx_mul_const_unsigned_int_checking_overflow(unsigned int a, unsigned int constant, int *overflow);
#define __Pyx_div_const_unsigned_int_checking_overflow __Pyx_div_unsigned_int_checking_overflow

static CYTHON_INLINE unsigned long __Pyx_add_unsigned_long_checking_overflow(unsigned long a, unsigned long b, int *overflow);
static CYTHON_INLINE unsigned long __Pyx_sub_unsigned_long_checking_overflow(unsigned long a, unsigned long b, int *overflow);
static CYTHON_INLINE unsigned long __Pyx_mul_unsigned_long_checking_overflow(unsigned long a, unsigned long b, int *overflow);
static CYTHON_INLINE unsigned long __Pyx_div_unsigned_long_checking_overflow(unsigned long a, unsigned long b, int *overflow);
#define __Pyx_add_const_unsigned_long_checking_overflow __Pyx_add_unsigned_long_checking_overflow
#define __Pyx_sub_const_unsigned_long_checking_overflow __Pyx_sub_unsigned_long_checking_overflow
static CYTHON_INLINE unsigned long __Pyx_mul_const_unsigned_long_checking_overflow(unsigned long a, unsigned long constant, int *overflow);
#define __Pyx_div_const_unsigned_long_checking_overflow __Pyx_div_unsigned_long_checking_overflow

static CYTHON_INLINE unsigned long long __Pyx_add_unsigned_long_long_checking_overflow(unsigned long long a, unsigned long long b, int *overflow);
static CYTHON_INLINE unsigned long long __Pyx_sub_unsigned_long_long_checking_overflow(unsigned long long a, unsigned long long b, int *overflow);
static CYTHON_INLINE unsigned long long __Pyx_mul_unsigned_long_long_checking_overflow(unsigned long long a, unsigned long long b, int *overflow);
static CYTHON_INLINE unsigned long long __Pyx_div_unsigned_long_long_checking_overflow(unsigned long long a, unsigned long long b, int *overflow);
#define __Pyx_add_const_unsigned_long_long_checking_overflow __Pyx_add_unsigned_long_long_checking_overflow
#define __Pyx_sub_const_unsigned_long_long_checking_overflow __Pyx_sub_unsigned_long_long_checking_overflow
static CYTHON_INLINE unsigned long long __Pyx_mul_const_unsigned_long_long_checking_overflow(unsigned long long a, unsigned long long constant, int *overflow);
#define __Pyx_div_const_unsigned_long_long_checking_overflow __Pyx_div_unsigned_long_long_checking_overflow

static int __Pyx_check_sane___pyx_t_5thinc_8typedefs_time_t(void) {
    if (sizeof(__pyx_t_5thinc_8typedefs_time_t) <= sizeof(int) ||
        sizeof(__pyx_t_5thinc_8typedefs_time_t) == sizeof(long) ||
        sizeof(__pyx_t_5thinc_8typedefs_time_t) == sizeof(long long)) {
        return 0;
    } else {
        PyErr_Format(PyExc_RuntimeError, \
            "Bad size for int type %.60s: %d", "__pyx_t_5thinc_8typedefs_time_t", (int) sizeof(__pyx_t_5thinc_8typedefs_time_t));
        return 1;
    }
}

static CYTHON_INLINE __pyx_t_5thinc_8typedefs_time_t __Pyx_sub___pyx_t_5thinc_8typedefs_time_t_checking_overflow(__pyx_t_5thinc_8typedefs_time_t a, __pyx_t_5thinc_8typedefs_time_t b, int *overflow);

static CYTHON_INLINE PyObject* __Pyx_PyInt_From_long(long value);

static CYTHON_INLINE size_t __Pyx_PyInt_As_size_t(PyObject *);

static CYTHON_INLINE uint32_t __Pyx_PyInt_As_uint32_t(PyObject *);

static CYTHON_INLINE long __Pyx_PyInt_As_long(PyObject *);

static int __Pyx_check_binary_version(void);

static int __Pyx_ExportFunction(const char *name, void (*f)(void), const char *sig);

#if !defined(__Pyx_PyIdentifier_FromString)
#if PY_MAJOR_VERSION < 3
  #define __Pyx_PyIdentifier_FromString(s) PyString_FromString(s)
#else
  #define __Pyx_PyIdentifier_FromString(s) PyUnicode_FromString(s)
#endif
#endif

static PyObject *__Pyx_ImportModule(const char *name);

static PyTypeObject *__Pyx_ImportType(const char *module_name, const char *class_name, size_t size, int strict);

static int __Pyx_ImportFunction(PyObject *module, const char *funcname, void (**f)(void), const char *sig);

static int __Pyx_InitStrings(__Pyx_StringTabEntry *t);


/* Module declarations from 'libc.stdint' */

/* Module declarations from 'thinc.typedefs' */

/* Module declarations from 'cymem.cymem' */
static PyTypeObject *__pyx_ptype_5cymem_5cymem_Pool = 0;
static PyTypeObject *__pyx_ptype_5cymem_5cymem_Address = 0;

/* Module declarations from 'preshed.maps' */
static PyTypeObject *__pyx_ptype_7preshed_4maps_PreshMap = 0;
static PyTypeObject *__pyx_ptype_7preshed_4maps_PreshMapArray = 0;
static void *(*__pyx_f_7preshed_4maps_map_get)(struct __pyx_t_7preshed_4maps_MapStruct const *, __pyx_t_7preshed_4maps_key_t const ); /*proto*/

/* Module declarations from 'thinc.features' */
static PyTypeObject *__pyx_ptype_5thinc_8features_Extractor = 0;

/* Module declarations from 'cython' */

/* Module declarations from 'libc.math' */

/* Module declarations from 'cpython.mem' */

/* Module declarations from 'libc.string' */

/* Module declarations from 'thinc.weights' */
static __pyx_t_5thinc_8typedefs_class_t __pyx_f_5thinc_7weights_get_nr_rows(__pyx_t_5thinc_8typedefs_class_t const ); /*proto*/
static CYTHON_INLINE __pyx_t_5thinc_8typedefs_class_t __pyx_f_5thinc_7weights_get_row(__pyx_t_5thinc_8typedefs_class_t const ); /*proto*/
static CYTHON_INLINE __pyx_t_5thinc_8typedefs_class_t __pyx_f_5thinc_7weights_get_col(__pyx_t_5thinc_8typedefs_class_t const ); /*proto*/
static int __pyx_f_5thinc_7weights__insert_row(struct __pyx_t_5thinc_7weights_TrainFeat *, int, __pyx_t_5thinc_8typedefs_class_t, __pyx_t_5thinc_8typedefs_class_t); /*proto*/
#define __Pyx_MODULE_NAME "thinc.weights"
int __pyx_module_is_main_thinc__weights = 0;

/* Implementation of 'thinc.weights' */
static PyObject *__pyx_builtin_range;
static char __pyx_k_main[] = "__main__";
static char __pyx_k_test[] = "__test__";
static char __pyx_k_range[] = "range";
static char __pyx_k_pyx_vtable[] = "__pyx_vtable__";
static PyObject *__pyx_n_s_main;
static PyObject *__pyx_n_s_pyx_vtable;
static PyObject *__pyx_n_s_range;
static PyObject *__pyx_n_s_test;

/* "thinc/weights.pyx":13
 * 
 * @cython.cdivision(True)
 * cdef inline class_t get_row(const class_t clas) nogil:             # <<<<<<<<<<<<<<
 *     return clas / LINE_SIZE
 * 
 */

static CYTHON_INLINE __pyx_t_5thinc_8typedefs_class_t __pyx_f_5thinc_7weights_get_row(__pyx_t_5thinc_8typedefs_class_t const __pyx_v_clas) {
  __pyx_t_5thinc_8typedefs_class_t __pyx_r;

  /* "thinc/weights.pyx":14
 * @cython.cdivision(True)
 * cdef inline class_t get_row(const class_t clas) nogil:
 *     return clas / LINE_SIZE             # <<<<<<<<<<<<<<
 * 
 * 
 */
  __pyx_r = (__pyx_v_clas / 7);
  goto __pyx_L0;

  /* "thinc/weights.pyx":13
 * 
 * @cython.cdivision(True)
 * cdef inline class_t get_row(const class_t clas) nogil:             # <<<<<<<<<<<<<<
 *     return clas / LINE_SIZE
 * 
 */

  /* function exit code */
  __pyx_L0:;
  return __pyx_r;
}

/* "thinc/weights.pyx":18
 * 
 * @cython.cdivision(True)
 * cdef inline class_t get_col(const class_t clas) nogil:             # <<<<<<<<<<<<<<
 *     return clas % LINE_SIZE
 * 
 */

static CYTHON_INLINE __pyx_t_5thinc_8typedefs_class_t __pyx_f_5thinc_7weights_get_col(__pyx_t_5thinc_8typedefs_class_t const __pyx_v_clas) {
  __pyx_t_5thinc_8typedefs_class_t __pyx_r;

  /* "thinc/weights.pyx":19
 * @cython.cdivision(True)
 * cdef inline class_t get_col(const class_t clas) nogil:
 *     return clas % LINE_SIZE             # <<<<<<<<<<<<<<
 * 
 * 
 */
  __pyx_r = (__pyx_v_clas % 7);
  goto __pyx_L0;

  /* "thinc/weights.pyx":18
 * 
 * @cython.cdivision(True)
 * cdef inline class_t get_col(const class_t clas) nogil:             # <<<<<<<<<<<<<<
 *     return clas % LINE_SIZE
 * 
 */

  /* function exit code */
  __pyx_L0:;
  return __pyx_r;
}

/* "thinc/weights.pyx":23
 * 
 * @cython.cdivision(True)
 * cdef class_t get_nr_rows(const class_t n) nogil:             # <<<<<<<<<<<<<<
 *     cdef class_t nr_lines = get_row(n)
 *     if nr_lines == 0 or nr_lines * LINE_SIZE < n:
 */

static __pyx_t_5thinc_8typedefs_class_t __pyx_f_5thinc_7weights_get_nr_rows(__pyx_t_5thinc_8typedefs_class_t const __pyx_v_n) {
  __pyx_t_5thinc_8typedefs_class_t __pyx_v_nr_lines;
  __pyx_t_5thinc_8typedefs_class_t __pyx_r;
  int __pyx_t_1;
  int __pyx_t_2;

  /* "thinc/weights.pyx":24
 * @cython.cdivision(True)
 * cdef class_t get_nr_rows(const class_t n) nogil:
 *     cdef class_t nr_lines = get_row(n)             # <<<<<<<<<<<<<<
 *     if nr_lines == 0 or nr_lines * LINE_SIZE < n:
 *         nr_lines += 1
 */
  __pyx_v_nr_lines = __pyx_f_5thinc_7weights_get_row(__pyx_v_n);

  /* "thinc/weights.pyx":25
 * cdef class_t get_nr_rows(const class_t n) nogil:
 *     cdef class_t nr_lines = get_row(n)
 *     if nr_lines == 0 or nr_lines * LINE_SIZE < n:             # <<<<<<<<<<<<<<
 *         nr_lines += 1
 *     return nr_lines
 */
  __pyx_t_2 = ((__pyx_v_nr_lines == 0) != 0);
  if (!__pyx_t_2) {
  } else {
    __pyx_t_1 = __pyx_t_2;
    goto __pyx_L4_bool_binop_done;
  }
  __pyx_t_2 = (((__pyx_v_nr_lines * 7) < __pyx_v_n) != 0);
  __pyx_t_1 = __pyx_t_2;
  __pyx_L4_bool_binop_done:;
  if (__pyx_t_1) {

    /* "thinc/weights.pyx":26
 *     cdef class_t nr_lines = get_row(n)
 *     if nr_lines == 0 or nr_lines * LINE_SIZE < n:
 *         nr_lines += 1             # <<<<<<<<<<<<<<
 *     return nr_lines
 * 
 */
    __pyx_v_nr_lines = (__pyx_v_nr_lines + 1);
    goto __pyx_L3;
  }
  __pyx_L3:;

  /* "thinc/weights.pyx":27
 *     if nr_lines == 0 or nr_lines * LINE_SIZE < n:
 *         nr_lines += 1
 *     return nr_lines             # <<<<<<<<<<<<<<
 * 
 * 
 */
  __pyx_r = __pyx_v_nr_lines;
  goto __pyx_L0;

  /* "thinc/weights.pyx":23
 * 
 * @cython.cdivision(True)
 * cdef class_t get_nr_rows(const class_t n) nogil:             # <<<<<<<<<<<<<<
 *     cdef class_t nr_lines = get_row(n)
 *     if nr_lines == 0 or nr_lines * LINE_SIZE < n:
 */

  /* function exit code */
  __pyx_L0:;
  return __pyx_r;
}

/* "thinc/weights.pyx":30
 * 
 * 
 * cdef int gather_weights(MapStruct* maps, const class_t nr_class,             # <<<<<<<<<<<<<<
 *         WeightLine* w_lines, const Feature* feats, const int n_feats) nogil:
 *     cdef:
 */

static int __pyx_f_5thinc_7weights_gather_weights(struct __pyx_t_7preshed_4maps_MapStruct *__pyx_v_maps, CYTHON_UNUSED __pyx_t_5thinc_8typedefs_class_t const __pyx_v_nr_class, struct __pyx_t_5thinc_7weights_WeightLine *__pyx_v_w_lines, struct __pyx_t_5thinc_8features_Feature const *__pyx_v_feats, int const __pyx_v_n_feats) {
  struct __pyx_t_5thinc_7weights_TrainFeat const *__pyx_v_feature;
  struct __pyx_t_5thinc_7weights_WeightLine const *__pyx_v_feat_weights;
  __pyx_t_5thinc_8typedefs_feat_t __pyx_v_key;
  __pyx_t_5thinc_8typedefs_weight_t __pyx_v_value;
  int __pyx_v_row;
  int __pyx_v_i;
  int __pyx_v_j;
  int __pyx_v_f_i;
  int __pyx_r;
  int __pyx_t_1;
  int __pyx_t_2;
  __pyx_t_5thinc_8typedefs_feat_t __pyx_t_3;
  __pyx_t_5thinc_8typedefs_weight_t __pyx_t_4;
  int __pyx_t_5;
  int __pyx_t_6;
  struct __pyx_t_5thinc_7weights_WeightLine *__pyx_t_7;
  uint32_t __pyx_t_8;
  int __pyx_t_9;
  int __pyx_t_10;
  int __pyx_t_11;
  int __pyx_t_12;

  /* "thinc/weights.pyx":39
 *         int row
 *     cdef int i, j
 *     cdef int f_i = 0             # <<<<<<<<<<<<<<
 *     for i in range(n_feats):
 *         key = feats[i].key
 */
  __pyx_v_f_i = 0;

  /* "thinc/weights.pyx":40
 *     cdef int i, j
 *     cdef int f_i = 0
 *     for i in range(n_feats):             # <<<<<<<<<<<<<<
 *         key = feats[i].key
 *         value = feats[i].value
 */
  __pyx_t_1 = __pyx_v_n_feats;
  for (__pyx_t_2 = 0; __pyx_t_2 < __pyx_t_1; __pyx_t_2+=1) {
    __pyx_v_i = __pyx_t_2;

    /* "thinc/weights.pyx":41
 *     cdef int f_i = 0
 *     for i in range(n_feats):
 *         key = feats[i].key             # <<<<<<<<<<<<<<
 *         value = feats[i].value
 *         if key == 0 or value == 0:
 */
    __pyx_t_3 = (__pyx_v_feats[__pyx_v_i]).key;
    __pyx_v_key = __pyx_t_3;

    /* "thinc/weights.pyx":42
 *     for i in range(n_feats):
 *         key = feats[i].key
 *         value = feats[i].value             # <<<<<<<<<<<<<<
 *         if key == 0 or value == 0:
 *             continue
 */
    __pyx_t_4 = (__pyx_v_feats[__pyx_v_i]).value;
    __pyx_v_value = __pyx_t_4;

    /* "thinc/weights.pyx":43
 *         key = feats[i].key
 *         value = feats[i].value
 *         if key == 0 or value == 0:             # <<<<<<<<<<<<<<
 *             continue
 *         feature = <TrainFeat*>map_get(maps, key)
 */
    __pyx_t_6 = ((__pyx_v_key == 0) != 0);
    if (!__pyx_t_6) {
    } else {
      __pyx_t_5 = __pyx_t_6;
      goto __pyx_L6_bool_binop_done;
    }
    __pyx_t_6 = ((__pyx_v_value == 0.0) != 0);
    __pyx_t_5 = __pyx_t_6;
    __pyx_L6_bool_binop_done:;
    if (__pyx_t_5) {

      /* "thinc/weights.pyx":44
 *         value = feats[i].value
 *         if key == 0 or value == 0:
 *             continue             # <<<<<<<<<<<<<<
 *         feature = <TrainFeat*>map_get(maps, key)
 *         if feature != NULL:
 */
      goto __pyx_L3_continue;
    }

    /* "thinc/weights.pyx":45
 *         if key == 0 or value == 0:
 *             continue
 *         feature = <TrainFeat*>map_get(maps, key)             # <<<<<<<<<<<<<<
 *         if feature != NULL:
 *             feat_weights = feature.weights
 */
    __pyx_v_feature = ((struct __pyx_t_5thinc_7weights_TrainFeat *)__pyx_f_7preshed_4maps_map_get(__pyx_v_maps, __pyx_v_key));

    /* "thinc/weights.pyx":46
 *             continue
 *         feature = <TrainFeat*>map_get(maps, key)
 *         if feature != NULL:             # <<<<<<<<<<<<<<
 *             feat_weights = feature.weights
 *             for row in range(feature.length):
 */
    __pyx_t_5 = ((__pyx_v_feature != NULL) != 0);
    if (__pyx_t_5) {

      /* "thinc/weights.pyx":47
 *         feature = <TrainFeat*>map_get(maps, key)
 *         if feature != NULL:
 *             feat_weights = feature.weights             # <<<<<<<<<<<<<<
 *             for row in range(feature.length):
 *                 w_lines[f_i] = feat_weights[row]
 */
      __pyx_t_7 = __pyx_v_feature->weights;
      __pyx_v_feat_weights = __pyx_t_7;

      /* "thinc/weights.pyx":48
 *         if feature != NULL:
 *             feat_weights = feature.weights
 *             for row in range(feature.length):             # <<<<<<<<<<<<<<
 *                 w_lines[f_i] = feat_weights[row]
 *                 if value != 1:
 */
      __pyx_t_8 = __pyx_v_feature->length;
      for (__pyx_t_9 = 0; __pyx_t_9 < __pyx_t_8; __pyx_t_9+=1) {
        __pyx_v_row = __pyx_t_9;

        /* "thinc/weights.pyx":49
 *             feat_weights = feature.weights
 *             for row in range(feature.length):
 *                 w_lines[f_i] = feat_weights[row]             # <<<<<<<<<<<<<<
 *                 if value != 1:
 *                     for j in range(LINE_SIZE):
 */
        (__pyx_v_w_lines[__pyx_v_f_i]) = (__pyx_v_feat_weights[__pyx_v_row]);

        /* "thinc/weights.pyx":50
 *             for row in range(feature.length):
 *                 w_lines[f_i] = feat_weights[row]
 *                 if value != 1:             # <<<<<<<<<<<<<<
 *                     for j in range(LINE_SIZE):
 *                         w_lines[f_i].line[j] *= value
 */
        __pyx_t_5 = ((__pyx_v_value != 1.0) != 0);
        if (__pyx_t_5) {

          /* "thinc/weights.pyx":51
 *                 w_lines[f_i] = feat_weights[row]
 *                 if value != 1:
 *                     for j in range(LINE_SIZE):             # <<<<<<<<<<<<<<
 *                         w_lines[f_i].line[j] *= value
 *                 f_i += 1
 */
          for (__pyx_t_10 = 0; __pyx_t_10 < 7; __pyx_t_10+=1) {
            __pyx_v_j = __pyx_t_10;

            /* "thinc/weights.pyx":52
 *                 if value != 1:
 *                     for j in range(LINE_SIZE):
 *                         w_lines[f_i].line[j] *= value             # <<<<<<<<<<<<<<
 *                 f_i += 1
 *     return f_i
 */
            __pyx_t_11 = __pyx_v_f_i;
            __pyx_t_12 = __pyx_v_j;
            ((__pyx_v_w_lines[__pyx_t_11]).line[__pyx_t_12]) = (((__pyx_v_w_lines[__pyx_t_11]).line[__pyx_t_12]) * __pyx_v_value);
          }
          goto __pyx_L11;
        }
        __pyx_L11:;

        /* "thinc/weights.pyx":53
 *                     for j in range(LINE_SIZE):
 *                         w_lines[f_i].line[j] *= value
 *                 f_i += 1             # <<<<<<<<<<<<<<
 *     return f_i
 * 
 */
        __pyx_v_f_i = (__pyx_v_f_i + 1);
      }
      goto __pyx_L8;
    }
    __pyx_L8:;
    __pyx_L3_continue:;
  }

  /* "thinc/weights.pyx":54
 *                         w_lines[f_i].line[j] *= value
 *                 f_i += 1
 *     return f_i             # <<<<<<<<<<<<<<
 * 
 * 
 */
  __pyx_r = __pyx_v_f_i;
  goto __pyx_L0;

  /* "thinc/weights.pyx":30
 * 
 * 
 * cdef int gather_weights(MapStruct* maps, const class_t nr_class,             # <<<<<<<<<<<<<<
 *         WeightLine* w_lines, const Feature* feats, const int n_feats) nogil:
 *     cdef:
 */

  /* function exit code */
  __pyx_L0:;
  return __pyx_r;
}

/* "thinc/weights.pyx":57
 * 
 * 
 * cdef int set_scores(weight_t* scores, const WeightLine* weight_lines,             # <<<<<<<<<<<<<<
 *         const class_t nr_rows, const class_t nr_class) nogil:
 *     cdef int row, col, max_col
 */

static int __pyx_f_5thinc_7weights_set_scores(__pyx_t_5thinc_8typedefs_weight_t *__pyx_v_scores, struct __pyx_t_5thinc_7weights_WeightLine const *__pyx_v_weight_lines, __pyx_t_5thinc_8typedefs_class_t const __pyx_v_nr_rows, __pyx_t_5thinc_8typedefs_class_t const __pyx_v_nr_class) {
  int __pyx_v_row;
  int __pyx_v_col;
  int __pyx_v_max_col;
  struct __pyx_t_5thinc_7weights_WeightLine const *__pyx_v_wline;
  __pyx_t_5thinc_8typedefs_weight_t *__pyx_v_row_scores;
  int __pyx_r;
  __pyx_t_5thinc_8typedefs_class_t __pyx_t_1;
  int __pyx_t_2;
  int __pyx_t_3;
  int __pyx_t_4;
  int __pyx_t_5;
  int __pyx_t_6;

  /* "thinc/weights.pyx":62
 *     cdef const WeightLine* wline
 *     cdef weight_t* row_scores
 *     for row in range(nr_rows):             # <<<<<<<<<<<<<<
 *         wline = &weight_lines[row]
 *         row_scores = &scores[wline.start]
 */
  __pyx_t_1 = __pyx_v_nr_rows;
  for (__pyx_t_2 = 0; __pyx_t_2 < __pyx_t_1; __pyx_t_2+=1) {
    __pyx_v_row = __pyx_t_2;

    /* "thinc/weights.pyx":63
 *     cdef weight_t* row_scores
 *     for row in range(nr_rows):
 *         wline = &weight_lines[row]             # <<<<<<<<<<<<<<
 *         row_scores = &scores[wline.start]
 *         max_col = nr_class - wline.start
 */
    __pyx_v_wline = (&(__pyx_v_weight_lines[__pyx_v_row]));

    /* "thinc/weights.pyx":64
 *     for row in range(nr_rows):
 *         wline = &weight_lines[row]
 *         row_scores = &scores[wline.start]             # <<<<<<<<<<<<<<
 *         max_col = nr_class - wline.start
 *         if max_col > LINE_SIZE:
 */
    __pyx_v_row_scores = (&(__pyx_v_scores[__pyx_v_wline->start]));

    /* "thinc/weights.pyx":65
 *         wline = &weight_lines[row]
 *         row_scores = &scores[wline.start]
 *         max_col = nr_class - wline.start             # <<<<<<<<<<<<<<
 *         if max_col > LINE_SIZE:
 *             max_col = LINE_SIZE
 */
    __pyx_v_max_col = (__pyx_v_nr_class - __pyx_v_wline->start);

    /* "thinc/weights.pyx":66
 *         row_scores = &scores[wline.start]
 *         max_col = nr_class - wline.start
 *         if max_col > LINE_SIZE:             # <<<<<<<<<<<<<<
 *             max_col = LINE_SIZE
 *         for col in range(max_col):
 */
    __pyx_t_3 = ((__pyx_v_max_col > 7) != 0);
    if (__pyx_t_3) {

      /* "thinc/weights.pyx":67
 *         max_col = nr_class - wline.start
 *         if max_col > LINE_SIZE:
 *             max_col = LINE_SIZE             # <<<<<<<<<<<<<<
 *         for col in range(max_col):
 *             row_scores[col] += wline.line[col]
 */
      __pyx_v_max_col = 7;
      goto __pyx_L5;
    }
    __pyx_L5:;

    /* "thinc/weights.pyx":68
 *         if max_col > LINE_SIZE:
 *             max_col = LINE_SIZE
 *         for col in range(max_col):             # <<<<<<<<<<<<<<
 *             row_scores[col] += wline.line[col]
 * 
 */
    __pyx_t_4 = __pyx_v_max_col;
    for (__pyx_t_5 = 0; __pyx_t_5 < __pyx_t_4; __pyx_t_5+=1) {
      __pyx_v_col = __pyx_t_5;

      /* "thinc/weights.pyx":69
 *             max_col = LINE_SIZE
 *         for col in range(max_col):
 *             row_scores[col] += wline.line[col]             # <<<<<<<<<<<<<<
 * 
 * 
 */
      __pyx_t_6 = __pyx_v_col;
      (__pyx_v_row_scores[__pyx_t_6]) = ((__pyx_v_row_scores[__pyx_t_6]) + (__pyx_v_wline->line[__pyx_v_col]));
    }
  }

  /* "thinc/weights.pyx":57
 * 
 * 
 * cdef int set_scores(weight_t* scores, const WeightLine* weight_lines,             # <<<<<<<<<<<<<<
 *         const class_t nr_rows, const class_t nr_class) nogil:
 *     cdef int row, col, max_col
 */

  /* function exit code */
  __pyx_r = 0;
  return __pyx_r;
}

/* "thinc/weights.pyx":72
 * 
 * 
 * cdef TrainFeat* new_train_feat(const class_t clas) except NULL:             # <<<<<<<<<<<<<<
 *     cdef TrainFeat* output = <TrainFeat*>PyMem_Malloc(sizeof(TrainFeat))
 *     output.weights = <WeightLine*>PyMem_Malloc(sizeof(WeightLine))
 */

static struct __pyx_t_5thinc_7weights_TrainFeat *__pyx_f_5thinc_7weights_new_train_feat(__pyx_t_5thinc_8typedefs_class_t const __pyx_v_clas) {
  struct __pyx_t_5thinc_7weights_TrainFeat *__pyx_v_output;
  struct __pyx_t_5thinc_7weights_TrainFeat *__pyx_r;
  __Pyx_RefNannyDeclarations
  __Pyx_RefNannySetupContext("new_train_feat", 0);

  /* "thinc/weights.pyx":73
 * 
 * cdef TrainFeat* new_train_feat(const class_t clas) except NULL:
 *     cdef TrainFeat* output = <TrainFeat*>PyMem_Malloc(sizeof(TrainFeat))             # <<<<<<<<<<<<<<
 *     output.weights = <WeightLine*>PyMem_Malloc(sizeof(WeightLine))
 *     memset(output.weights, 0, sizeof(WeightLine))
 */
  __pyx_v_output = ((struct __pyx_t_5thinc_7weights_TrainFeat *)PyMem_Malloc((sizeof(struct __pyx_t_5thinc_7weights_TrainFeat))));

  /* "thinc/weights.pyx":74
 * cdef TrainFeat* new_train_feat(const class_t clas) except NULL:
 *     cdef TrainFeat* output = <TrainFeat*>PyMem_Malloc(sizeof(TrainFeat))
 *     output.weights = <WeightLine*>PyMem_Malloc(sizeof(WeightLine))             # <<<<<<<<<<<<<<
 *     memset(output.weights, 0, sizeof(WeightLine))
 *     output.meta = <MDLine*>PyMem_Malloc(sizeof(MDLine))
 */
  __pyx_v_output->weights = ((struct __pyx_t_5thinc_7weights_WeightLine *)PyMem_Malloc((sizeof(struct __pyx_t_5thinc_7weights_WeightLine))));

  /* "thinc/weights.pyx":75
 *     cdef TrainFeat* output = <TrainFeat*>PyMem_Malloc(sizeof(TrainFeat))
 *     output.weights = <WeightLine*>PyMem_Malloc(sizeof(WeightLine))
 *     memset(output.weights, 0, sizeof(WeightLine))             # <<<<<<<<<<<<<<
 *     output.meta = <MDLine*>PyMem_Malloc(sizeof(MDLine))
 *     memset(output.meta, 0, sizeof(MDLine))
 */
  memset(__pyx_v_output->weights, 0, (sizeof(struct __pyx_t_5thinc_7weights_WeightLine)));

  /* "thinc/weights.pyx":76
 *     output.weights = <WeightLine*>PyMem_Malloc(sizeof(WeightLine))
 *     memset(output.weights, 0, sizeof(WeightLine))
 *     output.meta = <MDLine*>PyMem_Malloc(sizeof(MDLine))             # <<<<<<<<<<<<<<
 *     memset(output.meta, 0, sizeof(MDLine))
 *     output.length = 1
 */
  __pyx_v_output->meta = ((struct __pyx_t_5thinc_7weights_MDLine *)PyMem_Malloc((sizeof(struct __pyx_t_5thinc_7weights_MDLine))));

  /* "thinc/weights.pyx":77
 *     memset(output.weights, 0, sizeof(WeightLine))
 *     output.meta = <MDLine*>PyMem_Malloc(sizeof(MDLine))
 *     memset(output.meta, 0, sizeof(MDLine))             # <<<<<<<<<<<<<<
 *     output.length = 1
 *     output._resize_at = 1
 */
  memset(__pyx_v_output->meta, 0, (sizeof(struct __pyx_t_5thinc_7weights_MDLine)));

  /* "thinc/weights.pyx":78
 *     output.meta = <MDLine*>PyMem_Malloc(sizeof(MDLine))
 *     memset(output.meta, 0, sizeof(MDLine))
 *     output.length = 1             # <<<<<<<<<<<<<<
 *     output._resize_at = 1
 *     output.weights[0].start = clas - get_col(clas)
 */
  __pyx_v_output->length = 1;

  /* "thinc/weights.pyx":79
 *     memset(output.meta, 0, sizeof(MDLine))
 *     output.length = 1
 *     output._resize_at = 1             # <<<<<<<<<<<<<<
 *     output.weights[0].start = clas - get_col(clas)
 *     return output
 */
  __pyx_v_output->_resize_at = 1;

  /* "thinc/weights.pyx":80
 *     output.length = 1
 *     output._resize_at = 1
 *     output.weights[0].start = clas - get_col(clas)             # <<<<<<<<<<<<<<
 *     return output
 * 
 */
  (__pyx_v_output->weights[0]).start = (__pyx_v_clas - __pyx_f_5thinc_7weights_get_col(__pyx_v_clas));

  /* "thinc/weights.pyx":81
 *     output._resize_at = 1
 *     output.weights[0].start = clas - get_col(clas)
 *     return output             # <<<<<<<<<<<<<<
 * 
 * 
 */
  __pyx_r = __pyx_v_output;
  goto __pyx_L0;

  /* "thinc/weights.pyx":72
 * 
 * 
 * cdef TrainFeat* new_train_feat(const class_t clas) except NULL:             # <<<<<<<<<<<<<<
 *     cdef TrainFeat* output = <TrainFeat*>PyMem_Malloc(sizeof(TrainFeat))
 *     output.weights = <WeightLine*>PyMem_Malloc(sizeof(WeightLine))
 */

  /* function exit code */
  __pyx_L0:;
  __Pyx_RefNannyFinishContext();
  return __pyx_r;
}

/* "thinc/weights.pyx":84
 * 
 * 
 * cdef void free_feature(TrainFeat* feat) nogil:             # <<<<<<<<<<<<<<
 *     with gil:
 *         PyMem_Free(feat.weights)
 */

static void __pyx_f_5thinc_7weights_free_feature(struct __pyx_t_5thinc_7weights_TrainFeat *__pyx_v_feat) {
  __Pyx_RefNannyDeclarations
  #ifdef WITH_THREAD
  PyGILState_STATE __pyx_gilstate_save;
  #endif
  __Pyx_RefNannySetupContext("free_feature", 1);
  /*try:*/ {

    /* "thinc/weights.pyx":85
 * 
 * cdef void free_feature(TrainFeat* feat) nogil:
 *     with gil:             # <<<<<<<<<<<<<<
 *         PyMem_Free(feat.weights)
 *         PyMem_Free(feat.meta)
 */
    {
        #ifdef WITH_THREAD
        PyGILState_STATE __pyx_gilstate_save = PyGILState_Ensure();
        #endif
        /*try:*/ {

          /* "thinc/weights.pyx":86
 * cdef void free_feature(TrainFeat* feat) nogil:
 *     with gil:
 *         PyMem_Free(feat.weights)             # <<<<<<<<<<<<<<
 *         PyMem_Free(feat.meta)
 *         PyMem_Free(feat)
 */
          PyMem_Free(__pyx_v_feat->weights);

          /* "thinc/weights.pyx":87
 *     with gil:
 *         PyMem_Free(feat.weights)
 *         PyMem_Free(feat.meta)             # <<<<<<<<<<<<<<
 *         PyMem_Free(feat)
 * 
 */
          PyMem_Free(__pyx_v_feat->meta);

          /* "thinc/weights.pyx":88
 *         PyMem_Free(feat.weights)
 *         PyMem_Free(feat.meta)
 *         PyMem_Free(feat)             # <<<<<<<<<<<<<<
 * 
 * 
 */
          PyMem_Free(__pyx_v_feat);
        }

        /* "thinc/weights.pyx":85
 * 
 * cdef void free_feature(TrainFeat* feat) nogil:
 *     with gil:             # <<<<<<<<<<<<<<
 *         PyMem_Free(feat.weights)
 *         PyMem_Free(feat.meta)
 */
        /*finally:*/ {
          /*normal exit:*/{
            #ifdef WITH_THREAD
            PyGILState_Release(__pyx_gilstate_save);
            #endif
            goto __pyx_L8;
          }
          __pyx_L8:;
        }
    }
  }
  /*finally:*/ {
    /*normal exit:*/{
      #ifdef WITH_THREAD
      __pyx_gilstate_save = PyGILState_Ensure();
      #endif
      goto __pyx_L5;
    }
    __pyx_L5:;
  }

  /* "thinc/weights.pyx":84
 * 
 * 
 * cdef void free_feature(TrainFeat* feat) nogil:             # <<<<<<<<<<<<<<
 *     with gil:
 *         PyMem_Free(feat.weights)
 */

  /* function exit code */
  #ifdef WITH_THREAD
  PyGILState_Release(__pyx_gilstate_save);
  #endif
}

/* "thinc/weights.pyx":91
 * 
 * 
 * cdef int average_weight(TrainFeat* feat, const class_t nr_class, const time_t time) except -1:             # <<<<<<<<<<<<<<
 *     cdef time_t unchanged
 *     cdef class_t row
 */

static int __pyx_f_5thinc_7weights_average_weight(struct __pyx_t_5thinc_7weights_TrainFeat *__pyx_v_feat, CYTHON_UNUSED __pyx_t_5thinc_8typedefs_class_t const __pyx_v_nr_class, __pyx_t_5thinc_8typedefs_time_t const __pyx_v_time) {
  __pyx_t_5thinc_8typedefs_time_t __pyx_v_unchanged;
  __pyx_t_5thinc_8typedefs_class_t __pyx_v_row;
  __pyx_t_5thinc_8typedefs_class_t __pyx_v_col;
  int __pyx_r;
  __Pyx_RefNannyDeclarations
  uint32_t __pyx_t_1;
  __pyx_t_5thinc_8typedefs_class_t __pyx_t_2;
  __pyx_t_5thinc_8typedefs_class_t __pyx_t_3;
  __pyx_t_5thinc_8typedefs_class_t __pyx_t_4;
  __pyx_t_5thinc_8typedefs_class_t __pyx_t_5;
  int __pyx_lineno = 0;
  const char *__pyx_filename = NULL;
  int __pyx_clineno = 0;
  __Pyx_RefNannySetupContext("average_weight", 0);

  /* "thinc/weights.pyx":95
 *     cdef class_t row
 *     cdef class_t col
 *     for row in range(feat.length):             # <<<<<<<<<<<<<<
 *         for col in range(LINE_SIZE):
 *             unchanged = (time + 1) - feat.meta[row].line[col].time
 */
  __pyx_t_1 = __pyx_v_feat->length;
  for (__pyx_t_2 = 0; __pyx_t_2 < __pyx_t_1; __pyx_t_2+=1) {
    __pyx_v_row = __pyx_t_2;

    /* "thinc/weights.pyx":96
 *     cdef class_t col
 *     for row in range(feat.length):
 *         for col in range(LINE_SIZE):             # <<<<<<<<<<<<<<
 *             unchanged = (time + 1) - feat.meta[row].line[col].time
 *             feat.meta[row].line[col].total += unchanged * feat.weights[row].line[col]
 */
    for (__pyx_t_3 = 0; __pyx_t_3 < 7; __pyx_t_3+=1) {
      __pyx_v_col = __pyx_t_3;

      /* "thinc/weights.pyx":97
 *     for row in range(feat.length):
 *         for col in range(LINE_SIZE):
 *             unchanged = (time + 1) - feat.meta[row].line[col].time             # <<<<<<<<<<<<<<
 *             feat.meta[row].line[col].total += unchanged * feat.weights[row].line[col]
 *             feat.weights[row].line[col] = feat.meta[row].line[col].total / time
 */
      __pyx_v_unchanged = ((__pyx_v_time + 1) - ((__pyx_v_feat->meta[__pyx_v_row]).line[__pyx_v_col]).time);

      /* "thinc/weights.pyx":98
 *         for col in range(LINE_SIZE):
 *             unchanged = (time + 1) - feat.meta[row].line[col].time
 *             feat.meta[row].line[col].total += unchanged * feat.weights[row].line[col]             # <<<<<<<<<<<<<<
 *             feat.weights[row].line[col] = feat.meta[row].line[col].total / time
 *             #if abs(feat.weights[row].line[col]) < 1:
 */
      __pyx_t_4 = __pyx_v_row;
      __pyx_t_5 = __pyx_v_col;
      ((__pyx_v_feat->meta[__pyx_t_4]).line[__pyx_t_5]).total = (((__pyx_v_feat->meta[__pyx_t_4]).line[__pyx_t_5]).total + (__pyx_v_unchanged * ((__pyx_v_feat->weights[__pyx_v_row]).line[__pyx_v_col])));

      /* "thinc/weights.pyx":99
 *             unchanged = (time + 1) - feat.meta[row].line[col].time
 *             feat.meta[row].line[col].total += unchanged * feat.weights[row].line[col]
 *             feat.weights[row].line[col] = feat.meta[row].line[col].total / time             # <<<<<<<<<<<<<<
 *             #if abs(feat.weights[row].line[col]) < 1:
 *             #    feat.weights[row].line[col] = 0
 */
      if (unlikely(__pyx_v_time == 0)) {
        #ifdef WITH_THREAD
        PyGILState_STATE __pyx_gilstate_save = PyGILState_Ensure();
        #endif
        PyErr_SetString(PyExc_ZeroDivisionError, "float division");
        #ifdef WITH_THREAD
        PyGILState_Release(__pyx_gilstate_save);
        #endif
        {__pyx_filename = __pyx_f[0]; __pyx_lineno = 99; __pyx_clineno = __LINE__; goto __pyx_L1_error;}
      }
      ((__pyx_v_feat->weights[__pyx_v_row]).line[__pyx_v_col]) = (((__pyx_v_feat->meta[__pyx_v_row]).line[__pyx_v_col]).total / __pyx_v_time);
    }
  }

  /* "thinc/weights.pyx":91
 * 
 * 
 * cdef int average_weight(TrainFeat* feat, const class_t nr_class, const time_t time) except -1:             # <<<<<<<<<<<<<<
 *     cdef time_t unchanged
 *     cdef class_t row
 */

  /* function exit code */
  __pyx_r = 0;
  goto __pyx_L0;
  __pyx_L1_error:;
  __Pyx_AddTraceback("thinc.weights.average_weight", __pyx_clineno, __pyx_lineno, __pyx_filename);
  __pyx_r = -1;
  __pyx_L0:;
  __Pyx_RefNannyFinishContext();
  return __pyx_r;
}

/* "thinc/weights.pyx":105
 * 
 * @cython.overflowcheck(True)
 * cdef int perceptron_update_feature(TrainFeat* feat, class_t clas, weight_t upd,             # <<<<<<<<<<<<<<
 *                                    time_t time, class_t nr_classes) except -1:
 *     assert upd != 0
 */

static int __pyx_f_5thinc_7weights_perceptron_update_feature(struct __pyx_t_5thinc_7weights_TrainFeat *__pyx_v_feat, __pyx_t_5thinc_8typedefs_class_t __pyx_v_clas, __pyx_t_5thinc_8typedefs_weight_t __pyx_v_upd, __pyx_t_5thinc_8typedefs_time_t __pyx_v_time, __pyx_t_5thinc_8typedefs_class_t __pyx_v_nr_classes) {
  __pyx_t_5thinc_8typedefs_class_t __pyx_v_col;
  __pyx_t_5thinc_8typedefs_class_t __pyx_v_start;
  int __pyx_v_i;
  uint32_t __pyx_v_row;
  __pyx_t_5thinc_8typedefs_weight_t __pyx_v_weight;
  __pyx_t_5thinc_8typedefs_class_t __pyx_v_unchanged;
  int __pyx_r;
  __Pyx_RefNannyDeclarations
  int __pyx_t_1;
  int __pyx_t_2;
  uint32_t __pyx_t_3;
  int __pyx_t_4;
  uint32_t __pyx_t_5;
  __pyx_t_5thinc_8typedefs_time_t __pyx_t_6;
  __pyx_t_5thinc_8typedefs_class_t __pyx_t_7;
  int __pyx_lineno = 0;
  const char *__pyx_filename = NULL;
  int __pyx_clineno = 0;
  __Pyx_RefNannySetupContext("perceptron_update_feature", 0);

  /* "thinc/weights.pyx":107
 * cdef int perceptron_update_feature(TrainFeat* feat, class_t clas, weight_t upd,
 *                                    time_t time, class_t nr_classes) except -1:
 *     assert upd != 0             # <<<<<<<<<<<<<<
 *     cdef class_t col = get_col(clas)
 *     cdef class_t start = clas - col
 */
  #ifndef CYTHON_WITHOUT_ASSERTIONS
  if (unlikely(!Py_OptimizeFlag)) {
    if (unlikely(!((__pyx_v_upd != 0.0) != 0))) {
      PyErr_SetNone(PyExc_AssertionError);
      {__pyx_filename = __pyx_f[0]; __pyx_lineno = 107; __pyx_clineno = __LINE__; goto __pyx_L1_error;}
    }
  }
  #endif

  /* "thinc/weights.pyx":108
 *                                    time_t time, class_t nr_classes) except -1:
 *     assert upd != 0
 *     cdef class_t col = get_col(clas)             # <<<<<<<<<<<<<<
 *     cdef class_t start = clas - col
 *     cdef int i
 */
  __pyx_v_col = __pyx_f_5thinc_7weights_get_col(__pyx_v_clas);

  /* "thinc/weights.pyx":109
 *     assert upd != 0
 *     cdef class_t col = get_col(clas)
 *     cdef class_t start = clas - col             # <<<<<<<<<<<<<<
 *     cdef int i
 *     for i in range(feat.length):
 */
  __pyx_t_1 = 0;
  __pyx_t_2 = __Pyx_sub_int_checking_overflow(__pyx_v_clas, __pyx_v_col, &__pyx_t_1);
  if (unlikely(__pyx_t_1)) {
    PyErr_SetString(PyExc_OverflowError, "value too large");
    {__pyx_filename = __pyx_f[0]; __pyx_lineno = 109; __pyx_clineno = __LINE__; goto __pyx_L1_error;}
  }
  __pyx_v_start = __pyx_t_2;

  /* "thinc/weights.pyx":111
 *     cdef class_t start = clas - col
 *     cdef int i
 *     for i in range(feat.length):             # <<<<<<<<<<<<<<
 *         if feat.weights[i].start == start:
 *             row = i
 */
  __pyx_t_3 = __pyx_v_feat->length;
  for (__pyx_t_2 = 0; __pyx_t_2 < __pyx_t_3; __pyx_t_2+=1) {
    __pyx_v_i = __pyx_t_2;

    /* "thinc/weights.pyx":112
 *     cdef int i
 *     for i in range(feat.length):
 *         if feat.weights[i].start == start:             # <<<<<<<<<<<<<<
 *             row = i
 *             break
 */
    __pyx_t_4 = (((__pyx_v_feat->weights[__pyx_v_i]).start == __pyx_v_start) != 0);
    if (__pyx_t_4) {

      /* "thinc/weights.pyx":113
 *     for i in range(feat.length):
 *         if feat.weights[i].start == start:
 *             row = i             # <<<<<<<<<<<<<<
 *             break
 *         if feat.weights[i].start > start:
 */
      __pyx_v_row = __pyx_v_i;

      /* "thinc/weights.pyx":114
 *         if feat.weights[i].start == start:
 *             row = i
 *             break             # <<<<<<<<<<<<<<
 *         if feat.weights[i].start > start:
 *             row = i
 */
      goto __pyx_L4_break;
    }

    /* "thinc/weights.pyx":115
 *             row = i
 *             break
 *         if feat.weights[i].start > start:             # <<<<<<<<<<<<<<
 *             row = i
 *             _insert_row(feat, i, start, nr_classes)
 */
    __pyx_t_4 = (((__pyx_v_feat->weights[__pyx_v_i]).start > __pyx_v_start) != 0);
    if (__pyx_t_4) {

      /* "thinc/weights.pyx":116
 *             break
 *         if feat.weights[i].start > start:
 *             row = i             # <<<<<<<<<<<<<<
 *             _insert_row(feat, i, start, nr_classes)
 *             break
 */
      __pyx_v_row = __pyx_v_i;

      /* "thinc/weights.pyx":117
 *         if feat.weights[i].start > start:
 *             row = i
 *             _insert_row(feat, i, start, nr_classes)             # <<<<<<<<<<<<<<
 *             break
 *     else:
 */
      __pyx_t_1 = __pyx_f_5thinc_7weights__insert_row(__pyx_v_feat, __pyx_v_i, __pyx_v_start, __pyx_v_nr_classes); if (unlikely(__pyx_t_1 == -1)) {__pyx_filename = __pyx_f[0]; __pyx_lineno = 117; __pyx_clineno = __LINE__; goto __pyx_L1_error;}

      /* "thinc/weights.pyx":118
 *             row = i
 *             _insert_row(feat, i, start, nr_classes)
 *             break             # <<<<<<<<<<<<<<
 *     else:
 *         row = feat.length
 */
      goto __pyx_L4_break;
    }
  }
  /*else*/ {

    /* "thinc/weights.pyx":120
 *             break
 *     else:
 *         row = feat.length             # <<<<<<<<<<<<<<
 *         _insert_row(feat, feat.length, start, nr_classes)
 *     cdef weight_t weight = feat.weights[row].line[col]
 */
    __pyx_t_5 = __pyx_v_feat->length;
    __pyx_v_row = __pyx_t_5;

    /* "thinc/weights.pyx":121
 *     else:
 *         row = feat.length
 *         _insert_row(feat, feat.length, start, nr_classes)             # <<<<<<<<<<<<<<
 *     cdef weight_t weight = feat.weights[row].line[col]
 *     cdef class_t unchanged = time - feat.meta[row].line[col].time
 */
    __pyx_t_2 = __pyx_f_5thinc_7weights__insert_row(__pyx_v_feat, __pyx_v_feat->length, __pyx_v_start, __pyx_v_nr_classes); if (unlikely(__pyx_t_2 == -1)) {__pyx_filename = __pyx_f[0]; __pyx_lineno = 121; __pyx_clineno = __LINE__; goto __pyx_L1_error;}
  }
  __pyx_L4_break:;

  /* "thinc/weights.pyx":122
 *         row = feat.length
 *         _insert_row(feat, feat.length, start, nr_classes)
 *     cdef weight_t weight = feat.weights[row].line[col]             # <<<<<<<<<<<<<<
 *     cdef class_t unchanged = time - feat.meta[row].line[col].time
 *     feat.meta[row].line[col].total += unchanged * weight
 */
  __pyx_v_weight = ((__pyx_v_feat->weights[__pyx_v_row]).line[__pyx_v_col]);

  /* "thinc/weights.pyx":123
 *         _insert_row(feat, feat.length, start, nr_classes)
 *     cdef weight_t weight = feat.weights[row].line[col]
 *     cdef class_t unchanged = time - feat.meta[row].line[col].time             # <<<<<<<<<<<<<<
 *     feat.meta[row].line[col].total += unchanged * weight
 *     feat.meta[row].line[col].time = time
 */
  __pyx_t_2 = 0;
  __pyx_t_6 = __Pyx_sub___pyx_t_5thinc_8typedefs_time_t_checking_overflow(__pyx_v_time, ((__pyx_v_feat->meta[__pyx_v_row]).line[__pyx_v_col]).time, &__pyx_t_2);
  if (unlikely(__pyx_t_2)) {
    PyErr_SetString(PyExc_OverflowError, "value too large");
    {__pyx_filename = __pyx_f[0]; __pyx_lineno = 123; __pyx_clineno = __LINE__; goto __pyx_L1_error;}
  }
  __pyx_v_unchanged = __pyx_t_6;

  /* "thinc/weights.pyx":124
 *     cdef weight_t weight = feat.weights[row].line[col]
 *     cdef class_t unchanged = time - feat.meta[row].line[col].time
 *     feat.meta[row].line[col].total += unchanged * weight             # <<<<<<<<<<<<<<
 *     feat.meta[row].line[col].time = time
 *     feat.weights[row].line[col] += upd
 */
  __pyx_t_3 = __pyx_v_row;
  __pyx_t_7 = __pyx_v_col;
  ((__pyx_v_feat->meta[__pyx_t_3]).line[__pyx_t_7]).total = (((__pyx_v_feat->meta[__pyx_t_3]).line[__pyx_t_7]).total + (__pyx_v_unchanged * __pyx_v_weight));

  /* "thinc/weights.pyx":125
 *     cdef class_t unchanged = time - feat.meta[row].line[col].time
 *     feat.meta[row].line[col].total += unchanged * weight
 *     feat.meta[row].line[col].time = time             # <<<<<<<<<<<<<<
 *     feat.weights[row].line[col] += upd
 * 
 */
  ((__pyx_v_feat->meta[__pyx_v_row]).line[__pyx_v_col]).time = __pyx_v_time;

  /* "thinc/weights.pyx":126
 *     feat.meta[row].line[col].total += unchanged * weight
 *     feat.meta[row].line[col].time = time
 *     feat.weights[row].line[col] += upd             # <<<<<<<<<<<<<<
 * 
 * 
 */
  __pyx_t_3 = __pyx_v_row;
  __pyx_t_7 = __pyx_v_col;
  ((__pyx_v_feat->weights[__pyx_t_3]).line[__pyx_t_7]) = (((__pyx_v_feat->weights[__pyx_t_3]).line[__pyx_t_7]) + __pyx_v_upd);

  /* "thinc/weights.pyx":105
 * 
 * @cython.overflowcheck(True)
 * cdef int perceptron_update_feature(TrainFeat* feat, class_t clas, weight_t upd,             # <<<<<<<<<<<<<<
 *                                    time_t time, class_t nr_classes) except -1:
 *     assert upd != 0
 */

  /* function exit code */
  __pyx_r = 0;
  goto __pyx_L0;
  __pyx_L1_error:;
  __Pyx_AddTraceback("thinc.weights.perceptron_update_feature", __pyx_clineno, __pyx_lineno, __pyx_filename);
  __pyx_r = -1;
  __pyx_L0:;
  __Pyx_RefNannyFinishContext();
  return __pyx_r;
}

/* "thinc/weights.pyx":129
 * 
 * 
 * cdef int _insert_row(TrainFeat* feat, int i, class_t start, class_t nr_classes) except -1:             # <<<<<<<<<<<<<<
 *     cdef class_t nr_rows = get_nr_rows(nr_classes)
 *     if feat.length == feat._resize_at:
 */

static int __pyx_f_5thinc_7weights__insert_row(struct __pyx_t_5thinc_7weights_TrainFeat *__pyx_v_feat, int __pyx_v_i, __pyx_t_5thinc_8typedefs_class_t __pyx_v_start, __pyx_t_5thinc_8typedefs_class_t __pyx_v_nr_classes) {
  __pyx_t_5thinc_8typedefs_class_t __pyx_v_nr_rows;
  PyObject *__pyx_v_new_size = NULL;
  int __pyx_r;
  __Pyx_RefNannyDeclarations
  int __pyx_t_1;
  PyObject *__pyx_t_2 = NULL;
  PyObject *__pyx_t_3 = NULL;
  size_t __pyx_t_4;
  uint32_t __pyx_t_5;
  int __pyx_lineno = 0;
  const char *__pyx_filename = NULL;
  int __pyx_clineno = 0;
  __Pyx_RefNannySetupContext("_insert_row", 0);

  /* "thinc/weights.pyx":130
 * 
 * cdef int _insert_row(TrainFeat* feat, int i, class_t start, class_t nr_classes) except -1:
 *     cdef class_t nr_rows = get_nr_rows(nr_classes)             # <<<<<<<<<<<<<<
 *     if feat.length == feat._resize_at:
 *         new_size = (feat.length +1) * 2 if (feat.length+1) * 2 < nr_rows else nr_rows
 */
  __pyx_v_nr_rows = __pyx_f_5thinc_7weights_get_nr_rows(__pyx_v_nr_classes);

  /* "thinc/weights.pyx":131
 * cdef int _insert_row(TrainFeat* feat, int i, class_t start, class_t nr_classes) except -1:
 *     cdef class_t nr_rows = get_nr_rows(nr_classes)
 *     if feat.length == feat._resize_at:             # <<<<<<<<<<<<<<
 *         new_size = (feat.length +1) * 2 if (feat.length+1) * 2 < nr_rows else nr_rows
 *         feat.weights = <WeightLine*>PyMem_Realloc(feat.weights, new_size * sizeof(WeightLine))
 */
  __pyx_t_1 = ((__pyx_v_feat->length == __pyx_v_feat->_resize_at) != 0);
  if (__pyx_t_1) {

    /* "thinc/weights.pyx":132
 *     cdef class_t nr_rows = get_nr_rows(nr_classes)
 *     if feat.length == feat._resize_at:
 *         new_size = (feat.length +1) * 2 if (feat.length+1) * 2 < nr_rows else nr_rows             # <<<<<<<<<<<<<<
 *         feat.weights = <WeightLine*>PyMem_Realloc(feat.weights, new_size * sizeof(WeightLine))
 *         feat.meta = <MDLine*>PyMem_Realloc(feat.meta, new_size * sizeof(MDLine))
 */
    if (((((__pyx_v_feat->length + 1) * 2) < __pyx_v_nr_rows) != 0)) {
      __pyx_t_3 = __Pyx_PyInt_From_long(((__pyx_v_feat->length + 1) * 2)); if (unlikely(!__pyx_t_3)) {__pyx_filename = __pyx_f[0]; __pyx_lineno = 132; __pyx_clineno = __LINE__; goto __pyx_L1_error;}
      __Pyx_GOTREF(__pyx_t_3);
      __pyx_t_2 = __pyx_t_3;
      __pyx_t_3 = 0;
    } else {
      __pyx_t_3 = __Pyx_PyInt_From_int32_t(__pyx_v_nr_rows); if (unlikely(!__pyx_t_3)) {__pyx_filename = __pyx_f[0]; __pyx_lineno = 132; __pyx_clineno = __LINE__; goto __pyx_L1_error;}
      __Pyx_GOTREF(__pyx_t_3);
      __pyx_t_2 = __pyx_t_3;
      __pyx_t_3 = 0;
    }
    __pyx_v_new_size = __pyx_t_2;
    __pyx_t_2 = 0;

    /* "thinc/weights.pyx":133
 *     if feat.length == feat._resize_at:
 *         new_size = (feat.length +1) * 2 if (feat.length+1) * 2 < nr_rows else nr_rows
 *         feat.weights = <WeightLine*>PyMem_Realloc(feat.weights, new_size * sizeof(WeightLine))             # <<<<<<<<<<<<<<
 *         feat.meta = <MDLine*>PyMem_Realloc(feat.meta, new_size * sizeof(MDLine))
 *         feat._resize_at = new_size
 */
    __pyx_t_2 = __Pyx_PyInt_FromSize_t((sizeof(struct __pyx_t_5thinc_7weights_WeightLine))); if (unlikely(!__pyx_t_2)) {__pyx_filename = __pyx_f[0]; __pyx_lineno = 133; __pyx_clineno = __LINE__; goto __pyx_L1_error;}
    __Pyx_GOTREF(__pyx_t_2);
    __pyx_t_3 = PyNumber_Multiply(__pyx_v_new_size, __pyx_t_2); if (unlikely(!__pyx_t_3)) {__pyx_filename = __pyx_f[0]; __pyx_lineno = 133; __pyx_clineno = __LINE__; goto __pyx_L1_error;}
    __Pyx_GOTREF(__pyx_t_3);
    __Pyx_DECREF(__pyx_t_2); __pyx_t_2 = 0;
    __pyx_t_4 = __Pyx_PyInt_As_size_t(__pyx_t_3); if (unlikely((__pyx_t_4 == (size_t)-1) && PyErr_Occurred())) {__pyx_filename = __pyx_f[0]; __pyx_lineno = 133; __pyx_clineno = __LINE__; goto __pyx_L1_error;}
    __Pyx_DECREF(__pyx_t_3); __pyx_t_3 = 0;
    __pyx_v_feat->weights = ((struct __pyx_t_5thinc_7weights_WeightLine *)PyMem_Realloc(__pyx_v_feat->weights, __pyx_t_4));

    /* "thinc/weights.pyx":134
 *         new_size = (feat.length +1) * 2 if (feat.length+1) * 2 < nr_rows else nr_rows
 *         feat.weights = <WeightLine*>PyMem_Realloc(feat.weights, new_size * sizeof(WeightLine))
 *         feat.meta = <MDLine*>PyMem_Realloc(feat.meta, new_size * sizeof(MDLine))             # <<<<<<<<<<<<<<
 *         feat._resize_at = new_size
 *     memmove(&feat.weights[i+1], &feat.weights[i], (feat.length - i) * sizeof(WeightLine))
 */
    __pyx_t_3 = __Pyx_PyInt_FromSize_t((sizeof(struct __pyx_t_5thinc_7weights_MDLine))); if (unlikely(!__pyx_t_3)) {__pyx_filename = __pyx_f[0]; __pyx_lineno = 134; __pyx_clineno = __LINE__; goto __pyx_L1_error;}
    __Pyx_GOTREF(__pyx_t_3);
    __pyx_t_2 = PyNumber_Multiply(__pyx_v_new_size, __pyx_t_3); if (unlikely(!__pyx_t_2)) {__pyx_filename = __pyx_f[0]; __pyx_lineno = 134; __pyx_clineno = __LINE__; goto __pyx_L1_error;}
    __Pyx_GOTREF(__pyx_t_2);
    __Pyx_DECREF(__pyx_t_3); __pyx_t_3 = 0;
    __pyx_t_4 = __Pyx_PyInt_As_size_t(__pyx_t_2); if (unlikely((__pyx_t_4 == (size_t)-1) && PyErr_Occurred())) {__pyx_filename = __pyx_f[0]; __pyx_lineno = 134; __pyx_clineno = __LINE__; goto __pyx_L1_error;}
    __Pyx_DECREF(__pyx_t_2); __pyx_t_2 = 0;
    __pyx_v_feat->meta = ((struct __pyx_t_5thinc_7weights_MDLine *)PyMem_Realloc(__pyx_v_feat->meta, __pyx_t_4));

    /* "thinc/weights.pyx":135
 *         feat.weights = <WeightLine*>PyMem_Realloc(feat.weights, new_size * sizeof(WeightLine))
 *         feat.meta = <MDLine*>PyMem_Realloc(feat.meta, new_size * sizeof(MDLine))
 *         feat._resize_at = new_size             # <<<<<<<<<<<<<<
 *     memmove(&feat.weights[i+1], &feat.weights[i], (feat.length - i) * sizeof(WeightLine))
 *     memmove(&feat.meta[i+1], &feat.meta[i], (feat.length - i) * sizeof(MDLine))
 */
    __pyx_t_5 = __Pyx_PyInt_As_uint32_t(__pyx_v_new_size); if (unlikely((__pyx_t_5 == (uint32_t)-1) && PyErr_Occurred())) {__pyx_filename = __pyx_f[0]; __pyx_lineno = 135; __pyx_clineno = __LINE__; goto __pyx_L1_error;}
    __pyx_v_feat->_resize_at = __pyx_t_5;
    goto __pyx_L3;
  }
  __pyx_L3:;

  /* "thinc/weights.pyx":136
 *         feat.meta = <MDLine*>PyMem_Realloc(feat.meta, new_size * sizeof(MDLine))
 *         feat._resize_at = new_size
 *     memmove(&feat.weights[i+1], &feat.weights[i], (feat.length - i) * sizeof(WeightLine))             # <<<<<<<<<<<<<<
 *     memmove(&feat.meta[i+1], &feat.meta[i], (feat.length - i) * sizeof(MDLine))
 * 
 */
  memmove((&(__pyx_v_feat->weights[(__pyx_v_i + 1)])), (&(__pyx_v_feat->weights[__pyx_v_i])), ((__pyx_v_feat->length - __pyx_v_i) * (sizeof(struct __pyx_t_5thinc_7weights_WeightLine))));

  /* "thinc/weights.pyx":137
 *         feat._resize_at = new_size
 *     memmove(&feat.weights[i+1], &feat.weights[i], (feat.length - i) * sizeof(WeightLine))
 *     memmove(&feat.meta[i+1], &feat.meta[i], (feat.length - i) * sizeof(MDLine))             # <<<<<<<<<<<<<<
 * 
 *     memset(&feat.weights[i], 0, sizeof(WeightLine))
 */
  memmove((&(__pyx_v_feat->meta[(__pyx_v_i + 1)])), (&(__pyx_v_feat->meta[__pyx_v_i])), ((__pyx_v_feat->length - __pyx_v_i) * (sizeof(struct __pyx_t_5thinc_7weights_MDLine))));

  /* "thinc/weights.pyx":139
 *     memmove(&feat.meta[i+1], &feat.meta[i], (feat.length - i) * sizeof(MDLine))
 * 
 *     memset(&feat.weights[i], 0, sizeof(WeightLine))             # <<<<<<<<<<<<<<
 *     memset(&feat.meta[i], 0, sizeof(MDLine))
 * 
 */
  memset((&(__pyx_v_feat->weights[__pyx_v_i])), 0, (sizeof(struct __pyx_t_5thinc_7weights_WeightLine)));

  /* "thinc/weights.pyx":140
 * 
 *     memset(&feat.weights[i], 0, sizeof(WeightLine))
 *     memset(&feat.meta[i], 0, sizeof(MDLine))             # <<<<<<<<<<<<<<
 * 
 *     feat.weights[i].start = start
 */
  memset((&(__pyx_v_feat->meta[__pyx_v_i])), 0, (sizeof(struct __pyx_t_5thinc_7weights_MDLine)));

  /* "thinc/weights.pyx":142
 *     memset(&feat.meta[i], 0, sizeof(MDLine))
 * 
 *     feat.weights[i].start = start             # <<<<<<<<<<<<<<
 *     feat.length += 1
 * 
 */
  (__pyx_v_feat->weights[__pyx_v_i]).start = __pyx_v_start;

  /* "thinc/weights.pyx":143
 * 
 *     feat.weights[i].start = start
 *     feat.length += 1             # <<<<<<<<<<<<<<
 * 
 * 
 */
  __pyx_v_feat->length = (__pyx_v_feat->length + 1);

  /* "thinc/weights.pyx":129
 * 
 * 
 * cdef int _insert_row(TrainFeat* feat, int i, class_t start, class_t nr_classes) except -1:             # <<<<<<<<<<<<<<
 *     cdef class_t nr_rows = get_nr_rows(nr_classes)
 *     if feat.length == feat._resize_at:
 */

  /* function exit code */
  __pyx_r = 0;
  goto __pyx_L0;
  __pyx_L1_error:;
  __Pyx_XDECREF(__pyx_t_2);
  __Pyx_XDECREF(__pyx_t_3);
  __Pyx_AddTraceback("thinc.weights._insert_row", __pyx_clineno, __pyx_lineno, __pyx_filename);
  __pyx_r = -1;
  __pyx_L0:;
  __Pyx_XDECREF(__pyx_v_new_size);
  __Pyx_RefNannyFinishContext();
  return __pyx_r;
}

static PyMethodDef __pyx_methods[] = {
  {0, 0, 0, 0}
};

#if PY_MAJOR_VERSION >= 3
static struct PyModuleDef __pyx_moduledef = {
  #if PY_VERSION_HEX < 0x03020000
    { PyObject_HEAD_INIT(NULL) NULL, 0, NULL },
  #else
    PyModuleDef_HEAD_INIT,
  #endif
    "weights",
    0, /* m_doc */
    -1, /* m_size */
    __pyx_methods /* m_methods */,
    NULL, /* m_reload */
    NULL, /* m_traverse */
    NULL, /* m_clear */
    NULL /* m_free */
};
#endif

static __Pyx_StringTabEntry __pyx_string_tab[] = {
  {&__pyx_n_s_main, __pyx_k_main, sizeof(__pyx_k_main), 0, 0, 1, 1},
  {&__pyx_n_s_pyx_vtable, __pyx_k_pyx_vtable, sizeof(__pyx_k_pyx_vtable), 0, 0, 1, 1},
  {&__pyx_n_s_range, __pyx_k_range, sizeof(__pyx_k_range), 0, 0, 1, 1},
  {&__pyx_n_s_test, __pyx_k_test, sizeof(__pyx_k_test), 0, 0, 1, 1},
  {0, 0, 0, 0, 0, 0, 0}
};
static int __Pyx_InitCachedBuiltins(void) {
  __pyx_builtin_range = __Pyx_GetBuiltinName(__pyx_n_s_range); if (!__pyx_builtin_range) {__pyx_filename = __pyx_f[0]; __pyx_lineno = 40; __pyx_clineno = __LINE__; goto __pyx_L1_error;}
  return 0;
  __pyx_L1_error:;
  return -1;
}

static int __Pyx_InitCachedConstants(void) {
  __Pyx_RefNannyDeclarations
  __Pyx_RefNannySetupContext("__Pyx_InitCachedConstants", 0);
  __Pyx_RefNannyFinishContext();
  return 0;
}

static int __Pyx_InitGlobals(void) {
  /* Common.init */
  __Pyx_check_twos_complement();

if (unlikely(PyErr_Occurred())) {__pyx_filename = __pyx_f[0]; __pyx_lineno = 1; __pyx_clineno = __LINE__; goto __pyx_L1_error;}

  /* SizeCheck.init */
  __Pyx_check_sane___pyx_t_5thinc_8typedefs_time_t();

if (unlikely(PyErr_Occurred())) {__pyx_filename = __pyx_f[0]; __pyx_lineno = 1; __pyx_clineno = __LINE__; goto __pyx_L1_error;}

  if (__Pyx_InitStrings(__pyx_string_tab) < 0) {__pyx_filename = __pyx_f[0]; __pyx_lineno = 1; __pyx_clineno = __LINE__; goto __pyx_L1_error;};
  return 0;
  __pyx_L1_error:;
  return -1;
}

#if PY_MAJOR_VERSION < 3
PyMODINIT_FUNC initweights(void); /*proto*/
PyMODINIT_FUNC initweights(void)
#else
PyMODINIT_FUNC PyInit_weights(void); /*proto*/
PyMODINIT_FUNC PyInit_weights(void)
#endif
{
  PyObject *__pyx_t_1 = NULL;
  PyObject *__pyx_t_2 = NULL;
  int __pyx_lineno = 0;
  const char *__pyx_filename = NULL;
  int __pyx_clineno = 0;
  __Pyx_RefNannyDeclarations
  #if CYTHON_REFNANNY
  __Pyx_RefNanny = __Pyx_RefNannyImportAPI("refnanny");
  if (!__Pyx_RefNanny) {
      PyErr_Clear();
      __Pyx_RefNanny = __Pyx_RefNannyImportAPI("Cython.Runtime.refnanny");
      if (!__Pyx_RefNanny)
          Py_FatalError("failed to import 'refnanny' module");
  }
  #endif
  __Pyx_RefNannySetupContext("PyMODINIT_FUNC PyInit_weights(void)", 0);
  if ( __Pyx_check_binary_version() < 0) {__pyx_filename = __pyx_f[0]; __pyx_lineno = 1; __pyx_clineno = __LINE__; goto __pyx_L1_error;}
  __pyx_empty_tuple = PyTuple_New(0); if (unlikely(!__pyx_empty_tuple)) {__pyx_filename = __pyx_f[0]; __pyx_lineno = 1; __pyx_clineno = __LINE__; goto __pyx_L1_error;}
  __pyx_empty_bytes = PyBytes_FromStringAndSize("", 0); if (unlikely(!__pyx_empty_bytes)) {__pyx_filename = __pyx_f[0]; __pyx_lineno = 1; __pyx_clineno = __LINE__; goto __pyx_L1_error;}
  #ifdef __Pyx_CyFunction_USED
  if (__Pyx_CyFunction_init() < 0) {__pyx_filename = __pyx_f[0]; __pyx_lineno = 1; __pyx_clineno = __LINE__; goto __pyx_L1_error;}
  #endif
  #ifdef __Pyx_FusedFunction_USED
  if (__pyx_FusedFunction_init() < 0) {__pyx_filename = __pyx_f[0]; __pyx_lineno = 1; __pyx_clineno = __LINE__; goto __pyx_L1_error;}
  #endif
  #ifdef __Pyx_Generator_USED
  if (__pyx_Generator_init() < 0) {__pyx_filename = __pyx_f[0]; __pyx_lineno = 1; __pyx_clineno = __LINE__; goto __pyx_L1_error;}
  #endif
  /*--- Library function declarations ---*/
  /*--- Threads initialization code ---*/
  #if defined(__PYX_FORCE_INIT_THREADS) && __PYX_FORCE_INIT_THREADS
  #ifdef WITH_THREAD /* Python build with threading support? */
  PyEval_InitThreads();
  #endif
  #endif
  /*--- Module creation code ---*/
  #if PY_MAJOR_VERSION < 3
  __pyx_m = Py_InitModule4("weights", __pyx_methods, 0, 0, PYTHON_API_VERSION); Py_XINCREF(__pyx_m);
  #else
  __pyx_m = PyModule_Create(&__pyx_moduledef);
  #endif
  if (unlikely(!__pyx_m)) {__pyx_filename = __pyx_f[0]; __pyx_lineno = 1; __pyx_clineno = __LINE__; goto __pyx_L1_error;}
  __pyx_d = PyModule_GetDict(__pyx_m); if (unlikely(!__pyx_d)) {__pyx_filename = __pyx_f[0]; __pyx_lineno = 1; __pyx_clineno = __LINE__; goto __pyx_L1_error;}
  Py_INCREF(__pyx_d);
  __pyx_b = PyImport_AddModule(__Pyx_BUILTIN_MODULE_NAME); if (unlikely(!__pyx_b)) {__pyx_filename = __pyx_f[0]; __pyx_lineno = 1; __pyx_clineno = __LINE__; goto __pyx_L1_error;}
  #if CYTHON_COMPILING_IN_PYPY
  Py_INCREF(__pyx_b);
  #endif
  if (PyObject_SetAttrString(__pyx_m, "__builtins__", __pyx_b) < 0) {__pyx_filename = __pyx_f[0]; __pyx_lineno = 1; __pyx_clineno = __LINE__; goto __pyx_L1_error;};
  /*--- Initialize various global constants etc. ---*/
  if (unlikely(__Pyx_InitGlobals() < 0)) {__pyx_filename = __pyx_f[0]; __pyx_lineno = 1; __pyx_clineno = __LINE__; goto __pyx_L1_error;}
  #if PY_MAJOR_VERSION < 3 && (__PYX_DEFAULT_STRING_ENCODING_IS_ASCII || __PYX_DEFAULT_STRING_ENCODING_IS_DEFAULT)
  if (__Pyx_init_sys_getdefaultencoding_params() < 0) {__pyx_filename = __pyx_f[0]; __pyx_lineno = 1; __pyx_clineno = __LINE__; goto __pyx_L1_error;}
  #endif
  if (__pyx_module_is_main_thinc__weights) {
    if (PyObject_SetAttrString(__pyx_m, "__name__", __pyx_n_s_main) < 0) {__pyx_filename = __pyx_f[0]; __pyx_lineno = 1; __pyx_clineno = __LINE__; goto __pyx_L1_error;};
  }
  #if PY_MAJOR_VERSION >= 3
  {
    PyObject *modules = PyImport_GetModuleDict(); if (unlikely(!modules)) {__pyx_filename = __pyx_f[0]; __pyx_lineno = 1; __pyx_clineno = __LINE__; goto __pyx_L1_error;}
    if (!PyDict_GetItemString(modules, "thinc.weights")) {
      if (unlikely(PyDict_SetItemString(modules, "thinc.weights", __pyx_m) < 0)) {__pyx_filename = __pyx_f[0]; __pyx_lineno = 1; __pyx_clineno = __LINE__; goto __pyx_L1_error;}
    }
  }
  #endif
  /*--- Builtin init code ---*/
  if (unlikely(__Pyx_InitCachedBuiltins() < 0)) {__pyx_filename = __pyx_f[0]; __pyx_lineno = 1; __pyx_clineno = __LINE__; goto __pyx_L1_error;}
  /*--- Constants init code ---*/
  if (unlikely(__Pyx_InitCachedConstants() < 0)) {__pyx_filename = __pyx_f[0]; __pyx_lineno = 1; __pyx_clineno = __LINE__; goto __pyx_L1_error;}
  /*--- Global init code ---*/
  /*--- Variable export code ---*/
  /*--- Function export code ---*/
  if (__Pyx_ExportFunction("get_nr_rows", (void (*)(void))__pyx_f_5thinc_7weights_get_nr_rows, "__pyx_t_5thinc_8typedefs_class_t (__pyx_t_5thinc_8typedefs_class_t const )") < 0) {__pyx_filename = __pyx_f[0]; __pyx_lineno = 1; __pyx_clineno = __LINE__; goto __pyx_L1_error;}
  if (__Pyx_ExportFunction("average_weight", (void (*)(void))__pyx_f_5thinc_7weights_average_weight, "int (struct __pyx_t_5thinc_7weights_TrainFeat *, __pyx_t_5thinc_8typedefs_class_t const , __pyx_t_5thinc_8typedefs_time_t const )") < 0) {__pyx_filename = __pyx_f[0]; __pyx_lineno = 1; __pyx_clineno = __LINE__; goto __pyx_L1_error;}
  if (__Pyx_ExportFunction("new_train_feat", (void (*)(void))__pyx_f_5thinc_7weights_new_train_feat, "struct __pyx_t_5thinc_7weights_TrainFeat *(__pyx_t_5thinc_8typedefs_class_t const )") < 0) {__pyx_filename = __pyx_f[0]; __pyx_lineno = 1; __pyx_clineno = __LINE__; goto __pyx_L1_error;}
  if (__Pyx_ExportFunction("perceptron_update_feature", (void (*)(void))__pyx_f_5thinc_7weights_perceptron_update_feature, "int (struct __pyx_t_5thinc_7weights_TrainFeat *, __pyx_t_5thinc_8typedefs_class_t, __pyx_t_5thinc_8typedefs_weight_t, __pyx_t_5thinc_8typedefs_time_t, __pyx_t_5thinc_8typedefs_class_t const )") < 0) {__pyx_filename = __pyx_f[0]; __pyx_lineno = 1; __pyx_clineno = __LINE__; goto __pyx_L1_error;}
  if (__Pyx_ExportFunction("gather_weights", (void (*)(void))__pyx_f_5thinc_7weights_gather_weights, "int (struct __pyx_t_7preshed_4maps_MapStruct *, __pyx_t_5thinc_8typedefs_class_t const , struct __pyx_t_5thinc_7weights_WeightLine *, struct __pyx_t_5thinc_8features_Feature const *, int const )") < 0) {__pyx_filename = __pyx_f[0]; __pyx_lineno = 1; __pyx_clineno = __LINE__; goto __pyx_L1_error;}
  if (__Pyx_ExportFunction("set_scores", (void (*)(void))__pyx_f_5thinc_7weights_set_scores, "int (__pyx_t_5thinc_8typedefs_weight_t *, struct __pyx_t_5thinc_7weights_WeightLine const *, __pyx_t_5thinc_8typedefs_class_t const , __pyx_t_5thinc_8typedefs_class_t const )") < 0) {__pyx_filename = __pyx_f[0]; __pyx_lineno = 1; __pyx_clineno = __LINE__; goto __pyx_L1_error;}
  if (__Pyx_ExportFunction("free_feature", (void (*)(void))__pyx_f_5thinc_7weights_free_feature, "void (struct __pyx_t_5thinc_7weights_TrainFeat *)") < 0) {__pyx_filename = __pyx_f[0]; __pyx_lineno = 1; __pyx_clineno = __LINE__; goto __pyx_L1_error;}
  /*--- Type init code ---*/
  /*--- Type import code ---*/
  __pyx_ptype_5cymem_5cymem_Pool = __Pyx_ImportType("cymem.cymem", "Pool", sizeof(struct __pyx_obj_5cymem_5cymem_Pool), 1); if (unlikely(!__pyx_ptype_5cymem_5cymem_Pool)) {__pyx_filename = __pyx_f[1]; __pyx_lineno = 1; __pyx_clineno = __LINE__; goto __pyx_L1_error;}
  __pyx_vtabptr_5cymem_5cymem_Pool = (struct __pyx_vtabstruct_5cymem_5cymem_Pool*)__Pyx_GetVtable(__pyx_ptype_5cymem_5cymem_Pool->tp_dict); if (unlikely(!__pyx_vtabptr_5cymem_5cymem_Pool)) {__pyx_filename = __pyx_f[1]; __pyx_lineno = 1; __pyx_clineno = __LINE__; goto __pyx_L1_error;}
  __pyx_ptype_5cymem_5cymem_Address = __Pyx_ImportType("cymem.cymem", "Address", sizeof(struct __pyx_obj_5cymem_5cymem_Address), 1); if (unlikely(!__pyx_ptype_5cymem_5cymem_Address)) {__pyx_filename = __pyx_f[1]; __pyx_lineno = 10; __pyx_clineno = __LINE__; goto __pyx_L1_error;}
  __pyx_ptype_7preshed_4maps_PreshMap = __Pyx_ImportType("preshed.maps", "PreshMap", sizeof(struct __pyx_obj_7preshed_4maps_PreshMap), 1); if (unlikely(!__pyx_ptype_7preshed_4maps_PreshMap)) {__pyx_filename = __pyx_f[2]; __pyx_lineno = 32; __pyx_clineno = __LINE__; goto __pyx_L1_error;}
  __pyx_vtabptr_7preshed_4maps_PreshMap = (struct __pyx_vtabstruct_7preshed_4maps_PreshMap*)__Pyx_GetVtable(__pyx_ptype_7preshed_4maps_PreshMap->tp_dict); if (unlikely(!__pyx_vtabptr_7preshed_4maps_PreshMap)) {__pyx_filename = __pyx_f[2]; __pyx_lineno = 32; __pyx_clineno = __LINE__; goto __pyx_L1_error;}
  __pyx_ptype_7preshed_4maps_PreshMapArray = __Pyx_ImportType("preshed.maps", "PreshMapArray", sizeof(struct __pyx_obj_7preshed_4maps_PreshMapArray), 1); if (unlikely(!__pyx_ptype_7preshed_4maps_PreshMapArray)) {__pyx_filename = __pyx_f[2]; __pyx_lineno = 40; __pyx_clineno = __LINE__; goto __pyx_L1_error;}
  __pyx_vtabptr_7preshed_4maps_PreshMapArray = (struct __pyx_vtabstruct_7preshed_4maps_PreshMapArray*)__Pyx_GetVtable(__pyx_ptype_7preshed_4maps_PreshMapArray->tp_dict); if (unlikely(!__pyx_vtabptr_7preshed_4maps_PreshMapArray)) {__pyx_filename = __pyx_f[2]; __pyx_lineno = 40; __pyx_clineno = __LINE__; goto __pyx_L1_error;}
  __pyx_ptype_5thinc_8features_Extractor = __Pyx_ImportType("thinc.features", "Extractor", sizeof(struct __pyx_obj_5thinc_8features_Extractor), 1); if (unlikely(!__pyx_ptype_5thinc_8features_Extractor)) {__pyx_filename = __pyx_f[3]; __pyx_lineno = 20; __pyx_clineno = __LINE__; goto __pyx_L1_error;}
  __pyx_vtabptr_5thinc_8features_Extractor = (struct __pyx_vtabstruct_5thinc_8features_Extractor*)__Pyx_GetVtable(__pyx_ptype_5thinc_8features_Extractor->tp_dict); if (unlikely(!__pyx_vtabptr_5thinc_8features_Extractor)) {__pyx_filename = __pyx_f[3]; __pyx_lineno = 20; __pyx_clineno = __LINE__; goto __pyx_L1_error;}
  /*--- Variable import code ---*/
  /*--- Function import code ---*/
  __pyx_t_1 = __Pyx_ImportModule("preshed.maps"); if (!__pyx_t_1) {__pyx_filename = __pyx_f[0]; __pyx_lineno = 1; __pyx_clineno = __LINE__; goto __pyx_L1_error;}
  if (__Pyx_ImportFunction(__pyx_t_1, "map_get", (void (**)(void))&__pyx_f_7preshed_4maps_map_get, "void *(struct __pyx_t_7preshed_4maps_MapStruct const *, __pyx_t_7preshed_4maps_key_t const )") < 0) {__pyx_filename = __pyx_f[0]; __pyx_lineno = 1; __pyx_clineno = __LINE__; goto __pyx_L1_error;}
  Py_DECREF(__pyx_t_1); __pyx_t_1 = 0;
  /*--- Execution code ---*/

  /* "thinc/weights.pyx":1
 * cimport cython             # <<<<<<<<<<<<<<
 * from libc.math cimport sqrt
 * from cpython.mem cimport PyMem_Malloc, PyMem_Realloc, PyMem_Free
 */
  __pyx_t_2 = PyDict_New(); if (unlikely(!__pyx_t_2)) {__pyx_filename = __pyx_f[0]; __pyx_lineno = 1; __pyx_clineno = __LINE__; goto __pyx_L1_error;}
  __Pyx_GOTREF(__pyx_t_2);
  if (PyDict_SetItem(__pyx_d, __pyx_n_s_test, __pyx_t_2) < 0) {__pyx_filename = __pyx_f[0]; __pyx_lineno = 1; __pyx_clineno = __LINE__; goto __pyx_L1_error;}
  __Pyx_DECREF(__pyx_t_2); __pyx_t_2 = 0;

  /*--- Wrapped vars code ---*/

  goto __pyx_L0;
  __pyx_L1_error:;
  __Pyx_XDECREF(__pyx_t_1);
  __Pyx_XDECREF(__pyx_t_2);
  if (__pyx_m) {
    if (__pyx_d) {
      __Pyx_AddTraceback("init thinc.weights", __pyx_clineno, __pyx_lineno, __pyx_filename);
    }
    Py_DECREF(__pyx_m); __pyx_m = 0;
  } else if (!PyErr_Occurred()) {
    PyErr_SetString(PyExc_ImportError, "init thinc.weights");
  }
  __pyx_L0:;
  __Pyx_RefNannyFinishContext();
  #if PY_MAJOR_VERSION < 3
  return;
  #else
  return __pyx_m;
  #endif
}

/* Runtime support code */
#if CYTHON_REFNANNY
static __Pyx_RefNannyAPIStruct *__Pyx_RefNannyImportAPI(const char *modname) {
    PyObject *m = NULL, *p = NULL;
    void *r = NULL;
    m = PyImport_ImportModule((char *)modname);
    if (!m) goto end;
    p = PyObject_GetAttrString(m, (char *)"RefNannyAPI");
    if (!p) goto end;
    r = PyLong_AsVoidPtr(p);
end:
    Py_XDECREF(p);
    Py_XDECREF(m);
    return (__Pyx_RefNannyAPIStruct *)r;
}
#endif

static PyObject *__Pyx_GetBuiltinName(PyObject *name) {
    PyObject* result = __Pyx_PyObject_GetAttrStr(__pyx_b, name);
    if (unlikely(!result)) {
        PyErr_Format(PyExc_NameError,
#if PY_MAJOR_VERSION >= 3
            "name '%U' is not defined", name);
#else
            "name '%.200s' is not defined", PyString_AS_STRING(name));
#endif
    }
    return result;
}

static void* __Pyx_GetVtable(PyObject *dict) {
    void* ptr;
    PyObject *ob = PyObject_GetItem(dict, __pyx_n_s_pyx_vtable);
    if (!ob)
        goto bad;
#if PY_VERSION_HEX >= 0x02070000
    ptr = PyCapsule_GetPointer(ob, 0);
#else
    ptr = PyCObject_AsVoidPtr(ob);
#endif
    if (!ptr && !PyErr_Occurred())
        PyErr_SetString(PyExc_RuntimeError, "invalid vtable found for imported type");
    Py_DECREF(ob);
    return ptr;
bad:
    Py_XDECREF(ob);
    return NULL;
}

static int __pyx_bisect_code_objects(__Pyx_CodeObjectCacheEntry* entries, int count, int code_line) {
    int start = 0, mid = 0, end = count - 1;
    if (end >= 0 && code_line > entries[end].code_line) {
        return count;
    }
    while (start < end) {
        mid = (start + end) / 2;
        if (code_line < entries[mid].code_line) {
            end = mid;
        } else if (code_line > entries[mid].code_line) {
             start = mid + 1;
        } else {
            return mid;
        }
    }
    if (code_line <= entries[mid].code_line) {
        return mid;
    } else {
        return mid + 1;
    }
}
static PyCodeObject *__pyx_find_code_object(int code_line) {
    PyCodeObject* code_object;
    int pos;
    if (unlikely(!code_line) || unlikely(!__pyx_code_cache.entries)) {
        return NULL;
    }
    pos = __pyx_bisect_code_objects(__pyx_code_cache.entries, __pyx_code_cache.count, code_line);
    if (unlikely(pos >= __pyx_code_cache.count) || unlikely(__pyx_code_cache.entries[pos].code_line != code_line)) {
        return NULL;
    }
    code_object = __pyx_code_cache.entries[pos].code_object;
    Py_INCREF(code_object);
    return code_object;
}
static void __pyx_insert_code_object(int code_line, PyCodeObject* code_object) {
    int pos, i;
    __Pyx_CodeObjectCacheEntry* entries = __pyx_code_cache.entries;
    if (unlikely(!code_line)) {
        return;
    }
    if (unlikely(!entries)) {
        entries = (__Pyx_CodeObjectCacheEntry*)PyMem_Malloc(64*sizeof(__Pyx_CodeObjectCacheEntry));
        if (likely(entries)) {
            __pyx_code_cache.entries = entries;
            __pyx_code_cache.max_count = 64;
            __pyx_code_cache.count = 1;
            entries[0].code_line = code_line;
            entries[0].code_object = code_object;
            Py_INCREF(code_object);
        }
        return;
    }
    pos = __pyx_bisect_code_objects(__pyx_code_cache.entries, __pyx_code_cache.count, code_line);
    if ((pos < __pyx_code_cache.count) && unlikely(__pyx_code_cache.entries[pos].code_line == code_line)) {
        PyCodeObject* tmp = entries[pos].code_object;
        entries[pos].code_object = code_object;
        Py_DECREF(tmp);
        return;
    }
    if (__pyx_code_cache.count == __pyx_code_cache.max_count) {
        int new_max = __pyx_code_cache.max_count + 64;
        entries = (__Pyx_CodeObjectCacheEntry*)PyMem_Realloc(
            __pyx_code_cache.entries, (size_t)new_max*sizeof(__Pyx_CodeObjectCacheEntry));
        if (unlikely(!entries)) {
            return;
        }
        __pyx_code_cache.entries = entries;
        __pyx_code_cache.max_count = new_max;
    }
    for (i=__pyx_code_cache.count; i>pos; i--) {
        entries[i] = entries[i-1];
    }
    entries[pos].code_line = code_line;
    entries[pos].code_object = code_object;
    __pyx_code_cache.count++;
    Py_INCREF(code_object);
}

#include "compile.h"
#include "frameobject.h"
#include "traceback.h"
static PyCodeObject* __Pyx_CreateCodeObjectForTraceback(
            const char *funcname, int c_line,
            int py_line, const char *filename) {
    PyCodeObject *py_code = 0;
    PyObject *py_srcfile = 0;
    PyObject *py_funcname = 0;
    #if PY_MAJOR_VERSION < 3
    py_srcfile = PyString_FromString(filename);
    #else
    py_srcfile = PyUnicode_FromString(filename);
    #endif
    if (!py_srcfile) goto bad;
    if (c_line) {
        #if PY_MAJOR_VERSION < 3
        py_funcname = PyString_FromFormat( "%s (%s:%d)", funcname, __pyx_cfilenm, c_line);
        #else
        py_funcname = PyUnicode_FromFormat( "%s (%s:%d)", funcname, __pyx_cfilenm, c_line);
        #endif
    }
    else {
        #if PY_MAJOR_VERSION < 3
        py_funcname = PyString_FromString(funcname);
        #else
        py_funcname = PyUnicode_FromString(funcname);
        #endif
    }
    if (!py_funcname) goto bad;
    py_code = __Pyx_PyCode_New(
        0,
        0,
        0,
        0,
        0,
        __pyx_empty_bytes, /*PyObject *code,*/
        __pyx_empty_tuple, /*PyObject *consts,*/
        __pyx_empty_tuple, /*PyObject *names,*/
        __pyx_empty_tuple, /*PyObject *varnames,*/
        __pyx_empty_tuple, /*PyObject *freevars,*/
        __pyx_empty_tuple, /*PyObject *cellvars,*/
        py_srcfile,   /*PyObject *filename,*/
        py_funcname,  /*PyObject *name,*/
        py_line,
        __pyx_empty_bytes  /*PyObject *lnotab*/
    );
    Py_DECREF(py_srcfile);
    Py_DECREF(py_funcname);
    return py_code;
bad:
    Py_XDECREF(py_srcfile);
    Py_XDECREF(py_funcname);
    return NULL;
}
static void __Pyx_AddTraceback(const char *funcname, int c_line,
                               int py_line, const char *filename) {
    PyCodeObject *py_code = 0;
    PyFrameObject *py_frame = 0;
    py_code = __pyx_find_code_object(c_line ? c_line : py_line);
    if (!py_code) {
        py_code = __Pyx_CreateCodeObjectForTraceback(
            funcname, c_line, py_line, filename);
        if (!py_code) goto bad;
        __pyx_insert_code_object(c_line ? c_line : py_line, py_code);
    }
    py_frame = PyFrame_New(
        PyThreadState_GET(), /*PyThreadState *tstate,*/
        py_code,             /*PyCodeObject *code,*/
        __pyx_d,      /*PyObject *globals,*/
        0                    /*PyObject *locals*/
    );
    if (!py_frame) goto bad;
    py_frame->f_lineno = py_line;
    PyTraceBack_Here(py_frame);
bad:
    Py_XDECREF(py_code);
    Py_XDECREF(py_frame);
}

static CYTHON_INLINE PyObject* __Pyx_PyInt_From_int(int value) {
    const int neg_one = (int) -1, const_zero = 0;
    const int is_unsigned = neg_one > const_zero;
    if (is_unsigned) {
        if (sizeof(int) < sizeof(long)) {
            return PyInt_FromLong((long) value);
        } else if (sizeof(int) <= sizeof(unsigned long)) {
            return PyLong_FromUnsignedLong((unsigned long) value);
        } else if (sizeof(int) <= sizeof(unsigned long long)) {
            return PyLong_FromUnsignedLongLong((unsigned long long) value);
        }
    } else {
        if (sizeof(int) <= sizeof(long)) {
            return PyInt_FromLong((long) value);
        } else if (sizeof(int) <= sizeof(long long)) {
            return PyLong_FromLongLong((long long) value);
        }
    }
    {
        int one = 1; int little = (int)*(unsigned char *)&one;
        unsigned char *bytes = (unsigned char *)&value;
        return _PyLong_FromByteArray(bytes, sizeof(int),
                                     little, !is_unsigned);
    }
}

#define __PYX_VERIFY_RETURN_INT(target_type, func_type, func_value)       \
    {                                                                     \
        func_type value = func_value;                                     \
        if (sizeof(target_type) < sizeof(func_type)) {                    \
            if (unlikely(value != (func_type) (target_type) value)) {     \
                func_type zero = 0;                                       \
                if (is_unsigned && unlikely(value < zero))                \
                    goto raise_neg_overflow;                              \
                else                                                      \
                    goto raise_overflow;                                  \
            }                                                             \
        }                                                                 \
        return (target_type) value;                                       \
    }

#if CYTHON_COMPILING_IN_CPYTHON && PY_MAJOR_VERSION >= 3
 #if CYTHON_USE_PYLONG_INTERNALS
  #include "longintrepr.h"
 #endif
#endif

static CYTHON_INLINE int __Pyx_PyInt_As_int(PyObject *x) {
    const int neg_one = (int) -1, const_zero = 0;
    const int is_unsigned = neg_one > const_zero;
#if PY_MAJOR_VERSION < 3
    if (likely(PyInt_Check(x))) {
        if (sizeof(int) < sizeof(long)) {
            __PYX_VERIFY_RETURN_INT(int, long, PyInt_AS_LONG(x))
        } else {
            long val = PyInt_AS_LONG(x);
            if (is_unsigned && unlikely(val < 0)) {
                goto raise_neg_overflow;
            }
            return (int) val;
        }
    } else
#endif
    if (likely(PyLong_Check(x))) {
        if (is_unsigned) {
#if CYTHON_COMPILING_IN_CPYTHON && PY_MAJOR_VERSION >= 3
 #if CYTHON_USE_PYLONG_INTERNALS
            switch (Py_SIZE(x)) {
                case  0: return 0;
                case  1: __PYX_VERIFY_RETURN_INT(int, digit, ((PyLongObject*)x)->ob_digit[0]);
            }
 #endif
#endif
            if (unlikely(Py_SIZE(x) < 0)) {
                goto raise_neg_overflow;
            }
            if (sizeof(int) <= sizeof(unsigned long)) {
                __PYX_VERIFY_RETURN_INT(int, unsigned long, PyLong_AsUnsignedLong(x))
            } else if (sizeof(int) <= sizeof(unsigned long long)) {
                __PYX_VERIFY_RETURN_INT(int, unsigned long long, PyLong_AsUnsignedLongLong(x))
            }
        } else {
#if CYTHON_COMPILING_IN_CPYTHON && PY_MAJOR_VERSION >= 3
 #if CYTHON_USE_PYLONG_INTERNALS
            switch (Py_SIZE(x)) {
                case  0: return 0;
                case  1: __PYX_VERIFY_RETURN_INT(int,  digit, +(((PyLongObject*)x)->ob_digit[0]));
                case -1: __PYX_VERIFY_RETURN_INT(int, sdigit, -(sdigit) ((PyLongObject*)x)->ob_digit[0]);
            }
 #endif
#endif
            if (sizeof(int) <= sizeof(long)) {
                __PYX_VERIFY_RETURN_INT(int, long, PyLong_AsLong(x))
            } else if (sizeof(int) <= sizeof(long long)) {
                __PYX_VERIFY_RETURN_INT(int, long long, PyLong_AsLongLong(x))
            }
        }
        {
#if CYTHON_COMPILING_IN_PYPY && !defined(_PyLong_AsByteArray)
            PyErr_SetString(PyExc_RuntimeError,
                            "_PyLong_AsByteArray() not available in PyPy, cannot convert large numbers");
#else
            int val;
            PyObject *v = __Pyx_PyNumber_Int(x);
 #if PY_MAJOR_VERSION < 3
            if (likely(v) && !PyLong_Check(v)) {
                PyObject *tmp = v;
                v = PyNumber_Long(tmp);
                Py_DECREF(tmp);
            }
 #endif
            if (likely(v)) {
                int one = 1; int is_little = (int)*(unsigned char *)&one;
                unsigned char *bytes = (unsigned char *)&val;
                int ret = _PyLong_AsByteArray((PyLongObject *)v,
                                              bytes, sizeof(val),
                                              is_little, !is_unsigned);
                Py_DECREF(v);
                if (likely(!ret))
                    return val;
            }
#endif
            return (int) -1;
        }
    } else {
        int val;
        PyObject *tmp = __Pyx_PyNumber_Int(x);
        if (!tmp) return (int) -1;
        val = __Pyx_PyInt_As_int(tmp);
        Py_DECREF(tmp);
        return val;
    }
raise_overflow:
    PyErr_SetString(PyExc_OverflowError,
        "value too large to convert to int");
    return (int) -1;
raise_neg_overflow:
    PyErr_SetString(PyExc_OverflowError,
        "can't convert negative value to int");
    return (int) -1;
}

static CYTHON_INLINE PyObject* __Pyx_PyInt_From_uint32_t(uint32_t value) {
    const uint32_t neg_one = (uint32_t) -1, const_zero = 0;
    const int is_unsigned = neg_one > const_zero;
    if (is_unsigned) {
        if (sizeof(uint32_t) < sizeof(long)) {
            return PyInt_FromLong((long) value);
        } else if (sizeof(uint32_t) <= sizeof(unsigned long)) {
            return PyLong_FromUnsignedLong((unsigned long) value);
        } else if (sizeof(uint32_t) <= sizeof(unsigned long long)) {
            return PyLong_FromUnsignedLongLong((unsigned long long) value);
        }
    } else {
        if (sizeof(uint32_t) <= sizeof(long)) {
            return PyInt_FromLong((long) value);
        } else if (sizeof(uint32_t) <= sizeof(long long)) {
            return PyLong_FromLongLong((long long) value);
        }
    }
    {
        int one = 1; int little = (int)*(unsigned char *)&one;
        unsigned char *bytes = (unsigned char *)&value;
        return _PyLong_FromByteArray(bytes, sizeof(uint32_t),
                                     little, !is_unsigned);
    }
}

static CYTHON_INLINE PyObject* __Pyx_PyInt_From_int32_t(int32_t value) {
    const int32_t neg_one = (int32_t) -1, const_zero = 0;
    const int is_unsigned = neg_one > const_zero;
    if (is_unsigned) {
        if (sizeof(int32_t) < sizeof(long)) {
            return PyInt_FromLong((long) value);
        } else if (sizeof(int32_t) <= sizeof(unsigned long)) {
            return PyLong_FromUnsignedLong((unsigned long) value);
        } else if (sizeof(int32_t) <= sizeof(unsigned long long)) {
            return PyLong_FromUnsignedLongLong((unsigned long long) value);
        }
    } else {
        if (sizeof(int32_t) <= sizeof(long)) {
            return PyInt_FromLong((long) value);
        } else if (sizeof(int32_t) <= sizeof(long long)) {
            return PyLong_FromLongLong((long long) value);
        }
    }
    {
        int one = 1; int little = (int)*(unsigned char *)&one;
        unsigned char *bytes = (unsigned char *)&value;
        return _PyLong_FromByteArray(bytes, sizeof(int32_t),
                                     little, !is_unsigned);
    }
}

static CYTHON_INLINE int32_t __Pyx_PyInt_As_int32_t(PyObject *x) {
    const int32_t neg_one = (int32_t) -1, const_zero = 0;
    const int is_unsigned = neg_one > const_zero;
#if PY_MAJOR_VERSION < 3
    if (likely(PyInt_Check(x))) {
        if (sizeof(int32_t) < sizeof(long)) {
            __PYX_VERIFY_RETURN_INT(int32_t, long, PyInt_AS_LONG(x))
        } else {
            long val = PyInt_AS_LONG(x);
            if (is_unsigned && unlikely(val < 0)) {
                goto raise_neg_overflow;
            }
            return (int32_t) val;
        }
    } else
#endif
    if (likely(PyLong_Check(x))) {
        if (is_unsigned) {
#if CYTHON_COMPILING_IN_CPYTHON && PY_MAJOR_VERSION >= 3
 #if CYTHON_USE_PYLONG_INTERNALS
            switch (Py_SIZE(x)) {
                case  0: return 0;
                case  1: __PYX_VERIFY_RETURN_INT(int32_t, digit, ((PyLongObject*)x)->ob_digit[0]);
            }
 #endif
#endif
            if (unlikely(Py_SIZE(x) < 0)) {
                goto raise_neg_overflow;
            }
            if (sizeof(int32_t) <= sizeof(unsigned long)) {
                __PYX_VERIFY_RETURN_INT(int32_t, unsigned long, PyLong_AsUnsignedLong(x))
            } else if (sizeof(int32_t) <= sizeof(unsigned long long)) {
                __PYX_VERIFY_RETURN_INT(int32_t, unsigned long long, PyLong_AsUnsignedLongLong(x))
            }
        } else {
#if CYTHON_COMPILING_IN_CPYTHON && PY_MAJOR_VERSION >= 3
 #if CYTHON_USE_PYLONG_INTERNALS
            switch (Py_SIZE(x)) {
                case  0: return 0;
                case  1: __PYX_VERIFY_RETURN_INT(int32_t,  digit, +(((PyLongObject*)x)->ob_digit[0]));
                case -1: __PYX_VERIFY_RETURN_INT(int32_t, sdigit, -(sdigit) ((PyLongObject*)x)->ob_digit[0]);
            }
 #endif
#endif
            if (sizeof(int32_t) <= sizeof(long)) {
                __PYX_VERIFY_RETURN_INT(int32_t, long, PyLong_AsLong(x))
            } else if (sizeof(int32_t) <= sizeof(long long)) {
                __PYX_VERIFY_RETURN_INT(int32_t, long long, PyLong_AsLongLong(x))
            }
        }
        {
#if CYTHON_COMPILING_IN_PYPY && !defined(_PyLong_AsByteArray)
            PyErr_SetString(PyExc_RuntimeError,
                            "_PyLong_AsByteArray() not available in PyPy, cannot convert large numbers");
#else
            int32_t val;
            PyObject *v = __Pyx_PyNumber_Int(x);
 #if PY_MAJOR_VERSION < 3
            if (likely(v) && !PyLong_Check(v)) {
                PyObject *tmp = v;
                v = PyNumber_Long(tmp);
                Py_DECREF(tmp);
            }
 #endif
            if (likely(v)) {
                int one = 1; int is_little = (int)*(unsigned char *)&one;
                unsigned char *bytes = (unsigned char *)&val;
                int ret = _PyLong_AsByteArray((PyLongObject *)v,
                                              bytes, sizeof(val),
                                              is_little, !is_unsigned);
                Py_DECREF(v);
                if (likely(!ret))
                    return val;
            }
#endif
            return (int32_t) -1;
        }
    } else {
        int32_t val;
        PyObject *tmp = __Pyx_PyNumber_Int(x);
        if (!tmp) return (int32_t) -1;
        val = __Pyx_PyInt_As_int32_t(tmp);
        Py_DECREF(tmp);
        return val;
    }
raise_overflow:
    PyErr_SetString(PyExc_OverflowError,
        "value too large to convert to int32_t");
    return (int32_t) -1;
raise_neg_overflow:
    PyErr_SetString(PyExc_OverflowError,
        "can't convert negative value to int32_t");
    return (int32_t) -1;
}

static CYTHON_INLINE int __Pyx_add_int_checking_overflow(int a, int b, int *overflow) {
    if (sizeof(int) < sizeof(long)) {
        long big_r = ((long) a) + ((long) b);
        int r = (int) big_r;
        *overflow |= big_r != r;
        return r;
    } else if (sizeof(int) < sizeof(long long)) {
        long long big_r = ((long long) a) + ((long long) b);
        int r = (int) big_r;
        *overflow |= big_r != r;
        return r;
    } else {
        int r = (int) ((unsigned int) a + (unsigned int) b);
        int sign_a = __PYX_SIGN_BIT(int) & a;
        int sign_b = __PYX_SIGN_BIT(int) & b;
        int sign_r = __PYX_SIGN_BIT(int) & r;
        *overflow |= (sign_a == sign_b) & (sign_a != sign_r);
        return r;
    }
}
static CYTHON_INLINE int __Pyx_add_const_int_checking_overflow(int a, int b, int *overflow) {
    if (b > 0) {
        *overflow |= a > __PYX_MAX(int) - b;
    } else if (b < 0) {
        *overflow |= a < __PYX_MIN(int) - b;
    }
    return a + b;
}
static CYTHON_INLINE int __Pyx_sub_int_checking_overflow(int a, int b, int *overflow) {
    *overflow |= b == __PYX_MIN(int);
    return __Pyx_add_int_checking_overflow(a, -b, overflow);
}
static CYTHON_INLINE int __Pyx_sub_const_int_checking_overflow(int a, int b, int *overflow) {
    *overflow |= b == __PYX_MIN(int);
    return __Pyx_add_const_int_checking_overflow(a, -b, overflow);
}
static CYTHON_INLINE int __Pyx_mul_int_checking_overflow(int a, int b, int *overflow) {
    if (sizeof(int) < sizeof(long)) {
        long big_r = ((long) a) * ((long) b);
        int r = (int) big_r;
        *overflow |= big_r != r;
        return (int) r;
    } else if (sizeof(int) < sizeof(long long)) {
        long long big_r = ((long long) a) * ((long long) b);
        int r = (int) big_r;
        *overflow |= big_r != r;
        return (int) r;
    } else {
        int prod = a * b;
        double dprod = ((double) a) * ((double) b);
        *overflow |= fabs(dprod - prod) > (__PYX_MAX(int) / 2);
        return prod;
    }
}
static CYTHON_INLINE int __Pyx_mul_const_int_checking_overflow(int a, int b, int *overflow) {
    if (b > 1) {
        *overflow |= a > __PYX_MAX(int) / b;
        *overflow |= a < __PYX_MIN(int) / b;
    } else if (b == -1) {
        *overflow |= a == __PYX_MIN(int);
    } else if (b < -1) {
        *overflow |= a > __PYX_MIN(int) / b;
        *overflow |= a < __PYX_MAX(int) / b;
    }
    return a * b;
}
static CYTHON_INLINE int __Pyx_div_int_checking_overflow(int a, int b, int *overflow) {
    if (b == 0) {
        *overflow |= 1;
        return 0;
    }
    *overflow |= (a == __PYX_MIN(int)) & (b == -1);
    return a / b;
}

static CYTHON_INLINE long __Pyx_add_long_checking_overflow(long a, long b, int *overflow) {
    if (sizeof(long) < sizeof(long)) {
        long big_r = ((long) a) + ((long) b);
        long r = (long) big_r;
        *overflow |= big_r != r;
        return r;
    } else if (sizeof(long) < sizeof(long long)) {
        long long big_r = ((long long) a) + ((long long) b);
        long r = (long) big_r;
        *overflow |= big_r != r;
        return r;
    } else {
        long r = (long) ((unsigned long) a + (unsigned long) b);
        long sign_a = __PYX_SIGN_BIT(long) & a;
        long sign_b = __PYX_SIGN_BIT(long) & b;
        long sign_r = __PYX_SIGN_BIT(long) & r;
        *overflow |= (sign_a == sign_b) & (sign_a != sign_r);
        return r;
    }
}
static CYTHON_INLINE long __Pyx_add_const_long_checking_overflow(long a, long b, int *overflow) {
    if (b > 0) {
        *overflow |= a > __PYX_MAX(long) - b;
    } else if (b < 0) {
        *overflow |= a < __PYX_MIN(long) - b;
    }
    return a + b;
}
static CYTHON_INLINE long __Pyx_sub_long_checking_overflow(long a, long b, int *overflow) {
    *overflow |= b == __PYX_MIN(long);
    return __Pyx_add_long_checking_overflow(a, -b, overflow);
}
static CYTHON_INLINE long __Pyx_sub_const_long_checking_overflow(long a, long b, int *overflow) {
    *overflow |= b == __PYX_MIN(long);
    return __Pyx_add_const_long_checking_overflow(a, -b, overflow);
}
static CYTHON_INLINE long __Pyx_mul_long_checking_overflow(long a, long b, int *overflow) {
    if (sizeof(long) < sizeof(long)) {
        long big_r = ((long) a) * ((long) b);
        long r = (long) big_r;
        *overflow |= big_r != r;
        return (long) r;
    } else if (sizeof(long) < sizeof(long long)) {
        long long big_r = ((long long) a) * ((long long) b);
        long r = (long) big_r;
        *overflow |= big_r != r;
        return (long) r;
    } else {
        long prod = a * b;
        double dprod = ((double) a) * ((double) b);
        *overflow |= fabs(dprod - prod) > (__PYX_MAX(long) / 2);
        return prod;
    }
}
static CYTHON_INLINE long __Pyx_mul_const_long_checking_overflow(long a, long b, int *overflow) {
    if (b > 1) {
        *overflow |= a > __PYX_MAX(long) / b;
        *overflow |= a < __PYX_MIN(long) / b;
    } else if (b == -1) {
        *overflow |= a == __PYX_MIN(long);
    } else if (b < -1) {
        *overflow |= a > __PYX_MIN(long) / b;
        *overflow |= a < __PYX_MAX(long) / b;
    }
    return a * b;
}
static CYTHON_INLINE long __Pyx_div_long_checking_overflow(long a, long b, int *overflow) {
    if (b == 0) {
        *overflow |= 1;
        return 0;
    }
    *overflow |= (a == __PYX_MIN(long)) & (b == -1);
    return a / b;
}

static CYTHON_INLINE long long __Pyx_add_long_long_checking_overflow(long long a, long long b, int *overflow) {
    if (sizeof(long long) < sizeof(long)) {
        long big_r = ((long) a) + ((long) b);
        long long r = (long long) big_r;
        *overflow |= big_r != r;
        return r;
    } else if (sizeof(long long) < sizeof(long long)) {
        long long big_r = ((long long) a) + ((long long) b);
        long long r = (long long) big_r;
        *overflow |= big_r != r;
        return r;
    } else {
        long long r = (long long) ((unsigned long long) a + (unsigned long long) b);
        long long sign_a = __PYX_SIGN_BIT(long long) & a;
        long long sign_b = __PYX_SIGN_BIT(long long) & b;
        long long sign_r = __PYX_SIGN_BIT(long long) & r;
        *overflow |= (sign_a == sign_b) & (sign_a != sign_r);
        return r;
    }
}
static CYTHON_INLINE long long __Pyx_add_const_long_long_checking_overflow(long long a, long long b, int *overflow) {
    if (b > 0) {
        *overflow |= a > __PYX_MAX(long long) - b;
    } else if (b < 0) {
        *overflow |= a < __PYX_MIN(long long) - b;
    }
    return a + b;
}
static CYTHON_INLINE long long __Pyx_sub_long_long_checking_overflow(long long a, long long b, int *overflow) {
    *overflow |= b == __PYX_MIN(long long);
    return __Pyx_add_long_long_checking_overflow(a, -b, overflow);
}
static CYTHON_INLINE long long __Pyx_sub_const_long_long_checking_overflow(long long a, long long b, int *overflow) {
    *overflow |= b == __PYX_MIN(long long);
    return __Pyx_add_const_long_long_checking_overflow(a, -b, overflow);
}
static CYTHON_INLINE long long __Pyx_mul_long_long_checking_overflow(long long a, long long b, int *overflow) {
    if (sizeof(long long) < sizeof(long)) {
        long big_r = ((long) a) * ((long) b);
        long long r = (long long) big_r;
        *overflow |= big_r != r;
        return (long long) r;
    } else if (sizeof(long long) < sizeof(long long)) {
        long long big_r = ((long long) a) * ((long long) b);
        long long r = (long long) big_r;
        *overflow |= big_r != r;
        return (long long) r;
    } else {
        long long prod = a * b;
        double dprod = ((double) a) * ((double) b);
        *overflow |= fabs(dprod - prod) > (__PYX_MAX(long long) / 2);
        return prod;
    }
}
static CYTHON_INLINE long long __Pyx_mul_const_long_long_checking_overflow(long long a, long long b, int *overflow) {
    if (b > 1) {
        *overflow |= a > __PYX_MAX(long long) / b;
        *overflow |= a < __PYX_MIN(long long) / b;
    } else if (b == -1) {
        *overflow |= a == __PYX_MIN(long long);
    } else if (b < -1) {
        *overflow |= a > __PYX_MIN(long long) / b;
        *overflow |= a < __PYX_MAX(long long) / b;
    }
    return a * b;
}
static CYTHON_INLINE long long __Pyx_div_long_long_checking_overflow(long long a, long long b, int *overflow) {
    if (b == 0) {
        *overflow |= 1;
        return 0;
    }
    *overflow |= (a == __PYX_MIN(long long)) & (b == -1);
    return a / b;
}

static CYTHON_INLINE unsigned int __Pyx_add_unsigned_int_checking_overflow(unsigned int a, unsigned int b, int *overflow) {
    unsigned int r = a + b;
    *overflow |= r < a;
    return r;
}
static CYTHON_INLINE unsigned int __Pyx_sub_unsigned_int_checking_overflow(unsigned int a, unsigned int b, int *overflow) {
    unsigned int r = a - b;
    *overflow |= r > a;
    return r;
}
static CYTHON_INLINE unsigned int __Pyx_mul_unsigned_int_checking_overflow(unsigned int a, unsigned int b, int *overflow) {
    if (sizeof(unsigned int) < sizeof(unsigned long)) {
        unsigned long big_r = ((unsigned long) a) * ((unsigned long) b);
        unsigned int r = (unsigned int) big_r;
        *overflow |= big_r != r;
        return r;
    } else if (sizeof(unsigned int) < sizeof(unsigned long long)) {
        unsigned long long big_r = ((unsigned long long) a) * ((unsigned long long) b);
        unsigned int r = (unsigned int) big_r;
        *overflow |= big_r != r;
        return r;
    } else {
        unsigned int prod = a * b;
        double dprod = ((double) a) * ((double) b);
        *overflow |= fabs(dprod - prod) > (__PYX_MAX(unsigned int) / 2);
        return prod;
    }
}
static CYTHON_INLINE unsigned int __Pyx_mul_const_unsigned_int_checking_overflow(unsigned int a, unsigned int b, int *overflow) {
    if (b > 1) {
        *overflow |= a > __PYX_MAX(unsigned int) / b;
    }
    return a * b;
}
static CYTHON_INLINE unsigned int __Pyx_div_unsigned_int_checking_overflow(unsigned int a, unsigned int b, int *overflow) {
    if (b == 0) {
        *overflow |= 1;
        return 0;
    }
    return a / b;
}

static CYTHON_INLINE unsigned long __Pyx_add_unsigned_long_checking_overflow(unsigned long a, unsigned long b, int *overflow) {
    unsigned long r = a + b;
    *overflow |= r < a;
    return r;
}
static CYTHON_INLINE unsigned long __Pyx_sub_unsigned_long_checking_overflow(unsigned long a, unsigned long b, int *overflow) {
    unsigned long r = a - b;
    *overflow |= r > a;
    return r;
}
static CYTHON_INLINE unsigned long __Pyx_mul_unsigned_long_checking_overflow(unsigned long a, unsigned long b, int *overflow) {
    if (sizeof(unsigned long) < sizeof(unsigned long)) {
        unsigned long big_r = ((unsigned long) a) * ((unsigned long) b);
        unsigned long r = (unsigned long) big_r;
        *overflow |= big_r != r;
        return r;
    } else if (sizeof(unsigned long) < sizeof(unsigned long long)) {
        unsigned long long big_r = ((unsigned long long) a) * ((unsigned long long) b);
        unsigned long r = (unsigned long) big_r;
        *overflow |= big_r != r;
        return r;
    } else {
        unsigned long prod = a * b;
        double dprod = ((double) a) * ((double) b);
        *overflow |= fabs(dprod - prod) > (__PYX_MAX(unsigned long) / 2);
        return prod;
    }
}
static CYTHON_INLINE unsigned long __Pyx_mul_const_unsigned_long_checking_overflow(unsigned long a, unsigned long b, int *overflow) {
    if (b > 1) {
        *overflow |= a > __PYX_MAX(unsigned long) / b;
    }
    return a * b;
}
static CYTHON_INLINE unsigned long __Pyx_div_unsigned_long_checking_overflow(unsigned long a, unsigned long b, int *overflow) {
    if (b == 0) {
        *overflow |= 1;
        return 0;
    }
    return a / b;
}

static CYTHON_INLINE unsigned long long __Pyx_add_unsigned_long_long_checking_overflow(unsigned long long a, unsigned long long b, int *overflow) {
    unsigned long long r = a + b;
    *overflow |= r < a;
    return r;
}
static CYTHON_INLINE unsigned long long __Pyx_sub_unsigned_long_long_checking_overflow(unsigned long long a, unsigned long long b, int *overflow) {
    unsigned long long r = a - b;
    *overflow |= r > a;
    return r;
}
static CYTHON_INLINE unsigned long long __Pyx_mul_unsigned_long_long_checking_overflow(unsigned long long a, unsigned long long b, int *overflow) {
    if (sizeof(unsigned long long) < sizeof(unsigned long)) {
        unsigned long big_r = ((unsigned long) a) * ((unsigned long) b);
        unsigned long long r = (unsigned long long) big_r;
        *overflow |= big_r != r;
        return r;
    } else if (sizeof(unsigned long long) < sizeof(unsigned long long)) {
        unsigned long long big_r = ((unsigned long long) a) * ((unsigned long long) b);
        unsigned long long r = (unsigned long long) big_r;
        *overflow |= big_r != r;
        return r;
    } else {
        unsigned long long prod = a * b;
        double dprod = ((double) a) * ((double) b);
        *overflow |= fabs(dprod - prod) > (__PYX_MAX(unsigned long long) / 2);
        return prod;
    }
}
static CYTHON_INLINE unsigned long long __Pyx_mul_const_unsigned_long_long_checking_overflow(unsigned long long a, unsigned long long b, int *overflow) {
    if (b > 1) {
        *overflow |= a > __PYX_MAX(unsigned long long) / b;
    }
    return a * b;
}
static CYTHON_INLINE unsigned long long __Pyx_div_unsigned_long_long_checking_overflow(unsigned long long a, unsigned long long b, int *overflow) {
    if (b == 0) {
        *overflow |= 1;
        return 0;
    }
    return a / b;
}

static CYTHON_INLINE __pyx_t_5thinc_8typedefs_time_t __Pyx_sub___pyx_t_5thinc_8typedefs_time_t_checking_overflow(__pyx_t_5thinc_8typedefs_time_t a, __pyx_t_5thinc_8typedefs_time_t b, int *overflow) {
    if (sizeof(__pyx_t_5thinc_8typedefs_time_t) < sizeof(int)) {
        return __Pyx_sub_no_overflow(a, b, overflow);
    } else if (__PYX_IS_UNSIGNED(__pyx_t_5thinc_8typedefs_time_t)) {
        if (sizeof(__pyx_t_5thinc_8typedefs_time_t) == sizeof(unsigned int)) {
            return __Pyx_sub_unsigned_int_checking_overflow(a, b, overflow);
        } else if (sizeof(__pyx_t_5thinc_8typedefs_time_t) == sizeof(unsigned long)) {
            return __Pyx_sub_unsigned_long_checking_overflow(a, b, overflow);
        } else if (sizeof(__pyx_t_5thinc_8typedefs_time_t) == sizeof(unsigned long long)) {
            return __Pyx_sub_unsigned_long_long_checking_overflow(a, b, overflow);
        } else {
            abort(); return 0; // handled elsewhere
        }
    } else {
        if (sizeof(__pyx_t_5thinc_8typedefs_time_t) == sizeof(int)) {
            return __Pyx_sub_int_checking_overflow(a, b, overflow);
        } else if (sizeof(__pyx_t_5thinc_8typedefs_time_t) == sizeof(long)) {
            return __Pyx_sub_long_checking_overflow(a, b, overflow);
        } else if (sizeof(__pyx_t_5thinc_8typedefs_time_t) == sizeof(long long)) {
            return __Pyx_sub_long_long_checking_overflow(a, b, overflow);
        } else {
            abort(); return 0; // handled elsewhere
        }
    }
}

static CYTHON_INLINE PyObject* __Pyx_PyInt_From_long(long value) {
    const long neg_one = (long) -1, const_zero = 0;
    const int is_unsigned = neg_one > const_zero;
    if (is_unsigned) {
        if (sizeof(long) < sizeof(long)) {
            return PyInt_FromLong((long) value);
        } else if (sizeof(long) <= sizeof(unsigned long)) {
            return PyLong_FromUnsignedLong((unsigned long) value);
        } else if (sizeof(long) <= sizeof(unsigned long long)) {
            return PyLong_FromUnsignedLongLong((unsigned long long) value);
        }
    } else {
        if (sizeof(long) <= sizeof(long)) {
            return PyInt_FromLong((long) value);
        } else if (sizeof(long) <= sizeof(long long)) {
            return PyLong_FromLongLong((long long) value);
        }
    }
    {
        int one = 1; int little = (int)*(unsigned char *)&one;
        unsigned char *bytes = (unsigned char *)&value;
        return _PyLong_FromByteArray(bytes, sizeof(long),
                                     little, !is_unsigned);
    }
}

static CYTHON_INLINE size_t __Pyx_PyInt_As_size_t(PyObject *x) {
    const size_t neg_one = (size_t) -1, const_zero = 0;
    const int is_unsigned = neg_one > const_zero;
#if PY_MAJOR_VERSION < 3
    if (likely(PyInt_Check(x))) {
        if (sizeof(size_t) < sizeof(long)) {
            __PYX_VERIFY_RETURN_INT(size_t, long, PyInt_AS_LONG(x))
        } else {
            long val = PyInt_AS_LONG(x);
            if (is_unsigned && unlikely(val < 0)) {
                goto raise_neg_overflow;
            }
            return (size_t) val;
        }
    } else
#endif
    if (likely(PyLong_Check(x))) {
        if (is_unsigned) {
#if CYTHON_COMPILING_IN_CPYTHON && PY_MAJOR_VERSION >= 3
 #if CYTHON_USE_PYLONG_INTERNALS
            switch (Py_SIZE(x)) {
                case  0: return 0;
                case  1: __PYX_VERIFY_RETURN_INT(size_t, digit, ((PyLongObject*)x)->ob_digit[0]);
            }
 #endif
#endif
            if (unlikely(Py_SIZE(x) < 0)) {
                goto raise_neg_overflow;
            }
            if (sizeof(size_t) <= sizeof(unsigned long)) {
                __PYX_VERIFY_RETURN_INT(size_t, unsigned long, PyLong_AsUnsignedLong(x))
            } else if (sizeof(size_t) <= sizeof(unsigned long long)) {
                __PYX_VERIFY_RETURN_INT(size_t, unsigned long long, PyLong_AsUnsignedLongLong(x))
            }
        } else {
#if CYTHON_COMPILING_IN_CPYTHON && PY_MAJOR_VERSION >= 3
 #if CYTHON_USE_PYLONG_INTERNALS
            switch (Py_SIZE(x)) {
                case  0: return 0;
                case  1: __PYX_VERIFY_RETURN_INT(size_t,  digit, +(((PyLongObject*)x)->ob_digit[0]));
                case -1: __PYX_VERIFY_RETURN_INT(size_t, sdigit, -(sdigit) ((PyLongObject*)x)->ob_digit[0]);
            }
 #endif
#endif
            if (sizeof(size_t) <= sizeof(long)) {
                __PYX_VERIFY_RETURN_INT(size_t, long, PyLong_AsLong(x))
            } else if (sizeof(size_t) <= sizeof(long long)) {
                __PYX_VERIFY_RETURN_INT(size_t, long long, PyLong_AsLongLong(x))
            }
        }
        {
#if CYTHON_COMPILING_IN_PYPY && !defined(_PyLong_AsByteArray)
            PyErr_SetString(PyExc_RuntimeError,
                            "_PyLong_AsByteArray() not available in PyPy, cannot convert large numbers");
#else
            size_t val;
            PyObject *v = __Pyx_PyNumber_Int(x);
 #if PY_MAJOR_VERSION < 3
            if (likely(v) && !PyLong_Check(v)) {
                PyObject *tmp = v;
                v = PyNumber_Long(tmp);
                Py_DECREF(tmp);
            }
 #endif
            if (likely(v)) {
                int one = 1; int is_little = (int)*(unsigned char *)&one;
                unsigned char *bytes = (unsigned char *)&val;
                int ret = _PyLong_AsByteArray((PyLongObject *)v,
                                              bytes, sizeof(val),
                                              is_little, !is_unsigned);
                Py_DECREF(v);
                if (likely(!ret))
                    return val;
            }
#endif
            return (size_t) -1;
        }
    } else {
        size_t val;
        PyObject *tmp = __Pyx_PyNumber_Int(x);
        if (!tmp) return (size_t) -1;
        val = __Pyx_PyInt_As_size_t(tmp);
        Py_DECREF(tmp);
        return val;
    }
raise_overflow:
    PyErr_SetString(PyExc_OverflowError,
        "value too large to convert to size_t");
    return (size_t) -1;
raise_neg_overflow:
    PyErr_SetString(PyExc_OverflowError,
        "can't convert negative value to size_t");
    return (size_t) -1;
}

static CYTHON_INLINE uint32_t __Pyx_PyInt_As_uint32_t(PyObject *x) {
    const uint32_t neg_one = (uint32_t) -1, const_zero = 0;
    const int is_unsigned = neg_one > const_zero;
#if PY_MAJOR_VERSION < 3
    if (likely(PyInt_Check(x))) {
        if (sizeof(uint32_t) < sizeof(long)) {
            __PYX_VERIFY_RETURN_INT(uint32_t, long, PyInt_AS_LONG(x))
        } else {
            long val = PyInt_AS_LONG(x);
            if (is_unsigned && unlikely(val < 0)) {
                goto raise_neg_overflow;
            }
            return (uint32_t) val;
        }
    } else
#endif
    if (likely(PyLong_Check(x))) {
        if (is_unsigned) {
#if CYTHON_COMPILING_IN_CPYTHON && PY_MAJOR_VERSION >= 3
 #if CYTHON_USE_PYLONG_INTERNALS
            switch (Py_SIZE(x)) {
                case  0: return 0;
                case  1: __PYX_VERIFY_RETURN_INT(uint32_t, digit, ((PyLongObject*)x)->ob_digit[0]);
            }
 #endif
#endif
            if (unlikely(Py_SIZE(x) < 0)) {
                goto raise_neg_overflow;
            }
            if (sizeof(uint32_t) <= sizeof(unsigned long)) {
                __PYX_VERIFY_RETURN_INT(uint32_t, unsigned long, PyLong_AsUnsignedLong(x))
            } else if (sizeof(uint32_t) <= sizeof(unsigned long long)) {
                __PYX_VERIFY_RETURN_INT(uint32_t, unsigned long long, PyLong_AsUnsignedLongLong(x))
            }
        } else {
#if CYTHON_COMPILING_IN_CPYTHON && PY_MAJOR_VERSION >= 3
 #if CYTHON_USE_PYLONG_INTERNALS
            switch (Py_SIZE(x)) {
                case  0: return 0;
                case  1: __PYX_VERIFY_RETURN_INT(uint32_t,  digit, +(((PyLongObject*)x)->ob_digit[0]));
                case -1: __PYX_VERIFY_RETURN_INT(uint32_t, sdigit, -(sdigit) ((PyLongObject*)x)->ob_digit[0]);
            }
 #endif
#endif
            if (sizeof(uint32_t) <= sizeof(long)) {
                __PYX_VERIFY_RETURN_INT(uint32_t, long, PyLong_AsLong(x))
            } else if (sizeof(uint32_t) <= sizeof(long long)) {
                __PYX_VERIFY_RETURN_INT(uint32_t, long long, PyLong_AsLongLong(x))
            }
        }
        {
#if CYTHON_COMPILING_IN_PYPY && !defined(_PyLong_AsByteArray)
            PyErr_SetString(PyExc_RuntimeError,
                            "_PyLong_AsByteArray() not available in PyPy, cannot convert large numbers");
#else
            uint32_t val;
            PyObject *v = __Pyx_PyNumber_Int(x);
 #if PY_MAJOR_VERSION < 3
            if (likely(v) && !PyLong_Check(v)) {
                PyObject *tmp = v;
                v = PyNumber_Long(tmp);
                Py_DECREF(tmp);
            }
 #endif
            if (likely(v)) {
                int one = 1; int is_little = (int)*(unsigned char *)&one;
                unsigned char *bytes = (unsigned char *)&val;
                int ret = _PyLong_AsByteArray((PyLongObject *)v,
                                              bytes, sizeof(val),
                                              is_little, !is_unsigned);
                Py_DECREF(v);
                if (likely(!ret))
                    return val;
            }
#endif
            return (uint32_t) -1;
        }
    } else {
        uint32_t val;
        PyObject *tmp = __Pyx_PyNumber_Int(x);
        if (!tmp) return (uint32_t) -1;
        val = __Pyx_PyInt_As_uint32_t(tmp);
        Py_DECREF(tmp);
        return val;
    }
raise_overflow:
    PyErr_SetString(PyExc_OverflowError,
        "value too large to convert to uint32_t");
    return (uint32_t) -1;
raise_neg_overflow:
    PyErr_SetString(PyExc_OverflowError,
        "can't convert negative value to uint32_t");
    return (uint32_t) -1;
}

static CYTHON_INLINE long __Pyx_PyInt_As_long(PyObject *x) {
    const long neg_one = (long) -1, const_zero = 0;
    const int is_unsigned = neg_one > const_zero;
#if PY_MAJOR_VERSION < 3
    if (likely(PyInt_Check(x))) {
        if (sizeof(long) < sizeof(long)) {
            __PYX_VERIFY_RETURN_INT(long, long, PyInt_AS_LONG(x))
        } else {
            long val = PyInt_AS_LONG(x);
            if (is_unsigned && unlikely(val < 0)) {
                goto raise_neg_overflow;
            }
            return (long) val;
        }
    } else
#endif
    if (likely(PyLong_Check(x))) {
        if (is_unsigned) {
#if CYTHON_COMPILING_IN_CPYTHON && PY_MAJOR_VERSION >= 3
 #if CYTHON_USE_PYLONG_INTERNALS
            switch (Py_SIZE(x)) {
                case  0: return 0;
                case  1: __PYX_VERIFY_RETURN_INT(long, digit, ((PyLongObject*)x)->ob_digit[0]);
            }
 #endif
#endif
            if (unlikely(Py_SIZE(x) < 0)) {
                goto raise_neg_overflow;
            }
            if (sizeof(long) <= sizeof(unsigned long)) {
                __PYX_VERIFY_RETURN_INT(long, unsigned long, PyLong_AsUnsignedLong(x))
            } else if (sizeof(long) <= sizeof(unsigned long long)) {
                __PYX_VERIFY_RETURN_INT(long, unsigned long long, PyLong_AsUnsignedLongLong(x))
            }
        } else {
#if CYTHON_COMPILING_IN_CPYTHON && PY_MAJOR_VERSION >= 3
 #if CYTHON_USE_PYLONG_INTERNALS
            switch (Py_SIZE(x)) {
                case  0: return 0;
                case  1: __PYX_VERIFY_RETURN_INT(long,  digit, +(((PyLongObject*)x)->ob_digit[0]));
                case -1: __PYX_VERIFY_RETURN_INT(long, sdigit, -(sdigit) ((PyLongObject*)x)->ob_digit[0]);
            }
 #endif
#endif
            if (sizeof(long) <= sizeof(long)) {
                __PYX_VERIFY_RETURN_INT(long, long, PyLong_AsLong(x))
            } else if (sizeof(long) <= sizeof(long long)) {
                __PYX_VERIFY_RETURN_INT(long, long long, PyLong_AsLongLong(x))
            }
        }
        {
#if CYTHON_COMPILING_IN_PYPY && !defined(_PyLong_AsByteArray)
            PyErr_SetString(PyExc_RuntimeError,
                            "_PyLong_AsByteArray() not available in PyPy, cannot convert large numbers");
#else
            long val;
            PyObject *v = __Pyx_PyNumber_Int(x);
 #if PY_MAJOR_VERSION < 3
            if (likely(v) && !PyLong_Check(v)) {
                PyObject *tmp = v;
                v = PyNumber_Long(tmp);
                Py_DECREF(tmp);
            }
 #endif
            if (likely(v)) {
                int one = 1; int is_little = (int)*(unsigned char *)&one;
                unsigned char *bytes = (unsigned char *)&val;
                int ret = _PyLong_AsByteArray((PyLongObject *)v,
                                              bytes, sizeof(val),
                                              is_little, !is_unsigned);
                Py_DECREF(v);
                if (likely(!ret))
                    return val;
            }
#endif
            return (long) -1;
        }
    } else {
        long val;
        PyObject *tmp = __Pyx_PyNumber_Int(x);
        if (!tmp) return (long) -1;
        val = __Pyx_PyInt_As_long(tmp);
        Py_DECREF(tmp);
        return val;
    }
raise_overflow:
    PyErr_SetString(PyExc_OverflowError,
        "value too large to convert to long");
    return (long) -1;
raise_neg_overflow:
    PyErr_SetString(PyExc_OverflowError,
        "can't convert negative value to long");
    return (long) -1;
}

static int __Pyx_check_binary_version(void) {
    char ctversion[4], rtversion[4];
    PyOS_snprintf(ctversion, 4, "%d.%d", PY_MAJOR_VERSION, PY_MINOR_VERSION);
    PyOS_snprintf(rtversion, 4, "%s", Py_GetVersion());
    if (ctversion[0] != rtversion[0] || ctversion[2] != rtversion[2]) {
        char message[200];
        PyOS_snprintf(message, sizeof(message),
                      "compiletime version %s of module '%.100s' "
                      "does not match runtime version %s",
                      ctversion, __Pyx_MODULE_NAME, rtversion);
        return PyErr_WarnEx(NULL, message, 1);
    }
    return 0;
}

static int __Pyx_ExportFunction(const char *name, void (*f)(void), const char *sig) {
    PyObject *d = 0;
    PyObject *cobj = 0;
    union {
        void (*fp)(void);
        void *p;
    } tmp;
    d = PyObject_GetAttrString(__pyx_m, (char *)"__pyx_capi__");
    if (!d) {
        PyErr_Clear();
        d = PyDict_New();
        if (!d)
            goto bad;
        Py_INCREF(d);
        if (PyModule_AddObject(__pyx_m, (char *)"__pyx_capi__", d) < 0)
            goto bad;
    }
    tmp.fp = f;
#if PY_VERSION_HEX >= 0x02070000
    cobj = PyCapsule_New(tmp.p, sig, 0);
#else
    cobj = PyCObject_FromVoidPtrAndDesc(tmp.p, (void *)sig, 0);
#endif
    if (!cobj)
        goto bad;
    if (PyDict_SetItemString(d, name, cobj) < 0)
        goto bad;
    Py_DECREF(cobj);
    Py_DECREF(d);
    return 0;
bad:
    Py_XDECREF(cobj);
    Py_XDECREF(d);
    return -1;
}

#ifndef __PYX_HAVE_RT_ImportModule
#define __PYX_HAVE_RT_ImportModule
static PyObject *__Pyx_ImportModule(const char *name) {
    PyObject *py_name = 0;
    PyObject *py_module = 0;
    py_name = __Pyx_PyIdentifier_FromString(name);
    if (!py_name)
        goto bad;
    py_module = PyImport_Import(py_name);
    Py_DECREF(py_name);
    return py_module;
bad:
    Py_XDECREF(py_name);
    return 0;
}
#endif

#ifndef __PYX_HAVE_RT_ImportType
#define __PYX_HAVE_RT_ImportType
static PyTypeObject *__Pyx_ImportType(const char *module_name, const char *class_name,
    size_t size, int strict)
{
    PyObject *py_module = 0;
    PyObject *result = 0;
    PyObject *py_name = 0;
    char warning[200];
    Py_ssize_t basicsize;
#ifdef Py_LIMITED_API
    PyObject *py_basicsize;
#endif
    py_module = __Pyx_ImportModule(module_name);
    if (!py_module)
        goto bad;
    py_name = __Pyx_PyIdentifier_FromString(class_name);
    if (!py_name)
        goto bad;
    result = PyObject_GetAttr(py_module, py_name);
    Py_DECREF(py_name);
    py_name = 0;
    Py_DECREF(py_module);
    py_module = 0;
    if (!result)
        goto bad;
    if (!PyType_Check(result)) {
        PyErr_Format(PyExc_TypeError,
            "%.200s.%.200s is not a type object",
            module_name, class_name);
        goto bad;
    }
#ifndef Py_LIMITED_API
    basicsize = ((PyTypeObject *)result)->tp_basicsize;
#else
    py_basicsize = PyObject_GetAttrString(result, "__basicsize__");
    if (!py_basicsize)
        goto bad;
    basicsize = PyLong_AsSsize_t(py_basicsize);
    Py_DECREF(py_basicsize);
    py_basicsize = 0;
    if (basicsize == (Py_ssize_t)-1 && PyErr_Occurred())
        goto bad;
#endif
    if (!strict && (size_t)basicsize > size) {
        PyOS_snprintf(warning, sizeof(warning),
            "%s.%s size changed, may indicate binary incompatibility",
            module_name, class_name);
        if (PyErr_WarnEx(NULL, warning, 0) < 0) goto bad;
    }
    else if ((size_t)basicsize != size) {
        PyErr_Format(PyExc_ValueError,
            "%.200s.%.200s has the wrong size, try recompiling",
            module_name, class_name);
        goto bad;
    }
    return (PyTypeObject *)result;
bad:
    Py_XDECREF(py_module);
    Py_XDECREF(result);
    return NULL;
}
#endif

#ifndef __PYX_HAVE_RT_ImportFunction
#define __PYX_HAVE_RT_ImportFunction
static int __Pyx_ImportFunction(PyObject *module, const char *funcname, void (**f)(void), const char *sig) {
    PyObject *d = 0;
    PyObject *cobj = 0;
    union {
        void (*fp)(void);
        void *p;
    } tmp;
    d = PyObject_GetAttrString(module, (char *)"__pyx_capi__");
    if (!d)
        goto bad;
    cobj = PyDict_GetItemString(d, funcname);
    if (!cobj) {
        PyErr_Format(PyExc_ImportError,
            "%.200s does not export expected C function %.200s",
                PyModule_GetName(module), funcname);
        goto bad;
    }
#if PY_VERSION_HEX >= 0x02070000
    if (!PyCapsule_IsValid(cobj, sig)) {
        PyErr_Format(PyExc_TypeError,
            "C function %.200s.%.200s has wrong signature (expected %.500s, got %.500s)",
             PyModule_GetName(module), funcname, sig, PyCapsule_GetName(cobj));
        goto bad;
    }
    tmp.p = PyCapsule_GetPointer(cobj, sig);
#else
    {const char *desc, *s1, *s2;
    desc = (const char *)PyCObject_GetDesc(cobj);
    if (!desc)
        goto bad;
    s1 = desc; s2 = sig;
    while (*s1 != '\0' && *s1 == *s2) { s1++; s2++; }
    if (*s1 != *s2) {
        PyErr_Format(PyExc_TypeError,
            "C function %.200s.%.200s has wrong signature (expected %.500s, got %.500s)",
             PyModule_GetName(module), funcname, sig, desc);
        goto bad;
    }
    tmp.p = PyCObject_AsVoidPtr(cobj);}
#endif
    *f = tmp.fp;
    if (!(*f))
        goto bad;
    Py_DECREF(d);
    return 0;
bad:
    Py_XDECREF(d);
    return -1;
}
#endif

static int __Pyx_InitStrings(__Pyx_StringTabEntry *t) {
    while (t->p) {
        #if PY_MAJOR_VERSION < 3
        if (t->is_unicode) {
            *t->p = PyUnicode_DecodeUTF8(t->s, t->n - 1, NULL);
        } else if (t->intern) {
            *t->p = PyString_InternFromString(t->s);
        } else {
            *t->p = PyString_FromStringAndSize(t->s, t->n - 1);
        }
        #else
        if (t->is_unicode | t->is_str) {
            if (t->intern) {
                *t->p = PyUnicode_InternFromString(t->s);
            } else if (t->encoding) {
                *t->p = PyUnicode_Decode(t->s, t->n - 1, t->encoding, NULL);
            } else {
                *t->p = PyUnicode_FromStringAndSize(t->s, t->n - 1);
            }
        } else {
            *t->p = PyBytes_FromStringAndSize(t->s, t->n - 1);
        }
        #endif
        if (!*t->p)
            return -1;
        ++t;
    }
    return 0;
}

static CYTHON_INLINE PyObject* __Pyx_PyUnicode_FromString(const char* c_str) {
    return __Pyx_PyUnicode_FromStringAndSize(c_str, (Py_ssize_t)strlen(c_str));
}
static CYTHON_INLINE char* __Pyx_PyObject_AsString(PyObject* o) {
    Py_ssize_t ignore;
    return __Pyx_PyObject_AsStringAndSize(o, &ignore);
}
static CYTHON_INLINE char* __Pyx_PyObject_AsStringAndSize(PyObject* o, Py_ssize_t *length) {
#if __PYX_DEFAULT_STRING_ENCODING_IS_ASCII || __PYX_DEFAULT_STRING_ENCODING_IS_DEFAULT
    if (
#if PY_MAJOR_VERSION < 3 && __PYX_DEFAULT_STRING_ENCODING_IS_ASCII
            __Pyx_sys_getdefaultencoding_not_ascii &&
#endif
            PyUnicode_Check(o)) {
#if PY_VERSION_HEX < 0x03030000
        char* defenc_c;
        PyObject* defenc = _PyUnicode_AsDefaultEncodedString(o, NULL);
        if (!defenc) return NULL;
        defenc_c = PyBytes_AS_STRING(defenc);
#if __PYX_DEFAULT_STRING_ENCODING_IS_ASCII
        {
            char* end = defenc_c + PyBytes_GET_SIZE(defenc);
            char* c;
            for (c = defenc_c; c < end; c++) {
                if ((unsigned char) (*c) >= 128) {
                    PyUnicode_AsASCIIString(o);
                    return NULL;
                }
            }
        }
#endif
        *length = PyBytes_GET_SIZE(defenc);
        return defenc_c;
#else
        if (__Pyx_PyUnicode_READY(o) == -1) return NULL;
#if __PYX_DEFAULT_STRING_ENCODING_IS_ASCII
        if (PyUnicode_IS_ASCII(o)) {
            *length = PyUnicode_GET_LENGTH(o);
            return PyUnicode_AsUTF8(o);
        } else {
            PyUnicode_AsASCIIString(o);
            return NULL;
        }
#else
        return PyUnicode_AsUTF8AndSize(o, length);
#endif
#endif
    } else
#endif
#if !CYTHON_COMPILING_IN_PYPY
    if (PyByteArray_Check(o)) {
        *length = PyByteArray_GET_SIZE(o);
        return PyByteArray_AS_STRING(o);
    } else
#endif
    {
        char* result;
        int r = PyBytes_AsStringAndSize(o, &result, length);
        if (unlikely(r < 0)) {
            return NULL;
        } else {
            return result;
        }
    }
}
static CYTHON_INLINE int __Pyx_PyObject_IsTrue(PyObject* x) {
   int is_true = x == Py_True;
   if (is_true | (x == Py_False) | (x == Py_None)) return is_true;
   else return PyObject_IsTrue(x);
}
static CYTHON_INLINE PyObject* __Pyx_PyNumber_Int(PyObject* x) {
  PyNumberMethods *m;
  const char *name = NULL;
  PyObject *res = NULL;
#if PY_MAJOR_VERSION < 3
  if (PyInt_Check(x) || PyLong_Check(x))
#else
  if (PyLong_Check(x))
#endif
    return Py_INCREF(x), x;
  m = Py_TYPE(x)->tp_as_number;
#if PY_MAJOR_VERSION < 3
  if (m && m->nb_int) {
    name = "int";
    res = PyNumber_Int(x);
  }
  else if (m && m->nb_long) {
    name = "long";
    res = PyNumber_Long(x);
  }
#else
  if (m && m->nb_int) {
    name = "int";
    res = PyNumber_Long(x);
  }
#endif
  if (res) {
#if PY_MAJOR_VERSION < 3
    if (!PyInt_Check(res) && !PyLong_Check(res)) {
#else
    if (!PyLong_Check(res)) {
#endif
      PyErr_Format(PyExc_TypeError,
                   "__%.4s__ returned non-%.4s (type %.200s)",
                   name, name, Py_TYPE(res)->tp_name);
      Py_DECREF(res);
      return NULL;
    }
  }
  else if (!PyErr_Occurred()) {
    PyErr_SetString(PyExc_TypeError,
                    "an integer is required");
  }
  return res;
}
static CYTHON_INLINE Py_ssize_t __Pyx_PyIndex_AsSsize_t(PyObject* b) {
  Py_ssize_t ival;
  PyObject *x;
#if PY_MAJOR_VERSION < 3
  if (likely(PyInt_CheckExact(b)))
      return PyInt_AS_LONG(b);
#endif
  if (likely(PyLong_CheckExact(b))) {
    #if CYTHON_COMPILING_IN_CPYTHON && PY_MAJOR_VERSION >= 3
     #if CYTHON_USE_PYLONG_INTERNALS
       switch (Py_SIZE(b)) {
       case -1: return -(sdigit)((PyLongObject*)b)->ob_digit[0];
       case  0: return 0;
       case  1: return ((PyLongObject*)b)->ob_digit[0];
       }
     #endif
    #endif
    return PyLong_AsSsize_t(b);
  }
  x = PyNumber_Index(b);
  if (!x) return -1;
  ival = PyInt_AsSsize_t(x);
  Py_DECREF(x);
  return ival;
}
static CYTHON_INLINE PyObject * __Pyx_PyInt_FromSize_t(size_t ival) {
    return PyInt_FromSize_t(ival);
}


#endif /* Py_PYTHON_H */
